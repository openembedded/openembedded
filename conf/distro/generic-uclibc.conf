## conf/distro/include/angstrom-2010-preferred-versions.inc
```bitbake
ANGSTROM_MESA_VERSION = "7.9.1"
ANGSTROM_QT_VERSION ?= "4.7.1"
ANGSTROM_LIBTOOL_VERSION = "2.4"
# Use new sysroot feature
LIBTOOL_HAS_SYSROOT = "yes"

CE_VERSION ?= "latest"

require conf/distro/include/angstrom-codec-engine-${CE_VERSION}-preferred-versions.inc

PREFERRED_VERSION_autoconf = "2.65"
PREFERRED_VERSION_autoconf-native = "2.65"
PREFERRED_VERSION_automake = "1.11.1"
PREFERRED_VERSION_automake-native = "1.11.1"
PREFERRED_VERSION_busybox 	= "1.18.2"
PREFERRED_VERSION_cairo		= "1.10.0"
PREFERRED_VERSION_dbus 		= "1.2.24"
PREFERRED_VERSION_dropbear      = "0.52"
PREFERRED_VERSION_fontconfig	= "2.8.0"
PREFERRED_VERSION_glib-2.0 	= "2.26.1"
PREFERRED_VERSION_glib-2.0-native = "2.26.1"
PREFERRED_VERSION_glibmm = "2.24.0"
PREFERRED_VERSION_gst-pulse 	= "0.9.7"
PREFERRED_VERSION_gtk+		= "2.20.1"
PREFERRED_VERSION_gtk+-native	= "2.20.1"
PREFERRED_VERSION_gtkmm		= "2.20.0"
PREFERRED_VERSION_hal		= "0.5.14"
PREFERRED_VERSION_libgemwidget	= "1.0"
PREFERRED_VERSION_libgpephone	= "0.4"
PREFERRED_VERSION_libsdl-x11	= "1.2.14"
PREFERRED_VERSION_libtool           = "${ANGSTROM_LIBTOOL_VERSION}"
PREFERRED_VERSION_libtool-native    = "${ANGSTROM_LIBTOOL_VERSION}"
PREFERRED_VERSION_libtool-cross     = "${ANGSTROM_LIBTOOL_VERSION}"
PREFERRED_VERSION_libtool-nativesdk = "${ANGSTROM_LIBTOOL_VERSION}"
PREFERRED_VERSION_libtool-sdk       = "${ANGSTROM_LIBTOOL_VERSION}"
PREFERRED_VERSION_lighttpd      = "1.4.26"
PREFERRED_VERSION_mesa          = "${ANGSTROM_MESA_VERSION}"
PREFERRED_VERSION_mesa-dri      = "${ANGSTROM_MESA_VERSION}"
PREFERRED_VERSION_mesa-xlib     = "${ANGSTROM_MESA_VERSION}"
PREFERRED_VERSION_mythplugins   = "0.23"
PREFERRED_VERSION_myththemes    = "0.23"
PREFERRED_VERSION_mythtv        = "0.23"
PREFERRED_VERSION_mplayer       = "0.0+1.0rc3+svnr%"
PREFERRED_VERSION_network-manager-applet = "0.8.1"
PREFERRED_VERSION_networkmanager = "0.8.1"
PREFERRED_VERSION_networkmanager-openvpn = "0.8.1"
PREFERRED_VERSION_openssl = "1.0.0c"
PREFERRED_VERSION_openssl-native = "1.0.0c"
PREFERRED_VERSION_pango 	= "1.28.3"
PREFERRED_VERSION_pango-native     = "1.28.3"
PREFERRED_VERSION_perl = "5.10.1"
PREFERRED_VERSION_perl-native = "5.10.1"
#PREFERRED_VERSION_pixman	= "0.13.2"
PREFERRED_VERSION_pkgconfig	= "0.23"
PREFERRED_VERSION_pkgconfig-native = "0.23"
PREFERRED_VERSION_pulseaudio 	= "0.9.21"
PREFERRED_VERSION_python-pycairo = "1.8.0"
PREFERRED_VERSION_qt4-tools-native = "${ANGSTROM_QT_VERSION}"
PREFERRED_VERSION_qt4-tools-sdk = "${ANGSTROM_QT_VERSION}"
PREFERRED_VERSION_qt4-embedded = "${ANGSTROM_QT_VERSION}"
PREFERRED_VERSION_qt4-embedded-gles = "${ANGSTROM_QT_VERSION}"
PREFERRED_VERSION_qt4-x11-free = "${ANGSTROM_QT_VERSION}"
PREFERRED_VERSION_qt4-x11-free-gles = "${ANGSTROM_QT_VERSION}"

PREFERRED_VERSION_samba		= "3.3.9"
PREFERRED_VERSION_tiff 		= "3.9.4+4.0.0beta6"

PREFERRED_VERSION_udev 		= "165"
PREFERRED_VERSION_udev_libc-uclibc = "141"
UDEV_GE_141 = "1"

PREFERRED_VERSION_usbutils = "0.86"
PREFERRED_VERSION_wpa-supplicant = "0.7.3"
PREFERRED_VERSION_wget = "1.11.4"
PREFERRED_VERSION_xserver-common = "1.33"
PREFERRED_VERSION_xserver-kdrive = "1.4.0.90"

#
# meta-moblin package SRCREVs
#
SRCREV_pn-bickley ?= "de9431b7c6040bc3731157c05947159ad2c7a0a9"
SRCREV_pn-json-glib ?= "930fdf4c4dff1f5310a946c2a9f5b6860f7c8ba8"
SRCREV_pn-libccss ?= "92bc59e1d39302c8be500d53cb5dd8b05c2e4a15"
SRCREV_pn-libgdbus ?= "aeab6e3c0185b271ca343b439470491b99cc587f"
SRCREV_pn-librest ?= "14d35103d9649dc1e10c3e9ac2c690b3165c8184"
SRCREV_pn-moblin-menus ?= "e1d63681739dd16195d005b3cf15752df294bd3c"
SRCREV_pn-mojito ?= "0542c4b0e26c0e3b69c5ad1fa1898dc276fb9f48"
SRCREV_pn-mozilla-headless-services ?= "c7873654894af6c7c6c01194d6185db46667b81f"
SRCREV_pn-mutter ?= "aff4cf110307e149d3497d20543cde27b9699758"
SRCREV_pn-twitter-glib ?= "849bec29292df88590e0b2898b50b9b8d766817e"
SRCREV_pn-xf86-video-psb ?= "b6b3bba06fe5a3fe0b1bd6e31a7369dd83812bab"
```

## conf/distro/include/angstrom-codec-engine-2.25-preferred-versions.inc
```bitbake
# Codec engine needs a specific set of version of its dependencies, so we specify them here:

PREFERRED_VERSION_ti-codec-engine = "2_25_00_05"
 
PREFERRED_VERSION_ti-biosutils = "1_02_02"
PREFERRED_VERSION_ti-cgt6x = "6_1_9"
PREFERRED_VERSION_ti-dspbios = "5_41_02_14"
PREFERRED_VERSION_ti-dsplink-module = "1_64"
PREFERRED_VERSION_ti-edma3lld = "01_11_00_02"
PREFERRED_VERSION_ti-framework-components = "2_25_00_04"
PREFERRED_VERSION_ti-linuxutils = "2_25_01_06"
PREFERRED_VERSION_ti-lpm-module = "2_24_01"
PREFERRED_VERSION_ti-xdais = "6_25_00_07"
PREFERRED_VERSION_ti-xdctools = "3_16_01_27"
```

## conf/distro/include/angstrom-codec-engine-2.25.01-preferred-versions.inc
```bitbake
# Codec engine needs a specific set of version of its dependencies, so we specify them here:
# - using edma-lld 01.11.00.03 (instead of 01.11.00.02) to fix installer issue.

PREFERRED_VERSION_ti-codec-engine = "2_25_01_06"
 
PREFERRED_VERSION_ti-biosutils = "1_02_02"
PREFERRED_VERSION_ti-cgt6x = "6_1_9"
PREFERRED_VERSION_ti-dspbios = "5_41_02_14"
PREFERRED_VERSION_ti-dsplink-module = "1_64"
PREFERRED_VERSION_ti-edma3lld = "01_11_00_03"
PREFERRED_VERSION_ti-framework-components = "2_25_01_05"
PREFERRED_VERSION_ti-linuxutils = "2_25_01_06"
PREFERRED_VERSION_ti-lpm-module = "1_24_01"
PREFERRED_VERSION_ti-xdais = "6_25_01_08"
PREFERRED_VERSION_ti-xdctools = "3_16_01_27"
```

## conf/distro/include/angstrom-codec-engine-latest-preferred-versions.inc
```bitbake
# This is the latest set of TI components
#

PREFERRED_VERSION_ti-codec-engine = "2_26_01_09"
PREFERRED_VERSION_ti-codec-engine-examples = "2_26_01_09"

PREFERRED_VERSION_ti-biosutils = "1_02_02"
PREFERRED_VERSION_ti-cgt6x = "6_1_17"
PREFERRED_VERSION_ti-dspbios = "5_41_07_24"
PREFERRED_VERSION_ti-dsplink = "1_65_00_03"
PREFERRED_VERSION_ti-dsplink-examples = "1_65_00_03"
PREFERRED_VERSION_ti-dsplink-module = "1_65_00_03"
PREFERRED_VERSION_ti-edma3lld = "01_11_00_03"
PREFERRED_VERSION_ti-framework-components = "2_25_03_07"
PREFERRED_VERSION_ti-linuxutils = "2_25_05_11"
PREFERRED_VERSION_ti-local-power-manager = "1_24_02_09"
PREFERRED_VERSION_ti-lpm-module = "1_24_02_09"
PREFERRED_VERSION_ti-lpm-utils = "1_24_02_09"
PREFERRED_VERSION_ti-xdais = "6_26_00_02"
PREFERRED_VERSION_ti-xdctools = "3_20_05_76"

PREFERRED_VERSION_ti-codecs-dm355 = "1_13_000"
PREFERRED_VERSION_ti-codecs-dm355-server = "1_13_000"
PREFERRED_VERSION_ti-codecs-dm365 = "3_10_00_02"
PREFERRED_VERSION_ti-codecs-dm365-server = "3_10_00_02"
PREFERRED_VERSION_ti-codecs-dm6446 = "2_05_00_00"
PREFERRED_VERSION_ti-codecs-dm6446-server = "2_05_00_00"
PREFERRED_VERSION_ti-codecs-dm6467 = "1_00_00_03"
PREFERRED_VERSION_ti-codecs-dm6467-server = "1_00_00_03"
PREFERRED_VERSION_ti-codecs-omap3530 = "4_00_00_00"
PREFERRED_VERSION_ti-codecs-omap3530-server = "4_00_00_00"
PREFERRED_VERSION_ti-codecs_omapl137 = "1_00_00"
PREFERRED_VERSION_ti-codecs_omapl137-server = "1_00_00"
PREFERRED_VERSION_ti-codecs_omapl138 = "1_00_00"
PREFERRED_VERSION_ti-codecs-omapl138-server = "1_00_00"
PREFERRED_VERSION_ti-dm355mm-module = "1_13"
PREFERRED_VERSION_ti-dm365mm-module = "1_0_3"
PREFERRED_VERSION_ti-dvsdk-demos = "3_10_00_11"

PREFERRED_VERSION_ti-dmai = "2_10_00_01+svnr%"
PREFERRED_VERSION_ti-dmai-apps = "2_10_00_01+svnr%"
PREFERRED_VERSION_ti-dmai-tests = "2_10_00_01+svnr%"
# PREFERRED_VERSION_gstreamer-ti = ""
# PREFERRED_VERSION_gstreamer-ti-demo-script = ""

# PREFERRED_VERSION_matrix-gui = ""
# PREFERRED_VERSION_bitblit = ""
# PREFERRED_VERSION_ti-dsplib = ""
# PREFERRED_VERSION_ti-sysbios = ""
```

## conf/distro/include/angstrom-codec-engine-latestproduction-preferred-versions.inc
```bitbake
# This is the latest set of 'GA'd (Production Release) TI components
#

PREFERRED_VERSION_ti-codec-engine = "2_25_02_11"
PREFERRED_VERSION_ti-codec-engine-examples = "2_25_02_11"

PREFERRED_VERSION_ti-biosutils = "1_02_02"
PREFERRED_VERSION_ti-cgt6x = "6_1_14"
PREFERRED_VERSION_ti-dspbios = "5_41_03_17"
PREFERRED_VERSION_ti-dsplink = "1_64"
PREFERRED_VERSION_ti-dsplink-examples = "1_64"
PREFERRED_VERSION_ti-dsplink-module = "1_64"
PREFERRED_VERSION_ti-edma3lld = "01_11_00_03"
PREFERRED_VERSION_ti-framework-components = "2_25_01_05"
PREFERRED_VERSION_ti-linuxutils = "2_25_02_08"
PREFERRED_VERSION_ti-local-power-manager = "1_24_02_09"
PREFERRED_VERSION_ti-lpm-module = "1_24_02_09"
PREFERRED_VERSION_ti-lpm-utils = "1_24_02_09"
PREFERRED_VERSION_ti-xdais = "6_25_02_11"
PREFERRED_VERSION_ti-xdctools = "3_16_03_36"

PREFERRED_VERSION_ti-codecs-dm355 = "1_13_000"
PREFERRED_VERSION_ti-codecs-dm355-server = "1_13_000"
PREFERRED_VERSION_ti-codecs-dm365 = "3_10_00_02"
PREFERRED_VERSION_ti-codecs-dm365-server = "3_10_00_02"
PREFERRED_VERSION_ti-codecs-dm6446 = "2_05_00_00"
PREFERRED_VERSION_ti-codecs-dm6446-server = "2_05_00_00"
PREFERRED_VERSION_ti-codecs-dm6467 = "1_00_00_03"
PREFERRED_VERSION_ti-codecs-dm6467-server = "1_00_00_03"
PREFERRED_VERSION_ti-codecs-omap3530 = "1_00_01"
PREFERRED_VERSION_ti-codecs-omap3530-server = "1_00_01"
PREFERRED_VERSION_ti-codecs_omapl137 = "1_00_00"
PREFERRED_VERSION_ti-codecs_omapl137-server = "1_00_00"
PREFERRED_VERSION_ti-codecs_omapl138 = "1_00_00"
PREFERRED_VERSION_ti-codecs-omapl138-server = "1_00_00"
PREFERRED_VERSION_ti-dm355mm-module = "1_13"
PREFERRED_VERSION_ti-dm365mm-module = "1_0_3"
PREFERRED_VERSION_ti-dvsdk-demos = "3_10_00_11"

# PREFERRED_VERSION_ti-dmai = ""
# PREFERRED_VERSION_ti-dmai-apps = ""
# PREFERRED_VERSION_ti-dmai-tests = ""
# PREFERRED_VERSION_gstreamer-ti = ""
# PREFERRED_VERSION_gstreamer-ti-demo-script = ""

# PREFERRED_VERSION_matrix-gui = ""
# PREFERRED_VERSION_bitblit = ""
# PREFERRED_VERSION_ti-dsplib = ""
# PREFERRED_VERSION_ti-sysbios = ""
```

## conf/distro/include/angstrom-eglibc.inc
```bitbake
# eglibc:
require conf/distro/include/eglibc.inc

ANGSTROM_BLACKLIST_pn-libiconv = "the glibc builtin iconv replacement is used"

TARGET_OS = "linux"

# sane-toolchain.inc has this, and explains the GNU and ABI suffices:
#TARGET_OS = "${@compute_os_portion_of_target_triplet(d)}"

TARGET_OS .= "${@['','-gnueabi'][bb.data.getVar('TARGET_ARCH',d,1) in ['arm', 'armeb']]}"
TARGET_OS .= "${@['','-gnuspe'][bb.data.getVar('BASE_PACKAGE_ARCH',d,1) in ['ppce500', 'ppce500v2']]}"

# perl has some problems, see http://bugs.openembedded.net/show_bug.cgi?id=1616
# [23:00] oxo: glibc (any version) on sparc does not like (repeat me) "-Os"

FULL_OPTIMIZATION = "-fexpensive-optimizations -fomit-frame-pointer -frename-registers -O2 -ggdb2"
FULL_OPTIMIZATION_pn-eglibc_arm = "-fexpensive-optimizations -fomit-frame-pointer -frename-registers -O2 -ggdb3"
FULL_OPTIMIZATION_pn-perl = "-fexpensive-optimizations -fomit-frame-pointer -frename-registers -O1"
FULL_OPTIMIZATION_sparc = "-fexpensive-optimizations -fomit-frame-pointer -frename-registers -O2"

BUILD_OPTIMIZATION = "-O2 -g"
BUILD_OPTIMIZATION_pn-perl = "-O1"
BUILD_OPTIMIZATION_sparc = "-O2"

TARGET_LINK_HASH_STYLE = "${@['-Wl,--hash-style=gnu',''][bb.data.getVar('TARGET_ARCH',d,1) in ['mips', 'mipsel', 'mips64', 'mips64el']]}"

CXXFLAGS += "-fvisibility-inlines-hidden"
```

## conf/distro/include/angstrom-glibc.inc
```bitbake
# glibc:
require conf/distro/include/glibc-${TOOLCHAIN_TYPE}.inc

ANGSTROM_BLACKLIST_pn-libiconv = "the glibc builtin iconv replacement is used"

TARGET_OS = "linux"
TARGET_OS .= "${@['','-gnueabi'][bb.data.getVar('TARGET_ARCH',d,1) in ['arm', 'armeb']]}"

#mess with compiler flags to use -Os instead of -O2
#Please see http://free-electrons.com/doc/embedded_linux_optimizations/img47.html for some more info
# perl has some problems, see http://bugs.openembedded.net/show_bug.cgi?id=1616
# [23:00] oxo: glibc (any version) on sparc does not like (repeat me) "-Os"

FULL_OPTIMIZATION = "-fexpensive-optimizations -frename-registers -fomit-frame-pointer -O2 -ggdb3"

FULL_OPTIMIZATION_pn-perl = "-fexpensive-optimizations -fomit-frame-pointer -frename-registers -O1"
FULL_OPTIMIZATION_pn-glibc = "-fexpensive-optimizations -fomit-frame-pointer -O2"
FULL_OPTIMIZATION_sparc = "-fexpensive-optimizations -fomit-frame-pointer -frename-registers -O2"
FULL_OPTIMIZATION_ep9312 = "-fexpensive-optimizations -fomit-frame-pointer -frename-registers -O -fno-signed-zeros"

# This is only used for -native packages
BUILD_OPTIMIZATION = "-O2 -g"
BUILD_OPTIMIZATION_pn-perl-native = "-O1 -g"

TARGET_LINK_HASH_STYLE = "${@['-Wl,--hash-style=gnu',''][bb.data.getVar('TARGET_ARCH',d,1) in ['mips', 'mipsel']]}"

# Disable -Wl,as-needed for now till all the test come back OK
#require conf/distro/include/angstrom-ldflags.inc

CXXFLAGS += "-fvisibility-inlines-hidden"
```

## conf/distro/include/angstrom-jalimo.conf
```bitbake
# Put a 'require conf/distro/include/angstrom-jalimo.conf' in your local.conf if you want to build from the jalimo overlay

# initial stuff
PREFERRED_VERSION_jamvm-initial = "1.4.5"
PREFERRED_VERSION_classpath-initial = "0.93"

# Native VM
PREFERRED_PROVIDER_virtual/java-native ?= "cacao-native"
SRCREV_pn-cacao-native ?= "c7bf150bfa46"
PREFERRED_VERSION_classpath-native = "0.98"

# Native compiler settings
PREFERRED_PROVIDER_virtual/javac-native = "ecj-bootstrap-native"
PREFERRED_VERSION_libecj-bootstrap = "3.6"

# Target VM
PREFERRED_VERSION_cacao = "0.99.3"
PREFERRED_VERSION_cacaoh-native = "0.99.3"

PREFERRED_VERSION_jamvm = "1.5.2"
PREFERRED_PROVIDER_swt3.4-gtk = "swt3.4-gtk"
PREFERRED_PROVIDER_classpath = "classpath"

PREFERRED_VERSION_openjdk-6-jre = "6b18-1.8.5"
PREFERRED_VERSION_icedtea6-native = "1.7.10"

# Stage JAR files not into ARCH related dirs
STAGING_DIR_JAVA = "${STAGING_DIR}/java"
STAGING_DATADIR_JAVA ?= "${STAGING_DIR_JAVA}"
```

## conf/distro/include/angstrom-ldflags.inc
```bitbake
# Set as-need to an intermediate var...
ASNEEDED = "-Wl,--as-needed"

# ...so we can blacklist it for recipes that break with it
ASNEEDED_pn-console-tools = ""
ASNEEDED_pn-distcc = ""
ASNEEDED_pn-openobex = ""
ASNEEDED_pn-icu = ""
ASNEEDED_pn-xserver-kdrive-xomap = ""
ASNEEDED_pn-minimo = ""
ASNEEDED_pn-pciutils = ""
ASNEEDED_pn-puzzles = ""
ASNEEDED_pn-dialer = ""
ASNEEDED_pn-pulseaudio = ""
ASNEEDED_pn-python = ""
ASNEEDED_pn-libproxy = ""
ASNEEDED_pn-libxsettings-client = ""
ASNEEDED_pn-libmatchbox = ""
ASNEEDED_pn-faac = ""
ASNEEDED_pn-wireless-tools = ""
ASNEEDED_pn-ffmpeg = ""

# Append it to TARGET_LDLFLAGS 
TARGET_LDFLAGS += "${ASNEEDED}"
```

## conf/distro/include/angstrom-package-deb.inc
```bitbake
INHERIT += "package_deb"

PREFERRED_PROVIDER_virtual/update-alternatives-native ?= "update-alternatives-cworth-native"
PREFERRED_PROVIDER_virtual/update-alternatives ?= "update-alternatives-cworth"
```

## conf/distro/include/angstrom-package-ipk.inc
```bitbake
INHERIT += "package_ipk"

PREFERRED_PROVIDER_virtual/update-alternatives-native ?= "opkg-native"
PREFERRED_PROVIDER_virtual/update-alternatives ?= ${PREFERRED_PROVIDER_opkg}
```
