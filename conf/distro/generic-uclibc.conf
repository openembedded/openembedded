## conf/distro/generic-uclibc.conf
```bitbake
#-----------------------------------------------------------------------------
#@TYPE: Distribution
#@NAME: Generic uClibC
#@DESCRIPTION: Generic uClibC Embedded Linux Distribution Configuration
#
#@COMMENT: This distribution configuration serves as a starting point for
#@COMMENT: the integration of new target platforms, machines, or distributions.
#@COMMENT: It bases on conservative settings and should always be buildable.
#-----------------------------------------------------------------------------

require conf/distro/generic.conf

#
# Header
#
DISTRO_NAME = "generic-uClibC"

#
# Target OS & FPU system
#
TARGET_OS = "linux-uclibc"
TARGET_FPU_arm = "soft"
TARGET_FPU_armeb = "soft"
PREFERRED_PROVIDER_virtual/libiconv = "libiconv"
PREFERRED_PROVIDER_virtual/libintl = "libintl"
```

## conf/distro/generic-unstable.conf
```bitbake
#@--------------------------------------------------------------------
#@TYPE: Distribution
#@NAME: Bleeding Edge
#@DESCRIPTION: An experimental distribution configuration
#@--------------------------------------------------------------------

#
# Header
#
DISTRO_NAME = "generic-unstable-glibc"
DISTRO_VERSION = ".dev-snapshot-${SRCDATE}"
#DISTRO_TYPE = "release"
DISTRO_TYPE = "debug"

#
# Naming schemes
#
PARALLEL_INSTALL_MODULES = "1"
INHERIT += "debian multimachine"

#
# Packaging and output format
#
INHERIT += "package_ipk"
IMAGE_FSTYPES = "tar.gz ext2.gz jffs2"

#
# Binutils & Compiler
#
PREFERRED_PROVIDERS += " virtual/${TARGET_PREFIX}gcc-initial:gcc-cross-initial"
PREFERRED_PROVIDERS += " virtual/${TARGET_PREFIX}gcc:gcc-cross"
PREFERRED_PROVIDERS += " virtual/${TARGET_PREFIX}g++:gcc-cross"

#
# Target OS & FPU system
# 
TARGET_OS = "linux"
TARGET_FPU_arm = "soft"
TARGET_FPU_armeb = "soft"
PREFERRED_PROVIDER_virtual/libiconv = "glibc"
PREFERRED_PROVIDER_virtual/libintl = "glibc"
PREFERRED_PROVIDER_virtual/arm-linux-libc-for-gcc = "glibc-intermediate"
PREFERRED_VERSION_glibc = "2.4"
PREFERRED_VERSION_glibc-intermediate = "2.4"

#
# Bootstrap & Init
#
PREFERRED_PROVIDER_task-bootstrap = "task-bootstrap"

#
# Framebuffer & X
#
PREFERRED_PROVIDER_virtual/libx11 ?= "diet-x11"
PREFERRED_PROVIDER_tslib ?= tslib

#
# GPE
#
require conf/distro/include/preferred-gpe-versions.inc

#
# Opie
#
QTE_VERSION = "2.3.10"
PALMTOP_USE_MULTITHREADED_QTE = "yes"
require conf/distro/include/preferred-opie-versions.inc

#
# Enlightenment
#
require conf/distro/include/preferred-e-versions.inc
```

## conf/distro/generic.conf
```bitbake
#-----------------------------------------------------------------------------
#@TYPE: Distribution
#@NAME: Generic
#@DESCRIPTION: Generic Embedded Linux Distribution Configuration
#
#@COMMENT: This distribution configuration serves as a starting point for
#@COMMENT: the integration of new target platforms, machines, or distributions.
#@COMMENT: It bases on conservative settings and should always be buildable.
#-----------------------------------------------------------------------------

#
# Header
#
DISTRO_NAME = "generic-glibc"
DISTRO_VERSION = ".dev-snapshot-${SRCDATE}"
#DISTRO_TYPE = "release"
DISTRO_TYPE = "debug"

#
# Naming schemes
#
INHERIT += "debian multimachine"

#
# Packaging and output format
#
INHERIT += "package_ipk"
IMAGE_FSTYPES ?= "tar.gz ext2.gz jffs2"

#
# Kernel
#
KERNEL = "kernel26"
MACHINE_KERNEL_VERSION = "2.6"

#
# Binutils & Compiler
#
PREFERRED_PROVIDERS += " virtual/${TARGET_PREFIX}gcc-initial:gcc-cross-initial"
PREFERRED_PROVIDERS += " virtual/${TARGET_PREFIX}gcc:gcc-cross"
PREFERRED_PROVIDERS += " virtual/${TARGET_PREFIX}g++:gcc-cross"

PREFERRED_VERSION_gcc ?= "4.1.1"
PREFERRED_VERSION_gcc-cross ?= "4.1.1"
PREFERRED_VERSION_gcc-cross-initial ?= "4.1.1"
PREFERRED_VERSION_binutils ?= "2.17.50.0.5"
PREFERRED_VERSION_binutils-cross ?= "2.17.50.0.5"

#
# Target OS & FPU system
# 
TARGET_OS = "linux"
TARGET_FPU_arm = "soft"
TARGET_FPU_armeb = "soft"

PREFERRED_PROVIDER_virtual/libiconv = "glibc"
PREFERRED_PROVIDER_virtual/libintl = "glibc"
PREFERRED_PROVIDER_virtual/libc = "glibc"
PREFERRED_PROVIDER_virtual/${TARGET_PREFIX}libc-for-gcc = "glibc-intermediate"
PREFERRED_VERSION_linux-libc-headers ?= "2.6.18"
PREFERRED_VERSION_glibc ?= "2.5"
PREFERRED_VERSION_glibc-intermediate ?= "2.5"

#
# Bootstrap & Init
#
PREFERRED_PROVIDER_task-bootstrap = "task-bootstrap"
require conf/distro/include/sane-srcdates.inc

#
# Framebuffer & X
#
PREFERRED_PROVIDER_virtual/libx11 ?= "diet-x11"
PREFERRED_PROVIDER_tslib ?= "tslib"
require conf/distro/include/preferred-xorg-versions-X11R7.2.inc

#
# GPE
#
require conf/distro/include/preferred-gpe-versions-2.8.inc

#
# Opie
#
QTE_VERSION = "2.3.10"
PALMTOP_USE_MULTITHREADED_QTE = "yes"
require conf/distro/include/preferred-opie-versions.inc

#
# Enlightenment
#
require conf/distro/include/preferred-e-versions.inc
```

## conf/distro/gmustix.conf
```bitbake
#@TYPE: Distribution
#@NAME: GMUstix
#@DESCRIPTION: Gumstix distribution for GMU (George Mason University)

INHERIT += "package_tar package_ipk"
LIBC = "uclibc"
require conf/distro/include/${LIBC}.inc
require conf/distro/include/arm-thumb.inc

TARGET_OS = "linux-uclibc"
TARGET_FPU = "soft"
IMAGE_FSTYPES = "jffs2"

PREFERRED_PROVIDERS += " virtual/${TARGET_PREFIX}gcc-initial:gcc-cross-initial"
PREFERRED_PROVIDERS += " virtual/${TARGET_PREFIX}gcc-intermediate:gcc-cross-intermediate"
PREFERRED_PROVIDERS += " virtual/${TARGET_PREFIX}gcc:gcc-cross"
PREFERRED_PROVIDERS += " virtual/${TARGET_PREFIX}g++:gcc-cross"

PREFERRED_PROVIDER_classpath = "classpath-minimal"

PREFERRED_VERSION_gcc-cross-initial = "3.4.4"
PREFERRED_VERSION_gcc-cross-intermediate = "3.4.4"
PREFERRED_VERSION_gcc-cross = "3.4.4"
PREFERRED_VERSION_gcc-cross-sdk = "3.4.4" 
PREFERRED_VERSION_gcc = "3.4.4"

PREFERRED_VERSION_ipkg-native = "0.99.160"
PREFERRED_VERSION_qemu-native = "0.8.0"

DISTRO_VERSION = "uno"

IPK_EXCLUDE_SOURCE = "1"
```

## conf/distro/grant.conf
```bitbake
INHERIT += " package_ipk debian"
DISTRO = "grant-openzaurus"

FEED_URIS_openzaurus = "OZ-3.5.2##http://openzaurus.org/official/unstable/3.5.2/feed/ \
              OZ-Upgrades##http://openzaurus.org/official/unstable/3.5.2/upgrades/"

ASSUME_PROVIDED = "virtual/arm-linux-gcc-2.95"
PREFERRED_PROVIDERS = "virtual/qte:qte-for-opie virtual/libqpe:libqpe-opie"
PREFERRED_PROVIDERS += " virtual/xserver:xserver-kdrive"
PREFERRED_PROVIDERS += " gst-plugins:gpe-gst-plugins"
PREFERRED_PROVIDERS += " virtual/${TARGET_PREFIX}gcc-initial:gcc-cross-initial"
PREFERRED_PROVIDERS += " virtual/${TARGET_PREFIX}gcc:gcc-cross"
PREFERRED_PROVIDERS += " virtual/${TARGET_PREFIX}g++:gcc-cross"

OEINCLUDELOGS = "yes"
KERNEL_CONSOLE = "tty1"
TARGET_FPU = "soft"
```

## conf/distro/hentges-2.0.conf
```bitbake
#! /bin/sh
#
# Copyright Matthias Hentges <devel@hentges.net> (c) 2007
# License: MIT (see http://www.opensource.org/licenses/mit-license.php 
#               for a copy of the license)
#
# Filename: hentges-2.0.conf
# Date: 20070521 (YMD)

DESCRIPTION = "Distribution configuration for the Hentges ROM based on Angstrom"
MAINTAINER = "Matthias 'CoreDump' Hentges <oe@hentges.net>"
HOMEPAGE = "http://www.hentges.net"
LICENSE = "MIT"

######################################################################################

require conf/distro/angstrom-2007.1.conf

######################################################################################

require conf/machine/hentges-2.0_common.conf
require conf/machine/hentges-2.0_${MACHINE}.conf

######################################################################################

DISTRO_VERSION = "1.9+WIP-${DATE}"
DISTRO_REVISION = "1"

DISTRO = "hentges-2.0"
DISTRO_NAME = "Hentges"

######################################################################################

# Override FEED_URIS here

######################################################################################

HENTGES_PV = "${DISTRO_VERSION}"
HENTGES_PR = "${DISTRO_REVISION}"

######################################################################################
```
