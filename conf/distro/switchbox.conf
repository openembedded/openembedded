## conf/distro/switchbox.conf
```bitbake
#@TYPE: Distribution
#@NAME: SwitchBox
#@DESCRIPTION: SwitchBox Linux Distribution for the NSLU2

TARGET_FPU ?= "soft"
TARGET_OS = "linux-uclibc"

INHERIT += " package_ipk debian"

IMAGE_FSTYPE = "ext2.gz"
IMAGE_ROOTFS_SIZE_ext2 = "1024"
IMAGE_ROOTFS_SIZE_ext2.gz = "1024"

SWITCHBOX_DEVICE_TABLE = "${@bb.which(bb.data.getVar('BBPATH', d, 1), 'files/device_table-unslung.txt')}"
EXTRA_IMAGECMD_ext2.gz = "-r 0 -i 512 -f ${SWITCHBOX_DEVICE_TABLE}"

USE_NLS = "no"
```

## conf/distro/ucslugc-packages.conf
```bitbake
SLUGOS_EXTRA_BBFILES = "${UCSLUGC_EXTRA_BBFILES}"
include conf/distro/slugos-packages.conf
```

## conf/distro/ucslugc.conf
```bitbake
#@TYPE: Distribution
#@NAME: UcSlugC
#@DESCRIPTION: UcSlugC Linux Distribution for the NSLU2

DISTRO_NAME = "UcSlugC"
DISTRO_TYPE = "alpha"
IMAGE_BASENAME = "ucslugc"
ARM_INSTRUCTION_SET = "thumb"
IPKG_VARIANT ?= "opkg"
PREFERRED_PROVIDER_opkg ?= "opkg"
PREFERRED_PROVIDER_virtual/update-alternatives ?= "opkg"
IMAGE_INITSCRIPTS ?= "initscripts-slugos"
IMAGE_DEV_MANAGER = "busybox-mdev"

LIBC = "uclibc"

require conf/distro/include/slugos.inc
require conf/distro/include/sane-toolchain.inc
require conf/distro/include/arm-thumb.inc

OVERRIDES .= ":slugos"
```

## conf/distro/unmaintained/gmustix.conf
```bitbake
#@TYPE: Distribution
#@NAME: GMUstix
#@DESCRIPTION: Gumstix distribution for GMU (George Mason University)

INHERIT += "package_tar package_ipk"
TARGET_OS = "linux-uclibc"
TARGET_FPU = "soft"
IMAGE_FSTYPES = "jffs2"

PREFERRED_PROVIDERS += " virtual/${TARGET_PREFIX}gcc-initial:gcc-cross-initial"
PREFERRED_PROVIDERS += " virtual/${TARGET_PREFIX}gcc:gcc-cross"
PREFERRED_PROVIDERS += " virtual/${TARGET_PREFIX}g++:gcc-cross"
PREFERRED_PROVIDERS += " virtual/${TARGET_PREFIX}libc-for-gcc:uclibc"

PREFERRED_PROVIDER_classpath = "classpath-minimal"

PREFERRED_VERSION_gcc-cross-initial = "3.4.4"
PREFERRED_VERSION_gcc-cross = "3.4.4"
PREFERRED_VERSION_gcc-cross-sdk = "3.4.4" 
PREFERRED_VERSION_gcc = "3.4.4"

PREFERRED_VERSION_ipkg-native = "0.99.160"
PREFERRED_VERSION_qemu-native = "0.8.0"

DISTRO_VERSION = "uno"

IPK_EXCLUDE_SOURCE = "1"
```

## conf/distro/unmaintained/mokoslug.conf
```bitbake
#@--------------------------------------------------------------------
#@TYPE: Distribution
#@NAME: MokoSlug <http://www.nslu2-linux.org>
#@DESCRIPTION: The Linux Server companion for OpenMoko phones
#@MAINTAINER: Rod Whitby <rod@whitby.id.au>
#@--------------------------------------------------------------------

# MokoSlug is based on Angstrom, and would hopefully just be done by features one day ...
require conf/distro/angstrom-2007.1.conf

DISTRO = "mokoslug"
DISTRO_NAME = "MokoSlug"
DISTRO_VERSION = "1.0-alpha"
DISTRO_REVISION = "1"
DISTRO_TYPE = "debug"

MACHINE_TASK_PROVIDER = "task-boot dropbear"
MACHINE_TASK_PROVIDER_append_nslu2 = " sysconf"

# Even though the NSLU2 does not have built-in bluetooth,
# we assume that a MokoSlug gateway has a bluetooth dongle.
MACHINE_FEATURES_append_nslu2 = " bluetooth"

# No room for debug apps on an NSLU2.
DEBUG_APPS_nslu2 = ""

# No room for a kernel image on an NSLU2.
IMAGE_PREPROCESS_COMMAND_append_nslu2 = "rm ${IMAGE_ROOTFS}/boot/zImage*;"
```

## conf/distro/unmaintained/nylon.conf
```bitbake
#@TYPE: Distribution
#@NAME: Nylon Linux
#@DESCRIPTION: Distribution configuration for Nylon Mesh Linux distribution

# this distribution is mainly for wireless networking devices and includes
# packages necessary for wireless LAN access point, routing, encryption and 
# especially mesh routing applications
#
# it is primarily aimed at the 4G Systems MeshCube (mtx-1) and other 
# mipsel based platforms
#
# Bruno Randolf <bruno.randolf@4g-systems.biz>

INHERIT += "package_ipk debian nylon-mirrors"
INHERIT += "linux-kernel-base"

PREFERRED_PROVIDERS += " virtual/${TARGET_PREFIX}gcc-initial:gcc-cross-initial"
PREFERRED_PROVIDERS += " virtual/${TARGET_PREFIX}gcc:gcc-cross"
PREFERRED_PROVIDERS += " virtual/${TARGET_PREFIX}g++:gcc-cross"
PREFERRED_PROVIDERS += " virtual/${TARGET_PREFIX}libc-for-gcc:glibc"
PREFERRED_PROVIDERS += " virtual/libx11:diet-x11"
PREFERRED_PROVIDERS += " python:python-curses"
PREFERRED_PROVIDER_classpath = "classpath-minimal"

TARGET_FPU = "soft"

SRCDATE := "20050527"

PREFERRED_VERSION_glibc = "2.3.3"
PREFERRED_VERSION_shorewall = "2.0.9-monolithic"
PREFERRED_VERSION_ppp-dsl = "0.1-monolithic"
PREFERRED_VERSION_mtd-utils = "0.0.0+cvs20060223"
PREFERRED_VERSION_kismet = "2005-01-R1"

PREFERRED_VERSION_gcc-cross-initial = "3.3.4"
PREFERRED_VERSION_gcc-cross = "3.3.4"
PREFERRED_VERSION_gcc-cross-sdk = "3.3.4" 
PREFERRED_VERSION_gcc = "3.3.4"
PREFERRED_VERSION_binutils-cross = "2.14.90.0.7"
PREFERRED_VERSION_binutils-cross-sdk = "2.14.90.0.7"
PREFERRED_VERSION_binutils = "2.16"
PREFERRED_VERSION_linux-libc-headers = "2.6.18"

PREFERRED_VERSION_prism54-firmware = "1.0.3.0"

KERNEL_VERSION_mtx-1 = "2.4.27"
KERNEL_VERSION_mtx-2 = "2.4.27"

#PREFERRED_VERSION_glibc_mtx-3 = "2.3.5+cvs20050627"
PREFERRED_VERSION_gcc-cross-initial_mtx-3 = "3.4.4"
PREFERRED_VERSION_gcc-cross_mtx-3 = "3.4.4"
PREFERRED_VERSION_gcc-cross-sdk_mtx-3 = "3.4.4" 
PREFERRED_VERSION_gcc_mtx-3 = "3.4.4"
### did not compile with:
#PREFERRED_VERSION_binutils-cross_mtx-3 = "2.16.91.0.7"
#PREFERRED_VERSION_binutils-cross-sdk_mtx-3 = "2.16.91.0.7"
### falling back to:
PREFERRED_VERSION_binutils-cross_mtx-3 = "2.15.94.0.1"
PREFERRED_VERSION_binutils-cross-sdk_mtx-3 = "2.15.94.0.1"
PREFERRED_VERSION_binutils_mtx-3 = "2.16"
PREFERRED_VERSION_madwifi-modules = "0.9.3"
PREFERRED_VERSION_madwifi-tools = "0.9.3"

PREFERRED_VERSION_udev = "089"

KERNEL_VERSION_mtx-3 = "2.6.15.4"
PREFERRED_PROVIDER_virtual/kernel_mtx-3a = "linux-mtx-3a"


#PREFERRED_VERSION_glibc_mtx-3a = "2.3.5+cvs20050627"
PREFERRED_VERSION_gcc-cross-initial_mtx-3a = "3.4.4"
PREFERRED_VERSION_gcc-cross_mtx-3a = "3.4.4"
PREFERRED_VERSION_gcc-cross-sdk_mtx-3a = "3.4.4" 
PREFERRED_VERSION_gcc_mtx-3a = "3.4.4"
### did not compile with:
#PREFERRED_VERSION_binutils-cross_mtx-3a = "2.16.91.0.7"
#PREFERRED_VERSION_binutils-cross-sdk_mtx-3a = "2.16.91.0.7"
### falling back to:
PREFERRED_VERSION_binutils-cross_mtx-3a = "2.15.94.0.1"
PREFERRED_VERSION_binutils-cross-sdk_mtx-3a = "2.15.94.0.1"
PREFERRED_VERSION_binutils_mtx-3a = "2.16"

PREFERRED_VERSION_udev = "100"

KERNEL_VERSION_mtx-3a = "2.6.16.6"


# usually overrrided from local.conf
NYLON_RELEASE = "unstable"

# use meshcub.org mirrors for CVS sources
CVS_TARBALL_STASH = "http://meshcube.org/nylon/${NYLON_RELEASE}/sources/"

export FEED_URIS = " \
        nylon##http://meshcube.org/nylon/${NYLON_RELEASE}/feed \
        nylon-bin##http://meshcube.org/nylon/${NYLON_RELEASE}/binary-feed"

# image names
DISTRO_VERSION = "${NYLON_VERSION}"
BUILDNAME := "${NYLON_VERSION}"
#this does not work: ${@base_read_file('${STAGING_DIR}/${HOST_SYS}/kernel/kernel-abiversion')}
IMAGE_NAME = "${IMAGE_BASENAME}-${MACHINE}_${BUILDNAME}"
KERNEL_IMAGE_NAME = "kernel-${KERNEL_VERSION}-${MACHINE}_${BUILDNAME}"
```

## conf/distro/unmaintained/openprotium.conf
```bitbake
#
# Open Iomega distribution - based on openslug and generic confs
# 
DISTRO_NAME = "openprotium"
DISTRO_VERSION = ".dev-snapshot-${SRCDATE}"
DISTRO_TYPE = "alpha"

#
# Naming schemes
#
INHERIT += "debian"

#
# Packaging and output format
#
INHERIT += "package_ipk"
IMAGE_BASENAME = "openprotium"
IMAGE_FSTYPES = "jffs2"
FEED_URIS = "openprotium##http://www.openprotium.org/ipkg.ppc.v1.0"

# For protium on the turbostation
IMAGE_BASENAME_turbostation = "openprotium-ts"

#
# binutils and compilers
#
PREFERRED_PROVIDERS += "virtual/${TARGET_PREFIX}gcc-initial:gcc-cross-initial"
PREFERRED_PROVIDERS += "virtual/${TARGET_PREFIX}gcc:gcc-cross"
PREFERRED_PROVIDERS += "virtual/${TARGET_PREFIX}g++:gcc-cross"
#conflict between this and the last below.
#PREFERRED_PROVIDERS += "virtual/${TARGET_PREFIX}libc-for-gcc:glibc"
# Select 2.6 versions of the depmod support
PREFERRED_PROVIDERS += "virtual/${TARGET_PREFIX}depmod:module-init-tools-cross"
PREFERRED_PROVIDERS += "virtual/${TARGET_PREFIX}libc-for-gcc:glibc-intermediate"

PREFERRED_VERSION_binutils = "2.16"
PREFERRED_VERSION_binutils-cross = "2.16"

PREFERRED_VERSION_gcc = "4.1.1"
PREFERRED_VERSION_gcc-cross = "4.1.1"
PREFERRED_VERSION_gcc-cross-initial = "4.1.1"

PREFERRED_VERSION_glibc = "2.5"
PREFERRED_VERSION_glibc-intermediate = "2.5"
PREFERRED_VERSION_glibc-initial = "2.3.2"

# 
# Target OS & FPU system
#
USE_NLS ?= "no"
TARGET_OS = "linux"
HOTPLUG = "udev"
PREFERRED_PROVIDER_virtual/libiconv = "glibc"
PREFERRED_PROVIDER_virtual/libintl = "glibc"

#
# Bootstrap & Init
#
#PREFERRED_PROVIDER_task-bootstrap = "task-bootstrap"
require conf/distro/include/sane-srcdates.inc
#
#
# Ensure consistency across all SlugOS builds for the provider of a
# relational database - use the latest version of the SleepyCat
# Berkeley database
PREFERRED_PROVIDER_virtual/db = "db"
PREFERRED_PROVIDER_virtual/db-native = "db-native"

CMDLINE_DEBUG = "noirqdebug"
```

## conf/distro/unmaintained/openwrt-sdk.conf
```bitbake
#-----------------------------------------------------------------------------
#@TYPE: Distribution
#@NAME: OpenWRT-SDK
#@DESCRIPTION: Building packages for OpenWRT using its official SDK.
#
#@COMMENT: This allows to build packages only, not the whole images.
#@COMMENT: You should install and have in path an SDK from the www.openwrt.org.
#@COMMENT: SDK installers are both host and target specific (so look in download
#@COMMENT: dir for your target). If there is no SDK for your host arch,
#@COMMENT: you can also look at downloads of x-wrt.org, a sister project.
#@COMMENT: To build a package, use command like:
#@COMMENT: DISTRO=openwrt-sdk TARGET_ARCH=<arch> bitbake <package>
#-----------------------------------------------------------------------------

require conf/distro/generic-uclibc.conf

#
# Header
#
DISTRO_NAME = "OpenWRT"

# This is what lives in SDK
ASSUME_PROVIDED += "virtual/${TARGET_PREFIX}gcc virtual/libc"

# Make sure that we have correct package dependencies for SDK-provided libs.
ASSUME_SHLIBS += "libc.so.0:uclibc libgcc_s.so.1:libgcc"
```

## conf/distro/unmaintained/slugos.conf
```bitbake
#@TYPE: Distribution
#@NAME: SlugOS
#@DESCRIPTION: SlugOS Linux Distribution for the NSLU2

#----------------------------------------------------------------------------------
# STANDARD SlugOS/BE DEFINITIONS
#----------------------------------------------------------------------------------
DISTRO_NAME = "SlugOS"
# DISTRO_VERSION = "${SLUGOS_VERSION}${DISTRO_REVISION}-${DISTRO_TYPE}"
# DISTRO_FEED = "unstable"
DISTRO_TYPE = "beta"
TARGET_ARCH ?= "armeb"
ARM_INSTRUCTION_SET = "arm"
TARGET_OS = "linux"

require conf/distro/include/slugos.inc

# glibc:
PREFERRED_PROVIDER_virtual/libiconv ?= "glibc"
PREFERRED_PROVIDER_virtual/libintl ?= "glibc"
PREFERRED_PROVIDER_virtual/libc ?= "glibc"
PREFERRED_PROVIDER_virtual/${TARGET_PREFIX}libc-initial ?= "glibc-initial"
```

## conf/distro/unmaintained/wrt54oe.conf
```bitbake
#@TYPE: Distribution
#@NAME: WRT54OE Linux
#@DESCRIPTION: Distribution configuration for the WRT54 Linux

# this distribution is mainly for wireless networking devices and includes
# packages necessary for wireless LAN access point, routing, encryption and 
# especially mesh routing applications
#
# it is primarily aimed at the Linksys WRT54G(S) routers and other
# mipsel based platforms supported by OpenWRT (we base on their work)

INHERIT += "package_ipk debian"

TARGET_OS = "linux-uclibc"

PREFERRED_PROVIDERS += " virtual/${TARGET_PREFIX}gcc-initial:gcc-cross-initial"
PREFERRED_PROVIDERS += " virtual/${TARGET_PREFIX}gcc:gcc-cross"
PREFERRED_PROVIDERS += " virtual/${TARGET_PREFIX}g++:gcc-cross"
PREFERRED_PROVIDERS += " virtual/${TARGET_PREFIX}libc-for-gcc:uclibc"

PREFERRED_VERSION_gcc-cross-initial = "3.4.4"
PREFERRED_VERSION_gcc-cross = "3.4.4"
PREFERRED_VERSION_gcc-cross-sdk = "3.4.4" 
PREFERRED_VERSION_gcc = "3.4.4"

IMAGE_NAME = "${IMAGE_BASENAME}-${MACHINE}_${BUILDNAME}"
KERNEL_IMAGE_NAME = "kernel-${KV}-${MACHINE}_${BUILDNAME}"
```

## conf/distro/unslung-binary-kernel.conf
```bitbake
#@TYPE: Distribution
#@NAME: Unslung 
#@DESCRIPTION: Unslung Linux Distribution for the NSLU2

DISTRO_NAME = "Unslung"
DISTRO_VERSION = "6.0-alpha"
DISTRO_TYPE = "beta"

FEED_URIS  = "cross##http://ipkg.nslu2-linux.org/feeds/optware/nslu2/cross/unstable"
FEED_URIS += "native##http://ipkg.nslu2-linux.org/feeds/optware/nslu2/native/unstable"
FEED_URIS += "oe##http://ipkg.nslu2-linux.org/feeds/unslung/modules/cross/unstable"

# pull in the frozen list of bbfiles
UNSLUNG_EXTRA_BBFILES ?= ""
include conf/distro/freeze.conf

TARGET_FPU = "soft"
TARGET_OS = "linux"

FULL_OPTIMIZATION = "-fexpensive-optimizations -fomit-frame-pointer -frename-registers -O2"

INHERIT += " package_ipk nslu2-ramdisk-image"

# The OVERRIDES are modified here so that 'unslung' overrides are picked up if
# present (unslung-binary-kernel overrides take precedence).
NSLU2_BASE_DISTRO = ":unslung"

IMAGE_FSTYPE = "ext2.gz"
UNSLUNG_DEVICE_TABLE = "${@bb.which(bb.data.getVar('BBPATH', d, 1), 'files/device_table-unslung.txt')}"
EXTRA_IMAGECMD_ext2.gz = "-D ${UNSLUNG_DEVICE_TABLE}"
IMAGE_ROOTFS_SIZE_ext2.gz = "14000"

UNSLUNG_EXTRA_DEPENDS  ?= ""
UNSLUNG_EXTRA_RDEPENDS ?= "\
kernel-module-usbnet \
kernel-module-pegasus kernel-module-kaweth \
kernel-module-usbserial \
kernel-module-pl2303 kernel-module-ftdi-sio"

UNSLUNG_EXTRA_INSTALL ?= "${UNSLUNG_EXTRA_RDEPENDS}"

# Select between multiple alternative providers, if more than one is eligible.
PREFERRED_PROVIDERS += " virtual/${TARGET_PREFIX}gcc-initial:gcc-cross-initial"
PREFERRED_PROVIDERS += " virtual/${TARGET_PREFIX}gcc:gcc-cross"
PREFERRED_PROVIDERS += " virtual/${TARGET_PREFIX}g++:gcc-cross"

PREFERRED_VERSION_glibc ?= "2.2.5"
PREFERRED_VERSION_glibc-initial ?= "2.2.5"
PREFERRED_VERSION_binutils ?= "2.15.94.0.1"
PREFERRED_VERSION_binutils-cross ?= "2.15.94.0.1"

PREFERRED_VERSION_unslung-kernel ?= "2.4.22.l2.3r63"
PREFERRED_VERSION_unslung-rootfs         ?= "2.3r63"
PREFERRED_VERSION_nslu2-linksys-firmware ?= "2.3r63"
PREFERRED_VERSION_nslu2-linksys-libs     ?= "2.3r63"
PREFERRED_VERSION_nslu2-linksys-ramdisk  ?= "2.3r63"
```
