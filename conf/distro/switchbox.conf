## conf/machine/adzs-bf548-ezlite.conf
```bitbake
#@TYPE: Machine
#@Name: Analog Devices blackfin platfrom
#@DESCRIPTION: ADSP-BF548 EZ-LITE KIT Board (http://www.analog.com/en/epHSProd/0,,BF548-HARDWARE,00.html)

TARGET_ARCH = "bfin"

KERNEL_IMAGETYPE = "vmlinux"

PREFERRED_PROVIDER_virtual/kernel = "linux-bfin"
PREFERRED_PROVIDER_xserver = "xserver-kdrive"

#don't try to access tty1
USE_VT = "0"

MACHINE_FEATURES = "kernel26 alsa ext2 usbhost usbgadget screen"

# used by sysvinit_2
SERIAL_CONSOLE = "115200"
```

## conf/machine/akita.conf
```bitbake
#@TYPE: Machine
#@NAME: Sharp Zaurus SL-C1000
#@DESCRIPTION: Machine configuration for the Sharp Zaurus SL-C1000 device

require conf/machine/include/zaurus-2.6.inc
require conf/machine/include/zaurus-clamshell.inc

PACKAGE_EXTRA_ARCHS += "iwmmxt" 
MACHINE_FEATURES += "iwmmxt"

# NAND factory-default
# mtdparts=sharpsl-nand:7168k@0k(smf),59392k@7168k(root),-(home) 
ROOT_FLASH_SIZE = "58"

MACHINE_GUI_CLASS = "bigscreen"
MACHINE_DISPLAY_WIDTH_PIXELS = "640"
MACHINE_DISPLAY_HEIGHT_PIXELS = "480"
MACHINE_DISPLAY_ORIENTATION = "270"
MACHINE_DISPLAY_PPI = "216"

UBOOT_MACHINE = "akita_config"
UBOOT_ENTRYPOINT = "0xA1000000"
UBOOT_LOADADDRESS = "${UBOOT_ENTRYPOINT}"
```
