## conf/distro/openzaurus-3.5.2.conf
```bitbake
include conf/distro/openzaurus.conf
DISTRO = "openzaurus"

FEED_URIS += " \
	upgrades##http://openzaurus.org/official/unstable/3.5.2/upgrades/ 	\
	base##http://openzaurus.org/official/unstable/3.5.2/feed/base/		\
	libs##http://openzaurus.org/official/unstable/3.5.2/feed/libs/		\
	console##http://openzaurus.org/official/unstable/3.5.2/feed/console"

CVSDATE = 20041120
ASSUME_PROVIDED = "virtual/arm-linux-gcc-2.95"
PREFERRED_PROVIDERS = "virtual/qte:qte-for-opie virtual/libqpe:libqpe-opie"
PREFERRED_PROVIDERS += " virtual/xserver:xserver-kdrive"
PREFERRED_PROVIDERS += " virtual/libsdl:libsdl-x11"
PREFERRED_PROVIDERS += " gst-plugins:gpe-gst-plugins"
PREFERRED_PROVIDERS += " virtual/${TARGET_PREFIX}gcc-initial:gcc-cross-initial"
PREFERRED_PROVIDERS += " virtual/${TARGET_PREFIX}gcc:gcc-cross"
PREFERRED_PROVIDERS += " virtual/${TARGET_PREFIX}g++:gcc-cross"

OEINCLUDELOGS = "yes"
KERNEL_CONSOLE = "tty1"
TARGET_FPU = "soft"
#DEBUG_OPTIMIZATION = "-O -g3"
#DEBUG_BUILD = "1"
#INHIBIT_PACKAGE_STRIP = "1"

PREFERRED_VERSION_binutils-cross = "2.15.91.0.1"
PREFERRED_VERSION_qte-for-opie = "2.3.7"
PREFERRED_VERSION_orinoco-modules = "0.13e"
PREFERRED_VERSION_glibc = "2.3.2+cvs20040726"
PREFERRED_VERSION_libpng = "1.2.5+1.2.6rc5"
PREFERRED_VERSION_wlan-ng-modules = "0.2.1pre22"
PREFERRED_VERSION_bluez-utils-dbus = "2.11"

#
# Opie
#

OPIE_VERSION = "1.1.7"
PREFERRED_VERSION_libopie2 = "${OPIE_VERSION}"
PREFERRED_VERSION_libopieobex = "${OPIE_VERSION}"
PREFERRED_VERSION_libopietooth = "${OPIE_VERSION}"
PREFERRED_VERSION_libqpe-opie = "${OPIE_VERSION}"
PREFERRED_VERSION_libqtaux2 = "${OPIE_VERSION}"
PREFERRED_VERSION_opie-aboutapplet = "${OPIE_VERSION}"
PREFERRED_VERSION_opie-addressbook = "${OPIE_VERSION}"
PREFERRED_VERSION_opie-advancedfm = "${OPIE_VERSION}"
PREFERRED_VERSION_opie-alarm = "${OPIE_VERSION}"
PREFERRED_VERSION_opie-appearance = "${OPIE_VERSION}"
PREFERRED_VERSION_opie-aqpkg = "${OPIE_VERSION}"
PREFERRED_VERSION_opie-autorotateapplet = "${OPIE_VERSION}"
PREFERRED_VERSION_opie-backgammon = "${OPIE_VERSION}"
PREFERRED_VERSION_opie-backup = "${OPIE_VERSION}"
PREFERRED_VERSION_opie-bartender = "${OPIE_VERSION}"
PREFERRED_VERSION_opie-batteryapplet = "${OPIE_VERSION}"
PREFERRED_VERSION_opie-bluepin = "${OPIE_VERSION}"
PREFERRED_VERSION_opie-bluetoothapplet = "${OPIE_VERSION}"
PREFERRED_VERSION_opie-bluetoothmanager = "${OPIE_VERSION}"
PREFERRED_VERSION_opie-bounce = "${OPIE_VERSION}"
PREFERRED_VERSION_opie-brightnessapplet = "${OPIE_VERSION}"
PREFERRED_VERSION_opie-button-settings = "${OPIE_VERSION}"
PREFERRED_VERSION_opie-buzzword = "${OPIE_VERSION}"
PREFERRED_VERSION_opie-calculator = "${OPIE_VERSION}"
PREFERRED_VERSION_opie-calibrate = "${OPIE_VERSION}"
PREFERRED_VERSION_opie-camera = "1.0.1"
PREFERRED_VERSION_opie-cardmon = "${OPIE_VERSION}"
PREFERRED_VERSION_opie-checkbook = "0.8.0"
PREFERRED_VERSION_opie-citytime = "${OPIE_VERSION}"
PREFERRED_VERSION_opie-clipboardapplet = "${OPIE_VERSION}"
PREFERRED_VERSION_opie-clockapplet = "${OPIE_VERSION}"
PREFERRED_VERSION_opie-clock = "${OPIE_VERSION}"
PREFERRED_VERSION_opie-confeditor = "${OPIE_VERSION}"
PREFERRED_VERSION_opie-console = "${OPIE_VERSION}"
PREFERRED_VERSION_opie-dagger = "${OPIE_VERSION}"
PREFERRED_VERSION_opie-dasher = "${OPIE_VERSION}"
PREFERRED_VERSION_opie-datebook = "${OPIE_VERSION}"
PREFERRED_VERSION_opie-deco-flat = "${OPIE_VERSION}"
PREFERRED_VERSION_opie-deco-liquid = "${OPIE_VERSION}"
PREFERRED_VERSION_opie-deco-polished = "${OPIE_VERSION}"
PREFERRED_VERSION_opie-doctab = "${OPIE_VERSION}"
PREFERRED_VERSION_opie-drawpad = "${OPIE_VERSION}"
PREFERRED_VERSION_opie-dvorak = "${OPIE_VERSION}"
PREFERRED_VERSION_opie-embeddedkonsole = "${OPIE_VERSION}"
PREFERRED_VERSION_opie-euroconv = "${OPIE_VERSION}"
PREFERRED_VERSION_opie-examples-python = "${OPIE_VERSION}"
PREFERRED_VERSION_opie-eye = "${OPIE_VERSION}"
PREFERRED_VERSION_opie-fifteen = "${OPIE_VERSION}"
PREFERRED_VERSION_opie-formatter = "${OPIE_VERSION}"
PREFERRED_VERSION_opie-freetype = "${OPIE_VERSION}"
PREFERRED_VERSION_opie-ftplib = "${OPIE_VERSION}"
PREFERRED_VERSION_opie-ftp = "${OPIE_VERSION}"
PREFERRED_VERSION_opie-go = "${OPIE_VERSION}"
PREFERRED_VERSION_opie-gutenbrowser = "${OPIE_VERSION}"
PREFERRED_VERSION_opie-handwriting = "${OPIE_VERSION}"
PREFERRED_VERSION_opie-helpbrowser = "${OPIE_VERSION}"
PREFERRED_VERSION_opie-help-en = "${OPIE_VERSION}"
PREFERRED_VERSION_opie-homeapplet = "${OPIE_VERSION}"
PREFERRED_VERSION_opie-i18n = "${OPIE_VERSION}"
PREFERRED_VERSION_opie-i18n = "${OPIE_VERSION}"
PREFERRED_VERSION_opie-i18n = "${OPIE_VERSION}"
PREFERRED_VERSION_opie-irc = "${OPIE_VERSION}"
PREFERRED_VERSION_opie-irdaapplet = "${OPIE_VERSION}"
PREFERRED_VERSION_opie-jumpx = "${OPIE_VERSION}"
PREFERRED_VERSION_opie-kbill = "${OPIE_VERSION}"
PREFERRED_VERSION_opie-kcheckers = "${OPIE_VERSION}"
PREFERRED_VERSION_opie-keyboard = "${OPIE_VERSION}"
PREFERRED_VERSION_opie-keypebble = "${OPIE_VERSION}"
PREFERRED_VERSION_opie-keytabs = "${OPIE_VERSION}"
PREFERRED_VERSION_opie-keyview = "${OPIE_VERSION}"
PREFERRED_VERSION_opie-kjumpx = "${OPIE_VERSION}"
PREFERRED_VERSION_opie-kpacman = "${OPIE_VERSION}"
PREFERRED_VERSION_opie-language = "${OPIE_VERSION}"
PREFERRED_VERSION_opie-launcher-settings = "${OPIE_VERSION}"
PREFERRED_VERSION_opie-libqrsync = "${OPIE_VERSION}"
PREFERRED_VERSION_opie-light-and-power = "${OPIE_VERSION}"
PREFERRED_VERSION_opie-login = "${OPIE_VERSION}"
PREFERRED_VERSION_opie-logoutapplet = "${OPIE_VERSION}"
PREFERRED_VERSION_opie-mailapplet = "${OPIE_VERSION}"
PREFERRED_VERSION_opie-mail = "${OPIE_VERSION}"
PREFERRED_VERSION_opie-mediaplayer1-libmadplugin = "${OPIE_VERSION}"
PREFERRED_VERSION_opie-mediaplayer1-libmodplugin = "${OPIE_VERSION}"
PREFERRED_VERSION_opie-mediaplayer1-libtremorplugin = "${OPIE_VERSION}"
PREFERRED_VERSION_opie-mediaplayer1-libwavplugin = "${OPIE_VERSION}"
PREFERRED_VERSION_opie-mediaplayer1 = "${OPIE_VERSION}"
PREFERRED_VERSION_opie-mediaplayer2 = "${OPIE_VERSION}"
PREFERRED_VERSION_opie-mediaplayer2 = "${OPIE_VERSION}"
PREFERRED_VERSION_opie-mediaplayer2 = "${OPIE_VERSION}"
PREFERRED_VERSION_opie-mediaplayer2 = "${OPIE_VERSION}"
PREFERRED_VERSION_opie-mediaplayer2 = "${OPIE_VERSION}"
PREFERRED_VERSION_opie-mediummount = "${OPIE_VERSION}"
PREFERRED_VERSION_opie-memoryapplet = "${OPIE_VERSION}"
PREFERRED_VERSION_opie-mindbreaker = "${OPIE_VERSION}"
PREFERRED_VERSION_opie-minesweep = "${OPIE_VERSION}"
PREFERRED_VERSION_opie-mobilemsg = "${OPIE_VERSION}"
PREFERRED_VERSION_opie-multikeyapplet = "${OPIE_VERSION}"
PREFERRED_VERSION_opie-multikey = "${OPIE_VERSION}"
PREFERRED_VERSION_opie-networkapplet = "${OPIE_VERSION}"
PREFERRED_VERSION_opie-networksettings = "${OPIE_VERSION}"
PREFERRED_VERSION_opie-notesapplet = "${OPIE_VERSION}"
PREFERRED_VERSION_opie-odict = "${OPIE_VERSION}"
PREFERRED_VERSION_opie-osearch = "${OPIE_VERSION}"
PREFERRED_VERSION_opie-oxygen = "1.0.0"
PREFERRED_VERSION_opie-oyatzee = "${OPIE_VERSION}"
# PREFERRED_VERSION_opie-packagemanager = "${OPIE_VERSION}"
PREFERRED_VERSION_opie-parashoot = "${OPIE_VERSION}"
PREFERRED_VERSION_opie-performance = "${OPIE_VERSION}"
PREFERRED_VERSION_opie-pickboard = "${OPIE_VERSION}"
PREFERRED_VERSION_opie-pics = "${OPIE_VERSION}"
PREFERRED_VERSION_opie-pimconverter = "${OPIE_VERSION}"
PREFERRED_VERSION_opie-powerchord = "${OPIE_VERSION}"
PREFERRED_VERSION_opie-pyquicklaunchapplet = "${OPIE_VERSION}"
PREFERRED_VERSION_opie-qasteroids = "${OPIE_VERSION}"
PREFERRED_VERSION_opie-qcop = "1.0.0"
PREFERRED_VERSION_opie-quicklauncher = "${OPIE_VERSION}"
PREFERRED_VERSION_opie-rdesktop = "${OPIE_VERSION}"
PREFERRED_VERSION_opie-reader = "${OPIE_VERSION}"
PREFERRED_VERSION_opie-recorder = "${OPIE_VERSION}"
PREFERRED_VERSION_opie-remote = "${OPIE_VERSION}"
PREFERRED_VERSION_opie-restartapplet2 = "${OPIE_VERSION}"
PREFERRED_VERSION_opie-restartapplet = "${OPIE_VERSION}"
PREFERRED_VERSION_opie-restartapplet = "${OPIE_VERSION}"
PREFERRED_VERSION_opie-rotateapplet = "${OPIE_VERSION}"
PREFERRED_VERSION_opie-screenshotapplet = "${OPIE_VERSION}"
PREFERRED_VERSION_opie-search = "${OPIE_VERSION}"
PREFERRED_VERSION_opie-security = "${OPIE_VERSION}"
PREFERRED_VERSION_opie-securityplugins = "${OPIE_VERSION}"
PREFERRED_VERSION_opie-securityplugins = "${OPIE_VERSION}"
PREFERRED_VERSION_opie-securityplugins = "${OPIE_VERSION}"
PREFERRED_VERSION_opie-securityplugins = "${OPIE_VERSION}"
PREFERRED_VERSION_opie-sfcave = "${OPIE_VERSION}"
PREFERRED_VERSION_opie-sheet = "${OPIE_VERSION}"
PREFERRED_VERSION_opie-sh = "${OPIE_VERSION}"
PREFERRED_VERSION_opie-showimg = "${OPIE_VERSION}"
PREFERRED_VERSION_opie-snake = "${OPIE_VERSION}"
PREFERRED_VERSION_opie-solitaire = "${OPIE_VERSION}"
PREFERRED_VERSION_opie-sshkeys = "${OPIE_VERSION}"
PREFERRED_VERSION_opie-style-flat = "${OPIE_VERSION}"
PREFERRED_VERSION_opie-style-fresh = "${OPIE_VERSION}"
PREFERRED_VERSION_opie-style-liquid = "${OPIE_VERSION}"
PREFERRED_VERSION_opie-style-metal = "${OPIE_VERSION}"
PREFERRED_VERSION_opie-style-phase = "${OPIE_VERSION}"
PREFERRED_VERSION_opie-style-web = "${OPIE_VERSION}"
PREFERRED_VERSION_opie-sounds = "${OPIE_VERSION}"
PREFERRED_VERSION_opie-suspendapplet = "${OPIE_VERSION}"
PREFERRED_VERSION_opie-symlinker = "${OPIE_VERSION}"
PREFERRED_VERSION_opie-sysinfo = "${OPIE_VERSION}"
PREFERRED_VERSION_opie-systemtime = "${OPIE_VERSION}"
PREFERRED_VERSION_opie-tableviewer = "${OPIE_VERSION}"
PREFERRED_VERSION_opie-tabmanager = "${OPIE_VERSION}"
PREFERRED_VERSION_opie-taskbar = "${OPIE_VERSION}"
PREFERRED_VERSION_opie-tetrix = "${OPIE_VERSION}"
PREFERRED_VERSION_opie-textedit = "${OPIE_VERSION}"
PREFERRED_VERSION_opie-theme = "${OPIE_VERSION}"
PREFERRED_VERSION_opie-tictac = "${OPIE_VERSION}"
PREFERRED_VERSION_opie-tinykate = "${OPIE_VERSION}"
PREFERRED_VERSION_opie-today-addressbookplugin = "${OPIE_VERSION}"
PREFERRED_VERSION_opie-today-datebookplugin = "${OPIE_VERSION}"
PREFERRED_VERSION_opie-today-fortuneplugin = "${OPIE_VERSION}"
PREFERRED_VERSION_opie-today-mailplugin = "${OPIE_VERSION}"
PREFERRED_VERSION_opie-today = "${OPIE_VERSION}"
PREFERRED_VERSION_opie-today-stocktickerplugin = "${OPIE_VERSION}"
PREFERRED_VERSION_opie-today-todolistplugin = "${OPIE_VERSION}"
PREFERRED_VERSION_opie-today-weatherplugin = "${OPIE_VERSION}"
PREFERRED_VERSION_opie-todo = "${OPIE_VERSION}"
PREFERRED_VERSION_opie-tonleiter = "${OPIE_VERSION}"
PREFERRED_VERSION_opie-unikeyboard = "${OPIE_VERSION}"
PREFERRED_VERSION_opie-usermanager = "${OPIE_VERSION}"
PREFERRED_VERSION_opie-vmemo = "${OPIE_VERSION}"
PREFERRED_VERSION_opie-vmemo-settings = "${OPIE_VERSION}"
PREFERRED_VERSION_opie-volumeapplet = "${OPIE_VERSION}"
PREFERRED_VERSION_opie-vtapplet = "${OPIE_VERSION}"
PREFERRED_VERSION_opie-wellenreiter = "1.0.3"
PREFERRED_VERSION_opie-wirelessapplet = "${OPIE_VERSION}"
PREFERRED_VERSION_opie-wordgame = "${OPIE_VERSION}"
PREFERRED_VERSION_opie-write = "${OPIE_VERSION}"
PREFERRED_VERSION_opie-zkbapplet = "${OPIE_VERSION}"
PREFERRED_VERSION_opie-zlines = "${OPIE_VERSION}"
PREFERRED_VERSION_opie-zsafe = "${OPIE_VERSION}"
PREFERRED_VERSION_opie-zsame = "${OPIE_VERSION}"

#
# GPE
#

PREFERRED_VERSION_libmatchbox = "1.4"
PREFERRED_VERSION_matchbox = "0.8.1"
PREFERRED_VERSION_matchbox-common = "0.8"
PREFERRED_VERSION_matchbox-desktop = "0.8.1"
PREFERRED_VERSION_matchbox-wm = "0.8.4"
PREFERRED_VERSION_matchbox-panel = "0.8.3"
PREFERRED_VERSION_matchbox-applet-inputmanager = "0.5"
PREFERRED_VERSION_gtk+ = "2.4.13"
PREFERRED_VERSION_libgpewidget = "0.95"
PREFERRED_VERSION_libgpepimc = "0.3"
PREFERRED_VERSION_libgpevtype = "0.5"
PREFERRED_VERSION_libschedule = "0.13"
PREFERRED_VERSION_gpe-icons = "0.24"
PREFERRED_VERSION_libgsm = "1.0.10"
PREFERRED_VERSION_diet-x11 = "6.2.1"
PREFERRED_VERSION_xcursor-transparent-theme = "0.1.1"
PREFERRED_VERSION_rxvt-unicode = "3.7"
PREFERRED_VERSION_gtk2-theme-angelistic = "0.3"
PREFERRED_VERSION_xst = "0.14"
PREFERRED_VERSION_xprop = "0.0cvs${CVSDATE}" 
PREFERRED_VERSION_xhost = "0.0cvs20040413"
PREFERRED_VERSION_xrdb = "0.0cvs${CVSDATE}"
PREFERRED_VERSION_gpe-login = "0.73"
PREFERRED_VERSION_gpe-session-scripts = "0.62"
PREFERRED_VERSION_gpe-soundserver = "0.4-1"
PREFERRED_VERSION_gpe-todo = "0.50"
PREFERRED_VERSION_gpe-calendar = "0.58"
PREFERRED_VERSION_gpe-sketchbox = "0.2.8"
PREFERRED_VERSION_gpe-contacts = "0.33"
PREFERRED_VERSION_gpe-today = "0.08"
PREFERRED_VERSION_matchbox-panel-manager = "0.1"
PREFERRED_VERSION_dbus = "0.22"
PREFERRED_VERSION_gpe-bluetooth = "0.37"
PREFERRED_VERSION_gpe-su = "0.18"
PREFERRED_VERSION_gpe-conf = "0.1.21"
PREFERRED_VERSION_gpe-clock = "0.14"
PREFERRED_VERSION_gpe-mininet = "0.4"
PREFERRED_VERSION_gpe-mixer = "0.38"
PREFERRED_VERSION_gpe-shield = "0.6"
PREFERRED_VERSION_gpe-wlancfg = "0.2.6"
PREFERRED_VERSION_gpe-taskmanager = "0.17"
PREFERRED_VERSION_keylaunch = "2.0.7"
PREFERRED_VERSION_minilite = "0.44"
PREFERRED_VERSION_xmonobut = "0.4"
PREFERRED_VERSION_gpe-edit = "0.28"
PREFERRED_VERSION_gpe-gallery = "0.95"
PREFERRED_VERSION_gpe-calculator = "0.2"
PREFERRED_VERSION_gpe-package = "0.0.12"
PREFERRED_VERSION_gpe-soundbite = "1.0.5"
PREFERRED_VERSION_gpe-terminal = "1.1"
PREFERRED_VERSION_gpe-watch = "0.10"
PREFERRED_VERSION_gpe-what = "0.31"
PREFERRED_VERSION_gpe-filemanager = "0.20"
PREFERRED_VERSION_gpe-go = "0.05"
PREFERRED_VERSION_gpe-irc = "0.07"
PREFERRED_VERSION_gpe-lights = "0.12"
PREFERRED_VERSION_gpe-nmf = "0.19"
PREFERRED_VERSION_gpe-othello = "0.2-1"
PREFERRED_VERSION_gpe-plucker = "0.1"
PREFERRED_VERSION_gpe-tetris = "0.6-2"
PREFERRED_VERSION_gsoko = "0.4.2-gpe5"
PREFERRED_VERSION_xdemineur = "2.1.1"
PREFERRED_VERSION_matchbox-panel-hacks = "0.3-1"
PREFERRED_VERSION_rosetta = "0.0cvs${CVSDATE}"
PREFERRED_VERSION_dillo2 = "0.6.6"
PREFERRED_VERSION_minimo = "0.0cvs${CVSDATE}"
PREFERRED_VERSION_linphone-hh = "0.12.2.hh1"
PREFERRED_VERSION_linphone = "0.12.2"
PREFERRED_VERSION_firefox = "1.0"
```

## conf/distro/openzaurus-3.5.3.conf
```bitbake
include conf/distro/openzaurus.conf
DISTRO = "openzaurus"
DISTRO_NAME = "OpenZaurus"
DISTRO_VERSION = "3.5.3"
DISTRO_TYPE = "release"

FEED_URIS += " \
	upgrades##http://openzaurus.org/official/unstable/3.5.3/upgrades/ 	\
	base##http://openzaurus.org/official/unstable/3.5.3/feed/base/		\
	libs##http://openzaurus.org/official/unstable/3.5.3/feed/libs/		\
	console##http://openzaurus.org/official/unstable/3.5.3/feed/console     \
	devel##http://openzaurus.org/official/unstable/3.5.3/feed/devel"

CVSDATE = "20050403"

#
# Zaurus
#

ASSUME_PROVIDED += "virtual/arm-linux-gcc-2.95"
OEINCLUDELOGS = "yes"
KERNEL_CONSOLE = "ttyS0"
#DEBUG_OPTIMIZATION = "-O -g3"
#DEBUG_BUILD = "1"
#INHIBIT_PACKAGE_STRIP = "1"

#
# Base
#

PREFERRED_VERSION_binutils-cross = "2.15.94.0.1"
PREFERRED_VERSION_ipkg-native = "0.99.144"
PREFERRED_PROVIDERS += " virtual/${TARGET_PREFIX}gcc-initial:gcc-cross-initial"
PREFERRED_PROVIDERS += " virtual/${TARGET_PREFIX}gcc:gcc-cross"
PREFERRED_PROVIDERS += " virtual/${TARGET_PREFIX}g++:gcc-cross"

#
# Opie
#

PREFERRED_PROVIDERS += " virtual/libqpe:libqpe-opie"

OPIE_VERSION = "1.2.0"
include conf/distro/preferred-opie-versions.inc

#
# GPE
#

PREFERRED_PROVIDERS += "virtual/xserver:xserver-kdrive"
PREFERRED_PROVIDERS += "virtual/gconf:gconf-dbus"
GPE_EXTRA_INSTALL += " gsoko"

include conf/distro/preferred-gpe-versions.inc
```
