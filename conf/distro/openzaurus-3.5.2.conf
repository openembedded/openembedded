## conf/distro/slugosbe.conf
```bitbake
#@TYPE: Distribution
#@NAME: SlugOS/BE
#@DESCRIPTION: SlugOS/BE Linux Distribution for the NSLU2

#----------------------------------------------------------------------------------
# STANDARD SlugOS/BE DEFINITIONS
#----------------------------------------------------------------------------------
DISTRO_NAME = "SlugOS/BE"
# DISTRO_VERSION = "${SLUGOS_VERSION}${DISTRO_REVISION}-${DISTRO_TYPE}"
# DISTRO_FEED = "unstable"
DISTRO_TYPE = "beta"
SLUGOS_DISTRO ?= "slugosbe"

TARGET_ARCH = "armeb"
ARM_INSTRUCTION_SET = "arm"
TARGET_OS = "linux"

#----------------------------------------------------------------------------------
# FIRMWARE CONFIGURATION
#----------------------------------------------------------------------------------
# EXTRA PACKAGES
# --------------
# Filesystem support modules are listed in here for easy removal,
# as is the lrzsz serial package and other kernel modules which are
# not absolutely required for boot.
# NOTE: only jffs2 support is an absolute requirement of boot, even
# the ext2/ext3 support is optional!
SLUGOSBE_EXT2_PROGS =  "e2fsprogs-mke2fs e2fsprogs-fsck e2fsprogs-e2fsck e2fsprogs-badblocks"

# The standard firmware contents and additional packages built as requirements
# of the firmware are defined here in SLUGOSBE_STANDARD_RDEPENDS and
# SLUGOSBE_STANDARD_DEPENDS respectively.
SLUGOSBE_STANDARD_RDEPENDS = ""

# Support for a variety of file systems is built in to the slugosbe
# image, programs to format disks with these file systems may be
# added or removed.  By default ext2 and ext3 support
# is included by the following lines.
# 
# These lines add support for formatting ext2 and ext3 file systems
# on a hard disk attached to the NSLU2.  ext3 is the standard Linux
# file system.
SLUGOSBE_STANDARD_RDEPENDS += "${SLUGOSBE_EXT2_PROGS}"

# These lines add support for an X/Y/ZModem package called lrzsz
# (this is of use for people with modified NSLU2 hardware which
# supports a serial port.)
SLUGOSBE_STANDARD_RDEPENDS += "lrzsz"

# Filesystem selection.  Adding entries here adds the module to the
# image.  The module must be built as part of nslu2-kernel (i.e. it
# must be specified as a module in the defconfig file).  The NLS
# support charset modules must be given explicitly and must match
# the codepage/iocharset and NLS handling for the file systems which
# require them.  The installed lanugage set is minimal but sufficient
# for any file system (since it uses utf8).  See
# http://www.nslu2-linux.orgwiki/HowTo/MountFATFileSystems
# for more information on the language behaviour of the DOS file
# systems.
#
# KERNEL LEVEL FILE SYSTEM SUPPORT
# --------------------------------
# NOTE: removing kernel-module-nfs from this list will prevent NFS
# boot (however you can do a simple flash file system boot - no
# attached disk - and install the nfs modules from ssh.)
SLUGOSBE_STANDARD_RDEPENDS += "\
kernel-module-ext2 \
kernel-module-jbd \
kernel-module-ext3 \
kernel-module-vfat \
kernel-module-ntfs \
kernel-module-isofs \
kernel-module-udf \
kernel-module-nls-cp437 \
kernel-module-nls-utf8 \
"

# Add daemon required for HW RNG support
SLUGOSBE_STANDARD_RDEPENDS += "\
rng-tools \
"

# Add modules required for usb support
SLUGOSBE_STANDARD_RDEPENDS += "\
kernel-module-ohci-hcd \
kernel-module-uhci-hcd \
"

# Add modules required for IDE support
SLUGOSBE_STANDARD_RDEPENDS += "\
kernel-module-libata \
kernel-module-pata-artop \
"

# Add modules required for Network support
SLUGOSBE_STANDARD_RDEPENDS += "\
kernel-module-via-velocity \
"

# This documents other file systems which are built but not installed
# by default in the flash image.
#
# kernel-module-msdos - mounts a FAT file system without long file names
#                       (use kernel-module-vfat, it shows the long names
#                       if present.)

# The 'standard' values are the defaults for the 'extra' packages added
# to the firmware image.  None of these things are requirements to have
# a bootable, useable, system however they *are* expected to be present
# in SlugOS/BE - see nslu2-bag for a more minimal configuration and some
# more instructions about how to make a non-slugosbe image.
SLUGOSBE_EXTRA_RDEPENDS ?= ""
SLUGOS_EXTRA_RDEPENDS = "${SLUGOSBE_STANDARD_RDEPENDS} ${SLUGOSBE_EXTRA_RDEPENDS}"

require conf/distro/include/slugos.inc
```
