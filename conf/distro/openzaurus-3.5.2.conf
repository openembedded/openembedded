## conf/distro/openzaurus-3.5.4.1.conf
```bitbake
DISTRO_VERSION = "3.5.4.1"

include conf/distro/openzaurus-3.5.4.conf

# avoid "/" on end to avoid #1102
FEED_BASE_URI = "http://ewi546.ewi.utwente.nl/mirror/www.openzaurus.org/official/unstable/3.5.4.1"

FEED_URIS ?= " \
        upgrades##${FEED_BASE_URI}/feed/upgrades \
machine-upgrades##${FEED_BASE_URI}/feed/upgrades/machine/${MACHINE} \
         machine##${FEED_BASE_URI}/feed/machine/${MACHINE} \
            perl##${FEED_BASE_URI}/feed/perl \
          python##${FEED_BASE_URI}/feed/python \
            base##${FEED_BASE_URI}/feed/base "

CVSDATE_zaurusd = "20060916"

ENABLE_BINARY_LOCALE_GENERATION = "1"

PREFERRED_PROVIDER_hostap-conf = "hostap-conf"

# select kernel version for the zaurus family

MACHINE_KERNEL_VERSION_poodle = "2.4" 
MACHINE_KERNEL_VERSION_collie = "2.4"
MACHINE_KERNEL_VERSION_c7x0   = "2.6"
MACHINE_KERNEL_VERSION_spitz  = "2.6"
MACHINE_KERNEL_VERSION_akita  = "2.6"
MACHINE_KERNEL_VERSION_borzoi = "2.6"
MACHINE_KERNEL_VERSION_tosa   = "2.4" 

PREFERRED_VERSION_hostap-modules = "0.4.7"
PREFERRED_VERSION_poppler = "0.5.1"
PREFERRED_VERSION_evince  = "0.5.2"
PREFERRED_VERSION_altboot = "1.0.7"
# some GPE updates

PREFERRED_VERSION_gpe-bluetooth ?= "0.53"
PREFERRED_VERSION_libcontactsdb ?= "0.4"
PREFERRED_VERSION_gpe-irc ?= "0.08"

include conf/distro/preferred-gpe-versions-2.7.inc

PREFERRED_VERSION_dbus = "0.92"
PREFERRED_VERSION_dbus-glib = "0.71"
PREFERRED_VERSION_gpe-beam = "0.2.9"
```

## conf/distro/openzaurus-3.5.4.2.conf
```bitbake
#
# this is copy of 3.5.4.1
#

DISTRO_VERSION = "3.5.4.2-rc2"

include conf/distro/openzaurus-3.5.4.conf

# avoid "/" on end to avoid #1102
FEED_BASE_URI = "http://feeds.openzaurus.org/3.5.4.1"
FEED_BASE_URI_3542 = "http://feeds.openzaurus.org/3.5.4.1"

FEED_BASE_URI_3542_poodle = "http://feeds.openzaurus.org/3.5.4.2"
FEED_BASE_URI_3542_tosa = "http://feeds.openzaurus.org/3.5.4.2"
#
# OZ 3.5.4.2 will use feeds from 3.5.4.1
# only machine related stuff will be in 3.5.4.2 feed/ dir
# machine upgrades in 3.5.4.2/feed/
# normal upgrades in 3.5.4.1/feed/
#

FEED_URIS ?= " \
        upgrades##${FEED_BASE_URI}/feed/upgrades \
machine-upgrades##${FEED_BASE_URI_3542}/feed/upgrades/machine/${MACHINE} \
         machine##${FEED_BASE_URI_3542}/feed/machine/${MACHINE} \
            perl##${FEED_BASE_URI}/feed/perl \
          python##${FEED_BASE_URI}/feed/python \
            base##${FEED_BASE_URI}/feed/base "

CVSDATE_zaurusd = "20060916"
CVSDATE_gnome-vfs-dbus = "20060119"
CVSDATE_fluxbox = "20061020"

ENABLE_BINARY_LOCALE_GENERATION ?= "1"

PREFERRED_PROVIDER_hostap-conf = "hostap-conf"

#
# OpenZaurus 3.5.4.2 will be released for collie, poodle and tosa
# and will use 2.6.17 (or later) kernel
#
# ofcourse anyone can build 3.5.4.2 for other machines
# but those would be unofficial builds
#

MACHINE_KERNEL_VERSION = "2.6" 

PREFERRED_VERSION_linux-openzaurus = "2.6.17"
PREFERRED_VERSION_hostap-modules = "0.4.7"
PREFERRED_VERSION_poppler = "0.5.1"
PREFERRED_VERSION_evince  = "0.5.2"
PREFERRED_VERSION_altboot = "1.1.0"

# GPE versions

include conf/distro/preferred-gpe-versions-2.8.inc
```

## conf/distro/openzaurus-3.5.4.conf
```bitbake
DISTRO = "openzaurus"
DISTRO_NAME = "OpenZaurus"
DISTRO_VERSION = "3.5.4"

include conf/distro/openzaurus.conf

DISTRO_TYPE = "release"
CVSDATE = "20060102"



#
# Zaurus
#

ASSUME_PROVIDED += "virtual/arm-linux-gcc-2.95"
OEINCLUDELOGS = "yes"
KERNEL_CONSOLE = "ttyS0"
#DEBUG_OPTIMIZATION = "-O -g3"
#DEBUG_BUILD = "1"
#INHIBIT_PACKAGE_STRIP = "1"

# enable progressbar on c7x0 like we had in OZ 3.5.3
OZ_KERNEL_ENABLE_ELPP="yes"

PREFERRED_VERSION_ipkg = "0.99.159"

PREFERRED_VERSION_gcc = "3.4.4"
PREFERRED_VERSION_gcc-cross = "3.4.4"
PREFERRED_VERSION_gcc-cross-initial = "3.4.4"
PREFERRED_VERSION_binutils = "2.15.94.0.1"
PREFERRED_VERSION_binutils-cross = "2.15.94.0.1"

PREFERRED_VERSION_hostap-modules = "0.3.9"

#fix some iconv issues, needs to be adjusted when doing uclibc builds
PREFERRED_PROVIDER_virtual/libiconv=glibc
PREFERRED_PROVIDER_virtual/libintl=glibc


#
# Base
#
PREFERRED_PROVIDERS += " virtual/${TARGET_PREFIX}gcc-initial:gcc-cross-initial"
PREFERRED_PROVIDERS += " virtual/${TARGET_PREFIX}gcc:gcc-cross"
PREFERRED_PROVIDERS += " virtual/${TARGET_PREFIX}g++:gcc-cross"
PREFERRED_PROVIDERS += " virtual/arm-linux-libc-for-gcc:glibc"

#Set some default providers where multiple exist
PREFERRED_PROVIDERS += " tslib:tslib"

#
# Opie
#
PREFERRED_PROVIDERS += " virtual/libqpe:libqpe-opie"

OPIE_VERSION = "1.2.1"
include conf/distro/preferred-opie-versions.inc

#
# GPE
#
PREFERRED_PROVIDERS += "virtual/xserver:xserver-kdrive"
PREFERRED_PROVIDERS += "virtual/gconf:gconf-dbus"
PREFERRED_PROVIDER_gnome-vfs=gnome-vfs-dbus
PREFERRED_PROVIDER_x11 = "diet-x11"
PREFERRED_PROVIDER_libgpewidget = "libgpewidget"

include conf/distro/preferred-gpe-versions-2.7.inc

#
# E
#
include conf/distro/preferred-e-versions.inc

# put images into dirs from where we can copy them easier
DEPLOY_DIR_IMAGE = "${DEPLOY_DIR}/images/${DISTRO_VERSION}/${MACHINE}"
```

## conf/distro/openzaurus-3.5.5.conf
```bitbake
#
# This is config for last version of OpenZaurus distribution.
# We (Hrw & XorA) decided to release 3.5.5 from .dev tree because .oz354x
# is just too old so with such small devteam we are unable to backport all
# needed fixes.
#
# This config need some love. It was created from current OpenZaurus config,
# Ångström config and UmbaUmba 17.3 config.

DISTRO_VERSION = "3.5.5-test0"

TEST1 := "$bb.fatal('this config need love')"

require conf/distro/include/openzaurus.inc
require conf/distro/include/sane-srcdates.inc

#
# Base
#
PREFERRED_PROVIDERS += " virtual/${TARGET_PREFIX}gcc-initial:gcc-cross-initial"
PREFERRED_PROVIDERS += " virtual/${TARGET_PREFIX}gcc:gcc-cross"
PREFERRED_PROVIDERS += " virtual/${TARGET_PREFIX}g++:gcc-cross"

PREFERRED_VERSION_binutils-cross-sdk = "2.16"
PREFERRED_VERSION_binutils-cross = "2.16"
PREFERRED_VERSION_binutils = "2.16"

PREFERRED_VERSION_glibc = "2.3.5+cvs20050627"
PREFERRED_VERSION_gcc = "3.4.4"
PREFERRED_VERSION_gcc-cross = "3.4.4"
PREFERRED_VERSION_gcc-cross-sdk = "3.4.4"
PREFERRED_VERSION_gcc-cross-initial = "3.4.4"

# Glibc provides iconv and intl -- adjust, when doing uclibc builds
PREFERRED_PROVIDER_virtual/libiconv = "glibc"
PREFERRED_PROVIDER_virtual/libintl = "glibc"

#
# Feeds
#
# avoid "/" on end to avoid #1102
FEED_BASE_URI = "http://feeds.openzaurus.org/3.5.5"

FEED_URIS ?= " \
        upgrades##${FEED_BASE_URI}/feed/upgrades \
machine-upgrades##${FEED_BASE_URI}/feed/upgrades/machine/${MACHINE} \
         machine##${FEED_BASE_URI}/feed/machine/${MACHINE} \
            perl##${FEED_BASE_URI}/feed/perl \
          python##${FEED_BASE_URI}/feed/python \
            base##${FEED_BASE_URI}/feed/base "

ENABLE_BINARY_LOCALE_GENERATION = "1"

#
# All machines will get 2.6 kernel (except collie of course)
#
MACHINE_KERNEL_VERSION = "2.6" 
MACHINE_KERNEL_VERSION_collie = "2.4" 

#
# We use 2.6.20 kernel
#
PREFERRED_VERSION_linux-rp = "2.6.20"

#
# Toshiba USB Host driver is not updated so tosa == 2.6.17
#
PREFERRED_VERSION_linux-rp_tosa = "2.6.17"


PREFERRED_VERSION_altboot = "1.0.8"

# GPE
require conf/distro/include/preferred-gpe-versions-2.8.inc

PREFERRED_PROVIDER_dbus-glib         = "dbus-glib"
PREFERRED_PROVIDER_virtual/libsdl   ?= "libsdl-x11"
PREFERRED_PROVIDER_virtual/libxine  ?= "libxine-x11"
PREFERRED_PROVIDER_esound           ?= "pulseaudio"


PREFERRED_VERSION_fontconfig        = "2.4.1"
PREFERRED_VERSION_freetype          = "2.2.1"
PREFERRED_VERSION_freetype-native   = "2.2.1"
#fix screen corruption issues
PREFERRED_VERSION_cairo = "1.3.12"

PREFERRED_PROVIDER_virtual/xserver = "xserver-kdrive"
PREFERRED_PROVIDER_xserver         = "xserver-kdrive"

require conf/distro/include/preferred-xorg-versions-X11R7.1.inc

PREFERRED_VERSION_xserver-kdrive = "X11R7.1-1.1.0"

#
# 2.6.10 was used in previous release so will be compatible
#
PREFERRED_VERSION_gtk+ = "2.6.10"

#zap extra stuff taking place in $MACHINE.conf 
GPE_EXTRA_INSTALL = ""

# Virtuals:
PREFERRED_PROVIDER_virtual/db ?= "db"
PREFERRED_PROVIDER_virtual/db-native ?= "db-native"

TEST2 := "$bb.fatal('this config need love')"

# Others:
PREFERRED_PROVIDER_virtual/libx11 ?= "diet-x11"
PREFERRED_PROVIDER_gconf ?= "gconf-dbus"
PREFERRED_PROVIDER_gnome-vfs ?= "gnome-vfs"
PREFERRED_PROVIDER_gnome-vfs-plugin-file ?= "gnome-vfs"
PREFERRED_PROVIDER_tslib ?= "tslib"
PREFERRED_PROVIDER_tslib-conf ?= "tslib"
PREFERRED_PROVIDER_libgpewidget ?= "libgpewidget"
TEST4 := "$bb.fatal('this config need love')"
PREFERRED_PROVIDER_ntp = "ntp"
PREFERRED_PROVIDER_hotplug = "udev"
PREFERRED_PROVIDER_libxss = "libxss"

#
# busybox 1.2.1 was known as working - feel free to update
#
PREFERRED_VERSION_busybox = "1.2.1"

#
# Die pcmcia-cs, DIE!
#
PCMCIA_MANAGER = "pcmciautils"

PREFERRED_VERSION_dbus ?= "1.0.2"
PREFERRED_VERSION_dbus-glib ?= "0.71"

PREFERRED_VERSION_gstreamer ?= "0.10.11"

PREFERRED_PROVIDER_hostap-conf ?= "hostap-conf"

PREFERRED_VERSION_wpa-supplicant = "0.5.7"
PREFERRED_VERSION_hostap-utils ?= "0.4.7"
PREFERRED_VERSION_hostap-modules ?= "0.4.7"

#
# We do not use qte-mt to keep compatibility with older OZ
#
PALMTOP_USE_MULTITHREADED_QT = "no"
OPIE_VERSION = "1.2.2"

require conf/distro/include/preferred-opie-versions.inc
TEST3 := "$bb.fatal('this config need love')"
```

## conf/distro/openzaurus-unstable-uclibc.conf
```bitbake
require conf/distro/openzaurus-unstable.conf

TARGET_OS = "linux-uclibc"
PREFERRED_PROVIDER_virtual/libiconv = "libiconv"
PREFERRED_PROVIDER_virtual/libintl = "libintl"
PREFERRED_PROVIDER_hostap-modules = "hostap-modules"

# NOTE: you have to rename your 2.95 gcc and 2.11.2 ld
ASSUME_PROVIDED += "virtual/arm-linux-uclibc-gcc-2.95"
```

## conf/distro/openzaurus.conf
```bitbake
#@TYPE: Distribution
#@NAME: OpenZaurus
#@DESCRIPTION: Distribution configuration for OpenZaurus (http://www.openzaurus.org)

INHERIT += " package_ipk debian"
# For some reason, this doesn't work
# TARGET_OS ?= "linux"
TARGET_OS = "linux"
TARGET_FPU = "soft"

BOOTSTRAP_EXTRA_DEPENDS  += "openzaurus-version"
BOOTSTRAP_EXTRA_RDEPENDS += "openzaurus-version"
IMAGE_NAME = "${IMAGE_BASENAME}-${DISTRO_VERSION}-${MACHINE}"

PARALLEL_INSTALL_MODULES = "1"

DISTRO_CHECK := "${@bb.data.getVar("DISTRO_VERSION",d,1) or bb.fatal('You are trying to build unsupported OpenZaurus version.')}"

# Ethernet modules
BOOTSTRAP_EXTRA_RRECOMMENDS += "kernel-module-pcnet-cs"

# NFS Modules
BOOTSTRAP_EXTRA_RRECOMMENDS += "kernel-module-nfs kernel-module-lockd kernel-module-sunrpc"

# Crypto Modules
BOOTSTRAP_EXTRA_RRECOMMENDS += "kernel-module-des kernel-module-md5"

# SMB and CRAMFS
BOOTSTRAP_EXTRA_RRECOMMENDS += "kernel-module-smbfs kernel-module-cramfs"

# Serial Modules
BOOTSTRAP_EXTRA_RRECOMMENDS += "kernel-module-8250 kernel-module-serial-cs"

# Bluetooth Modules
BOOTSTRAP_EXTRA_RRECOMMENDS += "kernel-module-bluetooth kernel-module-l2cap kernel-module-rfcomm kernel-module-hci-vhci \
                             kernel-module-bnep kernel-module-hidp kernel-module-hci-uart kernel-module-sco \
                             kernel-module-bt3c-cs kernel-module-bluecard-cs kernel-module-btuart-cs kernel-module-dtl1-cs"

# Infrared Modules
BOOTSTRAP_EXTRA_RRECOMMENDS += "kernel-module-pxaficp-ir kernel-module-irda kernel-module-ircomm \
                             kernel-module-ircomm-tty kernel-module-irlan kernel-module-irnet"

# USB Gadget Modules
BOOTSTRAP_EXTRA_RRECOMMENDS += "kernel-module-gadgetfs kernel-module-g-file-storage \
                             kernel-module-g-serial kernel-module-g-ether"

# Wireless Modules
BOOTSTRAP_EXTRA_RRECOMMENDS += "kernel-module-hostap kernel-module-hostap-cs \
                             kernel-module-hermes kernel-module-orinoco \
                             kernel-module-orinoco-cs kernel-module-spectrum-cs \
                             kernel-module-ieee80211-crypt kernel-module-ieee80211-crypt-ccmp \
                             kernel-module-ieee80211-crypt-tkip kernel-module-ieee80211-crypt-wep \
                             kernel-module-arc4 kernel-module-michael-mic kernel-module-aes"

# Sound Modules
BOOTSTRAP_EXTRA_RRECOMMENDS += "kernel-module-snd-mixer-oss kernel-module-snd-pcm-oss"
BOOTSTRAP_EXTRA_RRECOMMENDS += "kernel-module-soundcore kernel-module-snd kernel-module-snd-page-alloc \
                             kernel-module-snd-timer kernel-module-snd-pcm  \
                             kernel-module-snd-soc-core kernel-module-snd-soc-pxa2xx \
                             kernel-module-snd-soc-pxa2xx-i2s"

# USB Host modules

USBHOST_MODULES = "kernel-module-ohci-hcd kernel-module-usbcore kernel-module-usbhid \
                   kernel-module-usbnet kernel-module-sd-mod kernel-module-scsi-mod \
                   kernel-module-usbmouse kernel-module-mousedev kernel-module-hci-usb \
                   kernel-module-usbserial kernel-module-usb-storage kernel-module-ir-usb"

BOOTSTRAP_EXTRA_RRECOMMENDS_append_spitz += " ${USBHOST_MODULES} "
BOOTSTRAP_EXTRA_RRECOMMENDS_append_akita += " ${USBHOST_MODULES} "
BOOTSTRAP_EXTRA_RRECOMMENDS_append_tosa  += " ${USBHOST_MODULES} "

# add WiFi card config for ALL machines

BOOTSTRAP_EXTRA_RDEPENDS += "hostap-conf orinoco-conf oz-bootsplash"
BOOTSTRAP_EXTRA_RDEPENDS_append_akita = " usbutils "
BOOTSTRAP_EXTRA_RDEPENDS_append_spitz = " usbutils "
BOOTSTRAP_EXTRA_RDEPENDS_append_tosa  = " usbutils "

BOOTSTRAP_EXTRA_DEPENDS += "hostap-conf orinoco-conf oz-bootsplash"
BOOTSTRAP_EXTRA_DEPENDS_append_akita = " usbutils "
BOOTSTRAP_EXTRA_DEPENDS_append_spitz = " usbutils "
BOOTSTRAP_EXTRA_DEPENDS_append_tosa  = " usbutils "

BB_MIN_VERSION = "1.4.4"
INHERIT += "sanity"

CVS_TARBALL_STASH = "\
http://ewi546.ewi.utwente.nl/mirror/www.openzaurus.org/official/unstable/3.5.4/sources/ \
http://www.oesources.org/source/current/"
```
