## conf/distro/preferred-opie-cvs-versions.inc
```bitbake
#
# Default versions
QTE_VERSION ?= "2.3.10"
# OPIE_VERSION ?= "1.2.2"
PALMTOP_USE_MULTITHREADED_QT ?= "yes"

#
#
# Opie libraries
#
PREFERRED_PROVIDER_virtual/libqte2 ?= '${@base_conditional("PALMTOP_USE_MULTITHREADED_QT", "yes", "qte-mt", "qte", d)}'
PREFERRED_PROVIDER_virtual/libqpe1 ?= "libqpe-opie"
PREFERRED_VERSION_qte-mt ?= "${QTE_VERSION}"
PREFERRED_VERSION_qte ?= "${QTE_VERSION}"
SRCDATE_libopie2 ?= "${OPIE_VERSION}"
SRCDATE_libopieobex0 ?= "${OPIE_VERSION}"
SRCDATE_libopietooth1 ?= "${OPIE_VERSION}"
SRCDATE_libqpe-opie ?= "${OPIE_VERSION}"
SRCDATE_libqtaux2 ?= "${OPIE_VERSION}"
SRCDATE_libmailwrapper ?= "${OPIE_VERSION}"
#
# Opie applications
#
SRCDATE_opie-aboutapplet ?= "${OPIE_VERSION}"
SRCDATE_opie-addressbook ?= "${OPIE_VERSION}"
SRCDATE_opie-advancedfm ?= "${OPIE_VERSION}"
SRCDATE_opie-alarm ?= "${OPIE_VERSION}"
SRCDATE_opie-appearance ?= "${OPIE_VERSION}"
SRCDATE_opie-aqpkg ?= "${OPIE_VERSION}"
SRCDATE_opie-autorotateapplet ?= "${OPIE_VERSION}"
SRCDATE_opie-backgammon ?= "${OPIE_VERSION}"
SRCDATE_opie-backup ?= "${OPIE_VERSION}"
SRCDATE_opie-bartender ?= "${OPIE_VERSION}"
SRCDATE_opie-batteryapplet ?= "${OPIE_VERSION}"
SRCDATE_opie-bluepin ?= "${OPIE_VERSION}"
SRCDATE_opie-bluetoothapplet ?= "${OPIE_VERSION}"
SRCDATE_opie-bluetoothmanager ?= "${OPIE_VERSION}"
SRCDATE_opie-bounce ?= "${OPIE_VERSION}"
SRCDATE_opie-brightnessapplet ?= "${OPIE_VERSION}"
SRCDATE_opie-button-settings ?= "${OPIE_VERSION}"
SRCDATE_opie-buzzword ?= "${OPIE_VERSION}"
SRCDATE_opie-calculator ?= "${OPIE_VERSION}"
SRCDATE_opie-calibrate ?= "${OPIE_VERSION}"
SRCDATE_opie-camera ?= "${OPIE_VERSION}"
SRCDATE_opie-cardmon ?= "${OPIE_VERSION}"
SRCDATE_opie-checkbook ?= "${OPIE_VERSION}"
SRCDATE_opie-citytime ?= "${OPIE_VERSION}"
SRCDATE_opie-clipboardapplet ?= "${OPIE_VERSION}"
SRCDATE_opie-clockapplet ?= "${OPIE_VERSION}"
SRCDATE_opie-clock ?= "${OPIE_VERSION}"
SRCDATE_opie-confeditor ?= "${OPIE_VERSION}"
SRCDATE_opie-console ?= "${OPIE_VERSION}"
SRCDATE_opie-dagger ?= "${OPIE_VERSION}"
SRCDATE_opie-dasher ?= "${OPIE_VERSION}"
SRCDATE_opie-datebook ?= "${OPIE_VERSION}"
SRCDATE_opie-datebook-chrisholidayplugin ?= "${OPIE_VERSION}"
SRCDATE_opie-datebook-nationalholidayplugin ?= "${OPIE_VERSION}"
SRCDATE_opie-datebook-birthdayplugin ?= "${OPIE_VERSION}"
SRCDATE_opie-deco-flat ?= "${OPIE_VERSION}"
SRCDATE_opie-deco-liquid ?= "${OPIE_VERSION}"
SRCDATE_opie-deco-polished ?= "${OPIE_VERSION}"
SRCDATE_opie-doctab ?= "${OPIE_VERSION}"
SRCDATE_opie-drawpad ?= "${OPIE_VERSION}"
SRCDATE_opie-dvorak ?= "${OPIE_VERSION}"
SRCDATE_opie-embeddedkonsole ?= "${OPIE_VERSION}"
SRCDATE_opie-euroconv ?= "${OPIE_VERSION}"
SRCDATE_opie-examples-python ?= "${OPIE_VERSION}"
SRCDATE_opie-examples ?= "${OPIE_VERSION}"
SRCDATE_opie-eye ?= "${OPIE_VERSION}"
SRCDATE_opie-fifteen ?= "${OPIE_VERSION}"
SRCDATE_opie-formatter ?= "${OPIE_VERSION}"
SRCDATE_opie-freetype ?= "${OPIE_VERSION}"
SRCDATE_opie-ftplib ?= "${OPIE_VERSION}"
SRCDATE_opie-ftp ?= "${OPIE_VERSION}"
SRCDATE_opie-go ?= "${OPIE_VERSION}"
SRCDATE_opie-gutenbrowser ?= "${OPIE_VERSION}"
SRCDATE_opie-handwriting ?= "${OPIE_VERSION}"
SRCDATE_opie-helpbrowser ?= "${OPIE_VERSION}"
SRCDATE_opie-help-en ?= "${OPIE_VERSION}"
SRCDATE_opie-homeapplet ?= "${OPIE_VERSION}"
SRCDATE_opie-i18n ?= "${OPIE_VERSION}"
SRCDATE_opie-lrelease-native ?= "${OPIE_VERSION}"
SRCDATE_opie-lupdate-native ?= "${OPIE_VERSION}"
SRCDATE_opie-icon-reload ?= "${OPIE_VERSION}"
SRCDATE_opie-irc ?= "${OPIE_VERSION}"
SRCDATE_opie-irdaapplet ?= "${OPIE_VERSION}"
SRCDATE_opie-jumpx ?= "${OPIE_VERSION}"
SRCDATE_opie-kbill ?= "${OPIE_VERSION}"
SRCDATE_opie-kcheckers ?= "${OPIE_VERSION}"
SRCDATE_opie-keyboard ?= "${OPIE_VERSION}"
SRCDATE_opie-keypebble ?= "${OPIE_VERSION}"
SRCDATE_opie-keytabs ?= "${OPIE_VERSION}"
SRCDATE_opie-keyview ?= "${OPIE_VERSION}"
SRCDATE_opie-kjumpx ?= "${OPIE_VERSION}"
SRCDATE_opie-kpacman ?= "${OPIE_VERSION}"
SRCDATE_opie-language ?= "${OPIE_VERSION}"
SRCDATE_opie-launcher-settings ?= "${OPIE_VERSION}"
SRCDATE_opie-libqrsync ?= "${OPIE_VERSION}"
SRCDATE_opie-light-and-power ?= "${OPIE_VERSION}"
SRCDATE_opie-lockapplet ?= "${OPIE_VERSION}"
SRCDATE_opie-login ?= "${OPIE_VERSION}"
SRCDATE_opie-logoutapplet ?= "${OPIE_VERSION}"
SRCDATE_opie-mailapplet ?= "${OPIE_VERSION}"
SRCDATE_opie-mail ?= "${OPIE_VERSION}"
SRCDATE_opie-mediaplayer1-libmadplugin ?= "${OPIE_VERSION}"
SRCDATE_opie-mediaplayer1-libmodplugin ?= "${OPIE_VERSION}"
SRCDATE_opie-mediaplayer1-libtremorplugin ?= "${OPIE_VERSION}"
SRCDATE_opie-mediaplayer1-libwavplugin ?= "${OPIE_VERSION}"
SRCDATE_opie-mediaplayer1 ?= "${OPIE_VERSION}"
SRCDATE_opie-mediaplayer2 ?= "${OPIE_VERSION}"
SRCDATE_opie-mediaplayer2-skin-default ?= "${OPIE_VERSION}"
SRCDATE_opie-mediaplayer2-skin-default-landscape ?= "${OPIE_VERSION}"
SRCDATE_opie-mediaplayer2-skin-pod ?= "${OPIE_VERSION}"
SRCDATE_opie-mediaplayer2-skin-techno ?= "${OPIE_VERSION}"
SRCDATE_opie-mediummount ?= "${OPIE_VERSION}"
SRCDATE_opie-memoryapplet ?= "${OPIE_VERSION}"
SRCDATE_opie-mindbreaker ?= "${OPIE_VERSION}"
SRCDATE_opie-minesweep ?= "${OPIE_VERSION}"
SRCDATE_opie-mobilemsg ?= "${OPIE_VERSION}"
SRCDATE_opie-multikeyapplet ?= "${OPIE_VERSION}"
SRCDATE_opie-multikey ?= "${OPIE_VERSION}"
SRCDATE_opie-networkapplet ?= "${OPIE_VERSION}"
SRCDATE_opie-networksettings ?= "${OPIE_VERSION}"
SRCDATE_opie-notesapplet ?= "${OPIE_VERSION}"
SRCDATE_opie-odict ?= "${OPIE_VERSION}"
SRCDATE_opie-osearch ?= "${OPIE_VERSION}"
SRCDATE_opie-oxygen ?= "${OPIE_VERSION}"
SRCDATE_opie-oyatzee ?= "${OPIE_VERSION}"
SRCDATE_opie-packagemanager ?= "${OPIE_VERSION}"
SRCDATE_opie-parashoot ?= "${OPIE_VERSION}"
SRCDATE_opie-pcmciaapplet ?= "${OPIE_VERSION}"
SRCDATE_opie-performance ?= "${OPIE_VERSION}"
SRCDATE_opie-pickboard ?= "${OPIE_VERSION}"
SRCDATE_opie-pics ?= "${OPIE_VERSION}"
SRCDATE_opie-pimconverter ?= "${OPIE_VERSION}"
SRCDATE_opie-powerchord ?= "${OPIE_VERSION}"
SRCDATE_opie-pyquicklaunchapplet ?= "${OPIE_VERSION}"
SRCDATE_opie-qasteroids ?= "${OPIE_VERSION}"
SRCDATE_opie-qcop ?= "${OPIE_VERSION}"
SRCDATE_opie-quicklauncher ?= "${OPIE_VERSION}"
SRCDATE_opie-qss ?= "${OPIE_VERSION}"
SRCDATE_opie-rdesktop ?= "${OPIE_VERSION}"
SRCDATE_opie-reader ?= "${OPIE_VERSION}"
SRCDATE_opie-recorder ?= "${OPIE_VERSION}"
SRCDATE_opie-remote ?= "${OPIE_VERSION}"
SRCDATE_opie-restartapplet2 ?= "${OPIE_VERSION}"
SRCDATE_opie-restartapplet ?= "${OPIE_VERSION}"
SRCDATE_opie-restartapplet ?= "${OPIE_VERSION}"
SRCDATE_opie-rotateapplet ?= "${OPIE_VERSION}"
SRCDATE_opie-screenshotapplet ?= "${OPIE_VERSION}"
SRCDATE_opie-search ?= "${OPIE_VERSION}"
SRCDATE_opie-security ?= "${OPIE_VERSION}"
SRCDATE_opie-securityplugin-blueping ?= "${OPIE_VERSION}"
SRCDATE_opie-securityplugin-dummy ?= "${OPIE_VERSION}"
SRCDATE_opie-securityplugin-notice ?= "${OPIE_VERSION}"
SRCDATE_opie-securityplugin-pin ?= "${OPIE_VERSION}"
SRCDATE_opie-sfcave ?= "${OPIE_VERSION}"
SRCDATE_opie-sheet ?= "${OPIE_VERSION}"
SRCDATE_opie-sh ?= "${OPIE_VERSION}"
SRCDATE_opie-showimg ?= "${OPIE_VERSION}"
SRCDATE_opie-snake ?= "${OPIE_VERSION}"
SRCDATE_opie-solitaire ?= "${OPIE_VERSION}"
SRCDATE_opie-sshkeys ?= "${OPIE_VERSION}"
SRCDATE_opie-style-flat ?= "${OPIE_VERSION}"
SRCDATE_opie-style-fresh ?= "${OPIE_VERSION}"
SRCDATE_opie-style-liquid ?= "${OPIE_VERSION}"
SRCDATE_opie-style-metal ?= "${OPIE_VERSION}"
SRCDATE_opie-style-phase ?= "${OPIE_VERSION}"
SRCDATE_opie-style-web ?= "${OPIE_VERSION}"
SRCDATE_opie-sounds ?= "${OPIE_VERSION}"
SRCDATE_opie-stumbler ?= "${OPIE_VERSION}"
SRCDATE_opie-suspendapplet ?= "${OPIE_VERSION}"
SRCDATE_opie-symlinker ?= "${OPIE_VERSION}"
SRCDATE_opie-sysinfo ?= "${OPIE_VERSION}"
SRCDATE_opie-systemtime ?= "${OPIE_VERSION}"
SRCDATE_opie-tableviewer ?= "${OPIE_VERSION}"
SRCDATE_opie-tabmanager ?= "${OPIE_VERSION}"
SRCDATE_opie-taskbar ?= "${OPIE_VERSION}"
SRCDATE_opie-tetrix ?= "${OPIE_VERSION}"
SRCDATE_opie-textedit ?= "${OPIE_VERSION}"
SRCDATE_opie-theme ?= "${OPIE_VERSION}"
SRCDATE_opie-tictac ?= "${OPIE_VERSION}"
SRCDATE_opie-tinykate ?= "${OPIE_VERSION}"
SRCDATE_opie-today-addressbookplugin ?= "${OPIE_VERSION}"
SRCDATE_opie-today-datebookplugin ?= "${OPIE_VERSION}"
SRCDATE_opie-today-fortuneplugin ?= "${OPIE_VERSION}"
SRCDATE_opie-today-mailplugin ?= "${OPIE_VERSION}"
SRCDATE_opie-today ?= "${OPIE_VERSION}"
SRCDATE_opie-today-stocktickerplugin ?= "${OPIE_VERSION}"
SRCDATE_opie-today-todolistplugin ?= "${OPIE_VERSION}"
SRCDATE_opie-today-weatherplugin ?= "${OPIE_VERSION}"
SRCDATE_opie-todo ?= "${OPIE_VERSION}"
SRCDATE_opie-tonleiter ?= "${OPIE_VERSION}"
SRCDATE_opie-unikeyboard ?= "${OPIE_VERSION}"
SRCDATE_opie-usermanager ?= "${OPIE_VERSION}"
SRCDATE_opie-vmemo ?= "${OPIE_VERSION}"
SRCDATE_opie-vmemo-settings ?= "${OPIE_VERSION}"
SRCDATE_opie-volumeapplet ?= "${OPIE_VERSION}"
SRCDATE_opie-vtapplet ?= "${OPIE_VERSION}"
SRCDATE_opie-wellenreiter ?= "${OPIE_VERSION}"
SRCDATE_opie-wirelessapplet ?= "${OPIE_VERSION}"
SRCDATE_opie-wordgame ?= "${OPIE_VERSION}"
SRCDATE_opie-write ?= "${OPIE_VERSION}"
SRCDATE_opie-zkbapplet ?= "${OPIE_VERSION}"
SRCDATE_opie-zlines ?= "${OPIE_VERSION}"
SRCDATE_opie-zsafe ?= "${OPIE_VERSION}"
SRCDATE_opie-zsame ?= "${OPIE_VERSION}"
PREFERRED_VERSION_konqueror-embedded = "20060404"
```

## conf/distro/preferred-x-versions-pre-X11R7.inc
```bitbake
#
# Specify to build old/old CVS versions of X libraries and apps
#

PREFERRED_VERSION_xproto         = "0.0+cvs${SRCDATE}"

PREFERRED_VERSION_diet-x11       = "6.2.1+cvs${SRCDATE}"
PREFERRED_VERSION_libice         = "6.3.3"
PREFERRED_VERSION_libsm          = "6.0.3"
PREFERRED_VERSION_libx11         = "6.2.1+cvs${SRCDATE}"
PREFERRED_VERSION_libxau         = "1.0.1"
PREFERRED_VERSION_libxaw         = "7.0.2"
PREFERRED_VERSION_libxcomposite  = "1.0.1"
PREFERRED_VERSION_libxcursor     = "1.1.2"
PREFERRED_VERSION_libxdamage     = "1.0.1"
PREFERRED_VERSION_libxdmcp       = "0.1.3"
PREFERRED_VERSION_libxext        = "0.0+cvs${SRCDATE}"
PREFERRED_VERSION_libxfixes      = "2.0.1"
PREFERRED_VERSION_libxfont       = "1.4.2"
PREFERRED_VERSION_libxft         = "2.1.6"
PREFERRED_VERSION_libxi          = "6.0.1"
PREFERRED_VERSION_libxinerama    = "1.0.2+cvs20050505"
PREFERRED_VERSION_libxkbfile     = "0.0+cvs${SRCDATE}"
PREFERRED_VERSION_libxmu         = "0.0+cvs${SRCDATE}"
PREFERRED_VERSION_libxp          = "0.0+cvs${SRCDATE}"
PREFERRED_VERSION_libxpm         = "3.5.1"
PREFERRED_VERSION_libxrandr      = "1.0.2"
PREFERRED_VERSION_libxrender     = "0.8.4"
PREFERRED_VERSION_libxres        = "1.0.1"
PREFERRED_VERSION_libxss         = "0.0+cvs${SRCDATE}"
PREFERRED_VERSION_libxt          = "0.1.5"
PREFERRED_VERSION_libxtst        = "0.0+cvs${SRCDATE}"
PREFERRED_VERSION_libxv          = "2.2.2+cvs20040918"
PREFERRED_VERSION_libxxf86dga    = "0.0+cvs${SRCDATE}"
PREFERRED_VERSION_libxxf86vm     = "0.0+cvs${SRCDATE}"

PREFERRED_VERSION_xcalibrate     = "0.0+cvs20060312"
PREFERRED_VERSION_xserver-kdrive = "0.0+cvs20050207"

PREFERRED_VERSION_xdpyinfo       = "0.0+cvs${SRCDATE}"
PREFERRED_VERSION_xev            = "0.0+cvs${SRCDATE}"
PREFERRED_VERSION_xhost          = "0.0+cvs20040413"
PREFERRED_VERSION_xmodmap        = "0.0+cvs${SRCDATE}"
PREFERRED_VERSION_xrandr         = "0.0+cvs${SRCDATE}"
```

## conf/distro/sharprom-compatible.conf
```bitbake
#@TYPE: Distribution
#@NAME: SharpROM
#@DESCRIPTION: Distribution configuration for SharpROM (Zaurus) compatible packages
#@MENTOR: None
#@REQUIREMENTS: A prebuilt SharpROM Embedix Toolchain in /usr/local/arm/2.95.3
#@REQUIREMENTS: Rename arm-linux-gcc|g++ to arm-linux-gcc-2.95 and rename arm-linux-ld to arm-linux-ld-2.11.2.
#@REQUIREMENTS: /usr/local/arm/2.95.3/bin must be in your path, like "export PATH=$PATH:/usr/local/arm/2.95.3/bin/"

INHERIT += " package_ipk debian sanity"

#
# Zaurus
#
TARGET_OS = "linux"
TARGET_FPU = ""
TARGET_ARCH = "arm"
TARGET_CC_ARCH = "-march=armv4"
FULL_OPTIMIZATION = "-fexpensive-optimizations -fomit-frame-pointer -O2"
FULL_OPTIMIZATION_pn-fetchmail = "-fexpensive-optimizations -fomit-frame-pointer -O1"
OEINCLUDELOGS = "yes"
KERNEL_CONSOLE = "tty1"
# prebuilt toolchain doesn't know about -isystem
export BUILD_CPPFLAGS = "-I${STAGING_INCDIR_NATIVE}"
export TARGET_CPPFLAGS = "-I${STAGING_DIR_TARGET}/${includedir}"
#DEBUG_OPTIMIZATION = "-O -g3"
#DEBUG_BUILD = "1"

# We are still using 2.4 embedix kernels
COMPATIBLE_MACHINE_pn-c7x0-kernels = "(c7x0|corgi|husky|shepherd)"
COMPATIBLE_MACHINE_pn-collie-kernels = "collie"
COMPATIBLE_MACHINE_pn-poodle-kernels = "(poodle|poodle255)"
COMPATIBLE_MACHINE_pn-openzaurus-pxa27x = "(akita|spitz|borzoi)"
COMPATIBLE_MACHINE_pn-openzaurus-pxa = "(c7x0|corgi|husky|shepherd|poodle|poodle255|tosa)"
COMPATIBLE_MACHINE_pn-openzaurus-sa = "collie"


#
# Base
#
DISTRO_NAME = "SharpROM"
DISTRO_VERSION = "3.1-compatible"
DISTRO_TYPE = "debug"

PREFERRED_PROVIDER_virtual/arm-linux-gcc-2.95 = "sharprom-toolchain-native" 
PREFERRED_PROVIDER_virtual/arm-linux-libc-for-gcc = "sharprom-toolchain-native" 
PREFERRED_PROVIDER_virtual/arm-linux-libc-initial = "sharprom-toolchain-native"
PREFERRED_PROVIDER_virtual/arm-linux-binutils = "sharprom-toolchain-native"
PREFERRED_PROVIDER_virtual/libc = "sharprom-toolchain-native"
PREFERRED_PROVIDER_virtual/libiconv = "sharprom-toolchain-native"
PREFERRED_PROVIDER_virtual/libintl = "sharprom-toolchain-native"
PREFERRED_PROVIDER_virtual/arm-linux-gcc = "sharprom-toolchain-native" 
PREFERRED_PROVIDER_linux-libc-headers = "linux-libc-headers"
PREFERRED_PROVIDER_virtual/arm-linux-gcc-initial = "sharprom-toolchain-native"
PREFERRED_PROVIDER_virtual/arm-linux-gcc-intermediate = "sharprom-toolchain-native"

PREFERRED_VERSION_glibc = "2.2.5"
PREFERRED_VERSION_linux-libc-headers = "2.4.18"

IPKGBUILDCMD = "ipkg-build -c -o 0 -g 0"
#INHIBIT_PACKAGE_STRIP = "1"

#
# Opie
#
PREFERRED_PROVIDERS += " virtual/libqpe:libqpe-opie"
QTE_VERSION = "2.3.10"
OPIE_VERSION = "1.2.2"
PALMTOP_USE_MULTITHREADED_QT = "no"
export palmtopdir = "/opt/QtPalmtop"
require conf/distro/include/preferred-opie-versions.inc

#
# GPE
#
SRCDATE_xserver-kdrive = "20050208"
PREFERRED_PROVIDERS += "virtual/xserver:xserver-kdrive"
PREFERRED_PROVIDERS += " gst-plugins:gpe-gst-plugins"
require conf/distro/include/preferred-gpe-versions.inc

#
# E
#
```
