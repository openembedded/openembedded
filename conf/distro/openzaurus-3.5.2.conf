## conf/distro/oplinux-uclibc.conf
```bitbake
#-----------------------------------------------------------------------------
#@TYPE: Distribution
#@NAME: OPLinux uClibC
#@DESCRIPTION: OPLinux uClibC Embedded Linux Distribution Configuration
#
#@COMMENT: This is a distribution for a number of embedded targets
#@COMMENT: currently supported are
#@COMMENT: generic x86
#@COMMENT: wrap (x86)
#@COMMENT: dht-walnut (ppc405)
#@COMMENT: efika (ppc603)
#@COMMENT: rb5xx (mips)
#@COMMENT: 
#@COMMENT: for additional info please check www.digital-opsis.com
#-----------------------------------------------------------------------------

require conf/distro/include/oplinux.inc
require conf/distro/include/sane-srcdates.inc

#
# Header
#
DISTRO_NAME = "OPLinux-uClibC"
DISTRO_VERSION = "dev-snapshot-${SRCDATE}"
#DISTRO_TYPE = "release"
DISTRO_TYPE = "debug"

#
# Target OS & FPU system
#
TARGET_OS = "linux-uclibc"
LIBC = "uclibc"
require conf/distro/include/${LIBC}.inc

#
# Kernel
#
KERNEL = "kernel26"
MACHINE_KERNEL_VERSION = "2.6"


#
# Binutils & Compiler
#
PREFERRED_PROVIDERS += " virtual/${TARGET_PREFIX}gcc-initial:gcc-cross-initial"
PREFERRED_PROVIDERS += " virtual/${TARGET_PREFIX}gcc-intermediate:gcc-cross-intermediate"
PREFERRED_PROVIDERS += " virtual/${TARGET_PREFIX}gcc:gcc-cross"
PREFERRED_PROVIDERS += " virtual/${TARGET_PREFIX}g++:gcc-cross"

PREFERRED_VERSION_gcc ?= "4.1.1"
PREFERRED_VERSION_gcc-cross ?= "4.1.1"
PREFERRED_VERSION_gcc-cross-initial ?= "4.1.1"
PREFERRED_VERSION_gcc-cross-intermediate ?= "4.1.1"
PREFERRED_VERSION_binutils ?= "2.17.50.0.5"
PREFERRED_VERSION_binutils-cross ?= "2.17.50.0.5"


#PREFERRED_VERSION_linux-libc-headers   = "2.6.15.99"
PREFERRED_VERSION_linux-libc-headers    = "2.6.11.1"

SRCDATE_uclibc ?= "20061128"
PREFERRED_VERSION_uclibc ?= "0.9.28+svn${SRCDATE_uclibc}"



#Other packages we need
#try to keep it minimal :)
DISTRO_EXTRA_RDEPENDS += "\
                         nano pciutils"




FEED_ARCH ?= "${TARGET_ARCH}"

#i486 machines          
FEED_ARCH_x86           ="i486"

#i586 machines
FEED_ARCH_epia          = "i586"

#i686 machines
FEED_ARCH_guinness      = "i686"
FEED_ARCH_progear       = "i686"

#powerpc machines
FEED_ARCH_efika         = "ppc603e"
FEED_ARCH-dht-walnut    = "ppc405"


FEED_URIS += " \
                no-arch##${OPLINUX-uCLIBC_URI}/unstable/feed/all \
                base##${OPLINUX-uCLIBC_URI}/unstable/feed/${FEED_ARCH}/base \
                perl##${OPLINUX-uCLIBC_URI}/unstable/feed/${FEED_ARCH}/perl \
                python##${OPLINUX-uCLIBC_URI}/unstable/feed/${FEED_ARCH}/python \
                debug##${OPLINUX-uCLIBC_URI}/unstable/feed/${FEED_ARCH}/debug \
                ${MACHINE}##${OPLINUX-uCLIBC_URI}/unstable/feed/${FEED_ARCH}/machine/${MACHINE}"
```

## conf/distro/oplinux.conf
```bitbake
# Copyright (C) 2007, Stelios Koroneos - Digital OPSiS, All Rights Reserved
# Released under the MIT license (see packages/COPYING)
#-----------------------------------------------------------------------------
#@TYPE: Distribution
#@NAME: OPLinux
#@DESCRIPTION: OPLinux Embedded Linux Distribution Configuration
#
#@COMMENT: This is a distribution for a number of embedded targets
#@COMMENT: currently supported are
#@COMMENT: x86 wrap   (i486)
#@COMMENT: i586-generic epia (i586)
#@COMMENT: i686-generic  (i686)
#@COMMENT: dht-walnut magicbox (ppc405)
#@COMMENT: sequoia (ppc440)
#@COMMENT: efika (ppc603)
#@COMMENT:
#@COMMENT: for additional info please check www.digital-opsis.com/oplinux
#-----------------------------------------------------------------------------

require conf/distro/include/oplinux.inc
require conf/distro/include/sane-srcdates.inc


#
# Header
#
DISTRO_NAME = "OPLinux"
DISTRO_VERSION ?= "dev-snapshot-${SRCDATE}"
#DISTRO_TYPE = "release"
DISTRO_TYPE = "debug"

#
# Target OS & FPU system
#
TARGET_OS = "linux"

PREFERRED_PROVIDERS += "virtual/${TARGET_PREFIX}gcc-initial:gcc-cross-initial"
PREFERRED_PROVIDERS += "virtual/${TARGET_PREFIX}gcc-intermediate:gcc-cross-intermediate"
PREFERRED_PROVIDERS += "virtual/${TARGET_PREFIX}gcc:gcc-cross"
PREFERRED_PROVIDERS += "virtual/${TARGET_PREFIX}g++:gcc-cross"


PREFERRED_PROVIDER_dbus-glib = "dbus-glib"
PREFERRED_PROVIDER_virtual/libsdl       ?= "libsdl-x11"
PREFERRED_PROVIDER_esound 		?= "pulseaudio"


# glibc:
LIBC ?= "glibc"
require conf/distro/include/${LIBC}.inc

# Virtuals:
PREFERRED_PROVIDER_virtual/db ?= "db"
PREFERRED_PROVIDER_virtual/db-native ?= "db-native"
PREFERRED_PROVIDER_virtual/xserver ?= "xserver-kdrive"

# Others:
PREFERRED_PROVIDER_virtual/libx11 ?= "diet-x11"
PREFERRED_PROVIDER_gconf ?= "gconf-dbus"
PREFERRED_PROVIDER_gnome-vfs ?= "gnome-vfs"
PREFERRED_PROVIDER_gnome-vfs-plugin-file ?= "gnome-vfs"
PREFERRED_PROVIDER_tslib ?= "tslib"
PREFERRED_PROVIDER_tslib-conf ?= "tslib"
PREFERRED_PROVIDER_libgpewidget ?= "libgpewidget"
PREFERRED_PROVIDER_ntp = "ntp"
PREFERRED_PROVIDER_hotplug = "udev"
PREFERRED_PROVIDER_libxss = "libxss"


PREFERRED_VERSION_gcc ?= "4.1.1"
PREFERRED_VERSION_gcc-cross ?= "4.1.1"
PREFERRED_VERSION_gcc-cross-sdk ?= "4.1.1"
PREFERRED_VERSION_gcc-cross-initial ?= "4.1.1"
PREFERRED_VERSION_gcc-cross-intermediate ?= "4.1.1"

PREFERRED_VERSION_binutils ?= "2.17.50.0.5"
PREFERRED_VERSION_binutils-cross ?= "2.17.50.0.5"
PREFERRED_VERSION_binutils-cross-sdk ?= "2.17.50.0.5"

PREFERRED_VERSION_linux-libc-headers_i486 ?= "2.6.18"
PREFERRED_VERSION_linux-libc-headers_i586 ?= "2.6.18"
PREFERRED_VERSION_linux-libc-headers_i686 ?= "2.6.18"
PREFERRED_VERSION_linux-libc-headers_powerpc ?= "2.6.18"
PREFERRED_VERSION_linux-libc-headers ?= "2.6.18"

PREFERRED_VERSION_glibc-initial ?= "2.5"
PREFERRED_VERSION_glibc ?= "2.5"

PCMCIA_MANAGER = "pcmciautils"
PREFERRED_VERSION_dbus ?= "1.0.2"
PREFERRED_VERSION_dbus-glib ?= "0.71"


#
# Kernel
#
KERNEL = "kernel26"
MACHINE_KERNEL_VERSION = "2.6"



#Other packages we need
#try to keep it minimal :)
DISTRO_EXTRA_RDEPENDS += "\
                         nano pciutils"


FEED_URIS += " \
                no-arch##${OPLINUX_URI}/unstable/feed/all \
                base##${OPLINUX_URI}/unstable/feed/${FEED_ARCH}/base \
                perl##${OPLINUX_URI}/unstable/feed/${FEED_ARCH}/perl \
                python##${OPLINUX_URI}/unstable/feed/${FEED_ARCH}/python \
                debug##${OPLINUX_URI}/unstable/feed/${FEED_ARCH}/debug \
                ${MACHINE}##${OPLINUX_URI}/unstable/feed/${FEED_ARCH}/machine/${MACHINE}"
```

## conf/distro/preferred-e-versions.inc
```bitbake
#
# Specify which versions of E-related libraries and applications to build
#

PREFERRED_VERSION_ecore = "0.9.9.007"
PREFERRED_VERSION_edb = "1.0.5.003"
PREFERRED_VERSION_edje = "0.5.0.007"
PREFERRED_VERSION_eet = "0.9.10.007"
PREFERRED_VERSION_embryo = "0.9.1.007"
PREFERRED_VERSION_etox = "0.9.0.003"
PREFERRED_VERSION_evas = "0.9.9.007"
PREFERRED_VERSION_ewl = "0.0.4.003"
PREFERRED_VERSION_imlib2 = "1.2.0.007"
```
