## conf/distro/shr.conf
```bitbake
#-----------------------------------------------------------------------------
#@TYPE: Distribution
#@NAME: SHR
#@DESCRIPTION: Linux Distribution Configuration for Mobile Phones
#-----------------------------------------------------------------------------

# set default locale for images
IMAGE_LINGUAS ?= "en-us"

# Set the toolchain type (internal, external) and brand (generic, csl etc.)
TOOLCHAIN_TYPE ?= "internal"
TOOLCHAIN_BRAND ?= ""

BB_LOCALCOUNT_OVERRIDE = ""
require conf/distro/include/preferred-shr-versions.inc

#
# Header
#
DISTRO_NAME = "shr"
DISTRO_VERSION = "-${DATE}"
DISTRO_REVISION = "2"
DISTRO_PR = ".6"
DISTRO_TYPE = "release"
DISTRO = "shr"

DISTRO_SSH_DAEMON = "openssh"
DISTRO_APM = "fso-apm"

#Generate locales on the buildsystem instead of on the target. Speeds up first boot, set to "1" to enable
ENABLE_BINARY_LOCALE_GENERATION ?= "1"

# We only want to build UTF8 locales
LOCALE_UTF8_ONLY = "1"

#save statistical info on images
INHERIT += "testlab"

#activate the angstrom blacklister
INHERIT += "angstrom"

#run QA tests on builds and packages and log them
INHERIT += "insane"
# INHERIT += "packagehistory"
QA_LOG = "1"

#make devshell available as task
INHERIT += "devshell"

#run QA tests on recipes
INHERIT += "recipe_sanity"

ANGSTROM_BLACKLIST_pn-bluez-libs  = "bluez-libs 3.x has been replaced by bluez4"
ANGSTROM_BLACKLIST_pn-bluez-utils = "bluez-utils 3.x has been replaced by bluez4"
ANGSTROM_BLACKLIST_pn-atd = "atd has been replaced by atd-over-fso"
ANGSTROM_BLACKLIST_pn-libnl = "libnld has been replaced by libnl2"
ANGSTROM_BLACKLIST_pn-update-alternatives-cworth-native = "update-alternatives-cworth-native has been replaced by opkg implementation of u-a script"
ANGSTROM_BLACKLIST_pn-update-alternatives-cworth = "update-alternatives-cworth has been replaced by opkg implementation of u-a script"
ANGSTROM_BLACKLIST_pn-qt4-x11-free-gles = "qt4-x11-free is fine even without gles"
ANGSTROM_BLACKLIST_pn-collie-kernel-48-16 = "kernel-2.4.* is too old and gcc-2.95 is gone"
ANGSTROM_BLACKLIST_pn-openzaurus-pxa27x = "kernel-2.4.* is too old and gcc-2.95 is gone"
ANGSTROM_BLACKLIST_pn-corgi-kernel-2.4-embedix = "kernel-2.4.* is too old and gcc-2.95 is gone"
ANGSTROM_BLACKLIST_pn-collie-kernel-32-32 = "kernel-2.4.* is too old and gcc-2.95 is gone"
ANGSTROM_BLACKLIST_pn-shepherd-kernel-2.4-embedix = "kernel-2.4.* is too old and gcc-2.95 is gone"
ANGSTROM_BLACKLIST_pn-collie-kernel-58-6 = "kernel-2.4.* is too old and gcc-2.95 is gone"
ANGSTROM_BLACKLIST_pn-husky-kernel-2.4-embedix = "kernel-2.4.* is too old and gcc-2.95 is gone"
ANGSTROM_BLACKLIST_pn-collie-kernel-24-8 = "kernel-2.4.* is too old and gcc-2.95 is gone"
ANGSTROM_BLACKLIST_pn-poodle-kernel-2.4-embedix = "kernel-2.4.* is too old and gcc-2.95 is gone"
ANGSTROM_BLACKLIST_pn-openzaurus-pxa = "kernel-2.4.* is too old and gcc-2.95 is gone"
ANGSTROM_BLACKLIST_pn-collie-kernel-40-24 = "kernel-2.4.* is too old and gcc-2.95 is gone"
ANGSTROM_BLACKLIST_pn-poodle255-kernel-2.4-embedix = "kernel-2.4.* is too old and gcc-2.95 is gone"
ANGSTROM_BLACKLIST_pn-openzaurus-sa = "kernel-2.4.* is too old and gcc-2.95 is gone"
ANGSTROM_BLACKLIST_pn-collie-kernel-32-0 = "kernel-2.4.* is too old and gcc-2.95 is gone"
ANGSTROM_BLACKLIST_pn-collie-kernel-64-0 = "kernel-2.4.* is too old and gcc-2.95 is gone"
ANGSTROM_BLACKLIST_pn-collie-kernel-58-6-debug = "kernel-2.4.* is too old and gcc-2.95 is gone"
ANGSTROM_BLACKLIST_pn-c7x0-kernels-2.4-embedix = "kernel-2.4.* is too old and gcc-2.95 is gone"
ANGSTROM_BLACKLIST_pn-collie-kernels-2.4-embedix = "kernel-2.4.* is too old and gcc-2.95 is gone"
ANGSTROM_BLACKLIST_pn-linux-jlime-current = "strange kernel, spank maintainer"
ANGSTROM_BLACKLIST_pn-linux-ml403-mvista-2.6.x = "strange kernel, spank maintainer"
ANGSTROM_BLACKLIST_pn-linux-davinci = "strange kernel, spank maintainer"


CVS_TARBALL_STASH += "http://build.shr-project.org/sources/"

#The shr-mirrors.bbclass repleaces this
#PREMIRRORS = "(ftp|https?)$://.*/.* http://build.shr-project.org/sources/"
INHERIT += "shr-mirrors" 


DISTRO_FEED_PREFIX ?= "shr-dev"
DISTRO_FEED_URI ?= "http://build.shr-project.org/shr-testing/ipk"

AB_DEPLOY_EXTRA ?= ""
DEPLOY_DIR_IMAGE = "${DEPLOY_DIR}/images/${MACHINE_ARCH}/${AB_DEPLOY_EXTRA}"

IMAGE_INITSCRIPTS = "initscripts-shr"

IPKG_VARIANT = "opkg"

#Illume settings
ILLUME_CONFIG = "e-wm-config-illume2-shr"
ILLUME_THEME = "e-wm-theme-illume-gry"

# From minimal.conf

#############################################################################
# FEATURE SELECTION
#############################################################################
# Use bluetooth 4.0
DISTRO_BLUETOOTH_MANAGER = "bluez4"
# We want images supporting the following features (for task-base)
DISTRO_FEATURES = "largefile ipv4 ipv6 wifi ppp ext2 vfat bluetooth usbgadget usbhost"
# Following features are for ARM and E500 based machines
DISTRO_FEATURES += " eabi "
# Use-like features
DISTRO_FEATURES += " tk "

#############################################################################
# LIBRARY NAMES
#############################################################################
# libfoo -> libfoo0-2 (etc)
INHERIT += "debian"

#############################################################################
# PACKAGING & FEEDS
#############################################################################
# Chose the packaging system
INHERIT += "package_ipk"
IMAGE_FSTYPES ?= "tar.gz jffs2"

require conf/distro/include/sane-feed.inc
PREFERRED_PKG_FORMAT ?= "ipk"
require conf/distro/include/sane-feed-${PREFERRED_PKG_FORMAT}.inc

#############################################################################
# IMAGES
#############################################################################
# Name the generated images in a sane way
IMAGE_NAME = "${DISTRO_NAME}-${IMAGE_BASENAME}-${LIBC}-${PREFERRED_PKG_FORMAT}-${DISTRO_VERSION}-${MACHINE}"
CACHE ?= "${TMPDIR}/cache/${LIBC}/${MACHINE}"
DEPLOY_DIR ?= "${TMPDIR}/deploy/${LIBC}"
DEPLOY_DIR_IMAGE = "${DEPLOY_DIR}/images/${MACHINE}"

# increase inode/block ratio for ext2 filesystem 
EXTRA_IMAGECMD_ext2 = "-i 8192"

#############################################################################
# KERNEL
#############################################################################
KERNEL = "kernel26"
MACHINE_KERNEL_VERSION = "2.6"

#############################################################################
# Ensure MACHINE_CLASS is in OVERRIDES
#############################################################################
MACHINE_CLASS ?= ""
MACHINE_OVERRIDES += "${MACHINE_CLASS}"

#############################################################################
# TOOLCHAIN
#############################################################################
LIBC ?= "eglibc"
require conf/distro/include/sane-toolchain.inc
require conf/distro/include/arm-thumb.inc

# Set some java bits
require conf/distro/include/sane-toolchain-java.inc
require conf/distro/include/angstrom-jalimo.conf


#############################################################################
# PREFERRED PROVIDERS
#############################################################################
PREFERRED_PROVIDER_gpsd = "fso-gpsd"
PREFERRED_PROVIDER_atd = "atd-over-fso"
PREFERRED_PROVIDER_opkg = "opkg"
# virtual/libgl is used ie in xorg-xserver which is not MACHINE_ARCH so we need to keep it consistent across multiple machines using same xorg-xserver
PREFERRED_PROVIDER_virtual/libgl = "mesa-dri"

#############################################################################
# PREFERRED VERSIONS
#############################################################################
require conf/distro/include/preferred-e-versions.inc
require conf/distro/include/preferred-opie-versions-1.2.4.inc

#############################################################################
# CONTENTS
#############################################################################

# Ship extra debug utils in the rootfs when doing a debug build 
DISTRO_EXTRA_APPS ?= ""
DISTRO_EXTRA_APPS += '${@base_conditional("DISTRO_TYPE", "release", "", "task-cli-tools-debug",d)}'

# Additional content I (only valid if you include task-base)
# distro-feed-configs: configuration files for the online feeds
# util-linux-ng-mount util-linux-ng-umount: busybox mount is broken
# angstrom-libc-fixup-hack: fixes an obscure bug with libc.so symlink
DISTRO_EXTRA_RDEPENDS += "\
  shr-version \
  distro-feed-configs \
  util-linux-ng-mount util-linux-ng-umount \
  angstrom-libc-fixup-hack \
  ${DISTRO_EXTRA_APPS} \
"
```

## conf/distro/slugos-bag.conf
```bitbake
#@TYPE: Distribution
#@NAME: SLUGOS-BAG
#@DESCRIPTION: Linux Distribution for the NSLU2

# See slugos.conf for an explanation of this file.

# This slugos variant corresponds to OpenSlug
DISTRO_NAME ?= "slugos-bag"
# DISTRO_VERSION = "${SLUGOS_VERSION}${DISTRO_REVISION}-${DISTRO_TYPE}"
# DISTRO_FEED ?= "unstable"
DISTRO_TYPE ?= "beta"

ARCH_BYTE_SEX = "be"
ARM_INSTRUCTION_SET = "arm"
TARGET_OS = "linux"
SLUGOS_IMAGESEX  ?= "big-endian"

FEED_URIS_append += "cross##http://ipkg.nslu2-linux.org/feeds/slugos-bag/cross/${DISTRO_FEED}"
FEED_URIS_append += "native##http://ipkg.nslu2-linux.org/feeds/slugos-bag/native/${DISTRO_FEED}"

include conf/distro/slugos.conf
```

## conf/distro/slugos-bau.conf
```bitbake
#@TYPE: Distribution
#@NAME: SLUGOS-BAU
#@DESCRIPTION: Linux Distribution for the NSLU2

# See slugos.conf for an explanation of this file.

# This slugos variant is not supported - there are no nslu2-linux.org
# regular builds and there is no feed.
DISTRO_NAME ?= "slugos-bau"
# DISTRO_VERSION = "${SLUGOS_VERSION}${DISTRO_REVISION}-${DISTRO_TYPE}"
# DISTRO_FEED ?= "unstable"
DISTRO_TYPE ?= "alpha"

ARCH_BYTE_SEX = "be"
ARM_INSTRUCTION_SET = "arm"
TARGET_OS = "linux-uclibc"
SLUGOS_IMAGESEX  ?= "big-endian"

include conf/distro/slugos.conf
```

## conf/distro/slugos-btu.conf
```bitbake
#@TYPE: Distribution
#@NAME: SLUGOS-BTU
#@DESCRIPTION: Linux Distribution for the NSLU2

# See slugos.conf for an explanation of this file.

# This slugos variant corresponds to UcSlugC
DISTRO_NAME ?= "slugos-btu"
# DISTRO_VERSION = "${SLUGOS_VERSION}${DISTRO_REVISION}-${DISTRO_TYPE}"
# DISTRO_FEED ?= "unstable"
DISTRO_TYPE ?= "beta"

ARCH_BYTE_SEX = "be"
ARM_INSTRUCTION_SET = "thumb"
TARGET_OS = "linux-uclibc"
SLUGOS_IMAGESEX  ?= "big-endian"

FEED_URIS_append += "cross##http://ipkg.nslu2-linux.org/feeds/slugos-btu/cross/${DISTRO_FEED}"
FEED_URIS_append += "native##http://ipkg.nslu2-linux.org/feeds/slugos-btu/native/${DISTRO_FEED}"

include conf/distro/slugos.conf
```

## conf/distro/slugos-lag.conf
```bitbake
#@TYPE: Distribution
#@NAME: SLUGOS-LAG
#@DESCRIPTION: Linux Distribution for the NSLU2

# See slugos.conf for an explanation of this file.

# This slugos variant corresponds to DebianSlug
DISTRO_NAME ?= "slugos-lag"
# DISTRO_VERSION = "${SLUGOS_VERSION}${DISTRO_REVISION}-${DISTRO_TYPE}"
# DISTRO_FEED ?= "unstable"
DISTRO_TYPE ?= "beta"

ARCH_BYTE_SEX = "le"
ARM_INSTRUCTION_SET = "arm"
TARGET_OS = "linux"
SLUGOS_IMAGESEX  ?= "big-endian"

FEED_URIS_append += "cross##http://ipkg.nslu2-linux.org/feeds/slugos-lag/cross/${DISTRO_FEED}"
FEED_URIS_append += "native##http://ipkg.nslu2-linux.org/feeds/slugos-lag/native/${DISTRO_FEED}"


include conf/distro/slugos.conf
```

## conf/distro/slugos-lau.conf
```bitbake
#@TYPE: Distribution
#@NAME: SLUGOS-LAU
#@DESCRIPTION: Linux Distribution for the NSLU2

# This slugos variant is not supported - there are no nslu2-linux.org
# regular builds and there is no feed.
DISTRO_NAME ?= "slugos-lau"
# DISTRO_VERSION = "${SLUGOS_VERSION}${DISTRO_REVISION}-${DISTRO_TYPE}"
DISTRO_FEED ?= "unstable"
DISTRO_TYPE ?= "alpha"

ARCH_BYTE_SEX = "le"
ARM_INSTRUCTION_SET = "arm"
TARGET_OS = "linux-uclibc"
SLUGOS_IMAGESEX  ?= "big-endian"

include conf/distro/slugos.conf
```

## conf/distro/slugos-ltu.conf
```bitbake
#@TYPE: Distribution
#@NAME: SLUGOS-LTU
#@DESCRIPTION: Linux Distribution for the NSLU2

# See slugos.conf for an explanation of this file.

DISTRO_NAME ?= "slugos-ltu"
# DISTRO_VERSION = "${SLUGOS_VERSION}${DISTRO_REVISION}-${DISTRO_TYPE}"
# DISTRO_FEED ?= "unstable"
DISTRO_TYPE ?= "beta"

ARCH_BYTE_SEX = "le"
ARM_INSTRUCTION_SET = "thumb"
TARGET_OS = "linux-uclibc"
SLUGOS_IMAGESEX  ?= "big-endian"

FEED_URIS_append += "cross##http://ipkg.nslu2-linux.org/feeds/slugos-ltu/cross/${DISTRO_FEED}"
FEED_URIS_append += "native##http://ipkg.nslu2-linux.org/feeds/slugos-ltu/native/${DISTRO_FEED}"


include conf/distro/slugos.conf
```

## conf/distro/slugos-native.conf
```bitbake
# Our build host is armeb, not armv5eb that the kernel reports
BUILD_ARCH = "armeb"

require conf/distro/slugos.conf

# Corresponding packages should be in slugos-native.bb,
# currently missing: ipkg-utils libtool quilt pkgconfig
ASSUME_PROVIDED = "libtool-cross \
		   libtool-native \
		   automake-native \
		   autoconf-native \
		   quilt-native \
		   ipkg-native \
		   gnu-config-native \
		   pkgconfig-native \
		   virtual/armeb-linux-gcc \
		   virtual/libc \
		   update-rc.d \
		   "
```

## conf/distro/slugos.conf
```bitbake
#@TYPE: Distribution
#@NAME: SlugOS
#@DESCRIPTION: SlugOS Linux Distribution for the NSLU2

DISTRO_NAME = "SlugOS"
DISTRO_TYPE = "alpha"

ARM_INSTRUCTION_SET = "thumb"
IPKG_VARIANT ?= "opkg"
PREFERRED_PROVIDER_opkg ?= "opkg"
PREFERRED_PROVIDER_virtual/update-alternatives ?= "opkg"
IMAGE_INITSCRIPTS ?= "initscripts-slugos"
IMAGE_DEV_MANAGER = "udev"
# Disable installing ldconfig
USE_LDCONFIG = "0"

require conf/distro/include/slugos.inc
require conf/distro/include/sane-toolchain.inc
require conf/distro/include/arm-thumb.inc
```
