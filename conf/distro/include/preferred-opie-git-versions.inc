## conf/distro/include/sane-feed.inc
```bitbake
# Originally brought to you by the Angstrom Distribution

#############################################################################
# FEED BUILDING SETTINGS
#############################################################################

# Put links to sources in deploy/sources to make it easier for people to be GPL compliant
INHERIT += "src_distribute_local"
SRC_DIST_LOCAL ?= "symlink"

# Add FEED_ARCH to overrides
OVERRIDES .= ":${FEED_ARCH}"

FEED_ARCH ?= "${TARGET_ARCH}"

# Blackfin machines
FEED_ARCH_bfin          = "blackfin"

# armv4t machines

FEED_ARCH_acern30 	= "armv4t"
FEED_ARCH_amsdelta 	= "armv4t"
FEED_ARCH_ep93xx 	= "armv4t"
FEED_ARCH_eteng500 	= "armv4t"
FEED_ARCH_om-gta01 	= "armv4t"
FEED_ARCH_om-gta02 	= "armv4t"
FEED_ARCH_h1940 	= "armv4t"
FEED_ARCH_h6300 	= "armv4t"
FEED_ARCH_kb9202 	= "armv4t"
FEED_ARCH_ks8695 	= "armv4t"
FEED_ARCH_rx1950 	= "armv4t"
FEED_ARCH_rx3000 	= "armv4t"
FEED_ARCH_sarge-at91 	= "armv4t"
FEED_ARCH_smdk2440 	= "armv4t"
FEED_ARCH_smdk2443 	= "armv4t"

# armv5t machines

FEED_ARCH_a1200 	= "armv5te"
FEED_ARCH_a780 		= "armv5te"
FEED_ARCH_akita 	= "armv5te"
FEED_ARCH_asus620 	= "armv5te"
FEED_ARCH_asus730 	= "armv5te"
FEED_ARCH_at91sam9260ek = "armv5te"
FEED_ARCH_at91sam9261ek = "armv5te"
FEED_ARCH_at91sam9263ek = "armv5te"
FEED_ARCH_at91sam9rlek 	= "armv5te"
FEED_ARCH_at91sam9g10ek = "armv5te"
FEED_ARCH_at91sam9g20ek = "armv5te"
FEED_ARCH_at91sam9g45ekes = "armv5te"
FEED_ARCH_aximx50 	= "armv5te"
FEED_ARCH_aximx50v 	= "armv5te"
FEED_ARCH_c7x0 		= "armv5te"
FEED_ARCH_compulab-pxa270 = "armv5te"
FEED_ARCH_davinci-dvevm = "armv5te"
FEED_ARCH_devkitidp-pxa255 = "armv5te"
FEED_ARCH_e680 		= "armv5te"
FEED_ARCH_er0100 	= "armv5te"
FEED_ARCH_gumstix 	= "armv5te"
FEED_ARCH_gumstix-verdex = "armv5te"
FEED_ARCH_gumstix-connex = "armv5te"
FEED_ARCH_h1910 	= "armv5te"
FEED_ARCH_h2200 	= "armv5te"
FEED_ARCH_h3900 	= "armv5te"
FEED_ARCH_h4000 	= "armv5te"
FEED_ARCH_h5000 	= "armv5te"
FEED_ARCH_htcalpine 	= "armv5te"
FEED_ARCH_htcapache 	= "armv5te"
FEED_ARCH_htcblueangel 	= "armv5te"
FEED_ARCH_htchimalaya 	= "armv5te"
FEED_ARCH_htcsable 	= "armv5te"
FEED_ARCH_htctornado 	= "armv5te"
FEED_ARCH_htcuniversal 	= "armv5te"
FEED_ARCH_hx2000 	= "armv5te"
FEED_ARCH_hx4700 	= "armv5te"
FEED_ARCH_ixp4xxle 	= "armv5te"
FEED_ARCH_logicpd-pxa270 = "armv5te"
FEED_ARCH_looxc550 	= "armv5te"
FEED_ARCH_lsarm 	= "armv5te"
FEED_ARCH_magician 	= "armv5te"
FEED_ARCH_mainstone 	= "armv5te"
FEED_ARCH_mnci 		= "armv5te"
FEED_ARCH_mtx-3 	= "armv5te"
FEED_ARCH_mx21ads 	= "armv5te"
FEED_ARCH_n2100 	= "armv5te"
FEED_ARCH_navman-icn330 = "armv5te"
FEED_ARCH_netbook-pro 	= "armv5te"
FEED_ARCH_nokia770 	= "armv5te"
FEED_ARCH_rokre2 	= "armv5te"
FEED_ARCH_nslu2le 	= "armv5te"
FEED_ARCH_omap1510inn 	= "armv5te"
FEED_ARCH_omap1610h2 	= "armv5te"
FEED_ARCH_omap1710h3 	= "armv5te"
FEED_ARCH_omap5912osk 	= "armv5te"
FEED_ARCH_palmld 	= "armv5te"
FEED_ARCH_palmt650 	= "armv5te"
FEED_ARCH_palmt680 	= "armv5te"
FEED_ARCH_palmtc 	= "armv5te"
FEED_ARCH_palmtt 	= "armv5te"
FEED_ARCH_palmtt3 	= "armv5te"
FEED_ARCH_palmtt5 	= "armv5te"
FEED_ARCH_palmtx 	= "armv5te"
FEED_ARCH_palmz31 	= "armv5te"
FEED_ARCH_palmz71 	= "armv5te"
FEED_ARCH_palmz72 	= "armv5te"
FEED_ARCH_poodle 	= "armv5te"
FEED_ARCH_qemuarm 	= "armv5te"
FEED_ARCH_spitz 	= "armv5te"
FEED_ARCH_tosa 		= "armv5te"
FEED_ARCH_triton 	= "armv5te"

FEED_ARCH_ixp4xxbe 	= "armv5teb"
FEED_ARCH_nslu2be 	= "armv5teb"

# armv6 machines

FEED_ARCH_mx31ads 	= "armv6"
FEED_ARCH_mx31moboard	= "armv6"
FEED_ARCH_nokia800	= "armv6"
FEED_ARCH_omap2420h4	= "armv6"
FEED_ARCH_omap2430sdp   = "armv6"

# i486 machines
FEED_ARCH_geodegx 	= "i486"
FEED_ARCH_geodelx 	= "i486"
FEED_ARCH_netvista 	= "i486"
FEED_ARCH_wrap 		= "i486"
FEED_ARCH_x86 		= "i486"

# i586 machines
FEED_ARCH_epia 		= "i586"
FEED_ARCH_i586-generic 	= "i586"
FEED_ARCH_qemux86 	= "i586"

# i686 machines

FEED_ARCH_alix 		= "i686"
FEED_ARCH_colinux	= "i686"
FEED_ARCH_guinness 	= "i686"
FEED_ARCH_i686-generic 	= "i686"
FEED_ARCH_progear 	= "i686"

# powerpc machines

FEED_ARCH_dht-walnut 	= "ppc405"
FEED_ARCH_magicbox 	= "ppc405"
FEED_ARCH_xilinx-ml403 	= "ppc405"
FEED_ARCH_xilinx-ml410 	= "ppc405"
FEED_ARCH_sequoia 	= "ppc440e"
FEED_ARCH_efika 	= "ppc603e"
FEED_ARCH_lite5200 	= "ppc603e"
FEED_ARCH_lsppchd 	= "ppc603e"
FEED_ARCH_lsppchg 	= "ppc603e"
FEED_ARCH_storcenter 	= "ppc603e"
FEED_ARCH_turbostation 	= "ppc603e"
FEED_ARCH_mpc8313e-rdb 	= "ppce300c3"
FEED_ARCH_mpc8323e-rdb 	= "ppce300c2"

# strongarm machines, no EABI

FEED_ARCH_collie 	= "arm-oabi"
FEED_ARCH_h3600 	= "arm-oabi"
FEED_ARCH_h3800 	= "arm-oabi"
FEED_ARCH_htcwallaby 	= "arm-oabi"
FEED_ARCH_jornada56x 	= "arm-oabi"
FEED_ARCH_jornada7xx 	= "arm-oabi"
FEED_ARCH_shark 	= "arm-oabi"
FEED_ARCH_simpad 	= "arm-oabi"

# Tweak packaging for strongarm machines since they can't use EABI

PACKAGE_EXTRA_ARCHS_collie = "arm-oabi"
PACKAGE_EXTRA_ARCHS_h3600  = "arm-oabi"
PACKAGE_EXTRA_ARCHS_h3800  = "arm-oabi"
PACKAGE_EXTRA_ARCHS_simpad = "arm-oabi"
PACKAGE_EXTRA_ARCHS_htcwallaby = "arm-oabi"
```

## conf/distro/include/sane-srcdates.inc
```bitbake
# Lock down some SRCDATEs
# See http://svn.o-hand.com/view/poky/trunk/openembedded/conf/distro/poky.conf for the original version 

# Kernel modules
SRCDATE_at76c503a-modules ?= "20060814"
SRCDATE_prism54-module ?= "20060814"

# Misc packages, sorted by alphabet
SRCDATE_aufs ?= "20081203"
SRCDATE_avetanabt ?= "20060814"
SRCDATE_bl ?= "20060814"
SRCDATE_dvbstream ?= "20090621"
SRCDATE_dvbtraffic ?= "20090621"
SRCDATE_dvbtune ?= "20090621"
SRCDATE_fdclock ?= "20060814"
SRCDATE_fltk ?= "20060814"
SRCDATE_gnuplot ?= "20080328"
SRCDATE_ipatience ?= "20061112" 
SRCDATE_ipkg-link ?= "20050930"
SRCDATE_ipkg-link-1 ?= "20050930"
SRCDATE_ipkg-utils ?= "20050930"
SRCDATE_ipkg-utils-native ?= "20050930"
SRCDATE_kaffe-qt ?= "20060814"
SRCDATE_kbdd ?= "20061019"
SRCDATE_led ?= "20060814"
SRCDATE_linux-input ?= "20060814"
SRCDATE_madwifi-modules ?= "20060814"
SRCDATE_maemo-mapper-nohildon ?= "20061114"
SRCDATE_mileage ?= "20060814"
SRCDATE_minimo ?= "20050401"
SRCDATE_mpd ?= "20070210"
SRCDATE_mystun-server ?= "20060814"
SRCDATE_olsrd ?= "20060814"
SRCDATE_opencvs ?= "20060814"
SRCDATE_oprofile ?= "20080210"
SRCDATE_portaudio ?= "20060814"
SRCDATE_putty ?= "20060814"
SRCDATE_python-cairo ?= "20060814"
SRCDATE_qemu-native ?= "20070613"
SRCDATE_rdesktop ?= "20080917"
SRCDATE_roadster ?= "20060814"
SRCDATE_rosetta ?= "20090514"
SRCDATE_sctzap ?= "20060814"
SRCDATE_squashfs ?= "20091110"
SRCDATE_tslib ?= "20051101"
SRCDATE_waimea ?= "20060814"
SRCDATE_xcompmgr ?= "20060814"
SRCDATE_xirssi ?= "20060814"
SRCDATE_xsvg ?= "20060814"
SRCDATE_yamonenv ?= "20051022"
SRCDATE_zaurusd ?= "20090501"

# Freedesktop.org
SRCDATE_poppler0.6 = "20070708"

# aleph1/yaffs
SRCDATE_yaffs2-utils = "20080331"
SRCDATE_yaffs2-utils-native = "20080331"
```

## conf/distro/include/sane-srcrevs-fso.inc
```bitbake
# To be included from sane-srcrevs.inc

# FSO Projects -- Cornucopia
FSO_CORNUCOPIA_SRCREV ?= "2619482c376880ba54389c22e3cb0305cfb87fe8"
SRCREV_pn-fso-abyss ?= "${FSO_CORNUCOPIA_SRCREV}"
SRCREV_pn-fso-apm ?= "${FSO_CORNUCOPIA_SRCREV}"
SRCREV_pn-fso-boot ?= "${FSO_CORNUCOPIA_SRCREV}"
SRCREV_pn-fsodatad ?= "${FSO_CORNUCOPIA_SRCREV}"
SRCREV_pn-fsodeviced ?= "${FSO_CORNUCOPIA_SRCREV}"
SRCREV_pn-fsogsmd ?= "${FSO_CORNUCOPIA_SRCREV}"
SRCREV_pn-fsolocationd ?= "${FSO_CORNUCOPIA_SRCREV}"
SRCREV_pn-fsomusicd ?= "${FSO_CORNUCOPIA_SRCREV}"
SRCREV_pn-fsonetworkd ?= "${FSO_CORNUCOPIA_SRCREV}"
SRCREV_pn-fsotimed ?= "${FSO_CORNUCOPIA_SRCREV}"
SRCREV_pn-fsotdld ?= "${FSO_CORNUCOPIA_SRCREV}"
SRCREV_pn-fsousaged ?= "${FSO_CORNUCOPIA_SRCREV}"
SRCREV_pn-libfsobasics ?= "${FSO_CORNUCOPIA_SRCREV}"
SRCREV_pn-libfsoframework ?= "${FSO_CORNUCOPIA_SRCREV}"
SRCREV_pn-libfsotransport ?= "${FSO_CORNUCOPIA_SRCREV}"
SRCREV_pn-libfsoresource ?= "${FSO_CORNUCOPIA_SRCREV}"
SRCREV_pn-libgsm0710mux ?= "${FSO_CORNUCOPIA_SRCREV}"
SRCREV_pn-mdbus2 ?= "${FSO_CORNUCOPIA_SRCREV}"
SRCREV_pn-mterm2 ?= "${FSO_CORNUCOPIA_SRCREV}"

# FSO Projects -- Misc
SRCREV_pn-dbus-hlid ?= "5df7f49fe8881804aaab544a569fd164c3e93afb"
SRCREV_pn-frameworkd ?= "f751f2724eea23d0ca050bdf2672f9011ae09517"
SRCREV_pn-frameworkd-config-shr_FSO_REV ?= ${SRCREV_pn-frameworkd}
SRCREV_pn-fso-gpsd ?= "39e810899110a9bb302cf2064e1c0f73541fb4e6"
SRCREV_pn-fso-gsm0710muxd ?= "1d69fb5b666ac2a9e54e46978c7afa8fe5dfc3c9"
SRCREV_pn-fso-monitord ?= "b4ae1e9b10e710042624c2cf1a15b91a7d5b1d44"
SRCREV_pn-fso-sounds ?= "3a4767ec01988bd0fd8f72f0c35d6d36e5fbc815"
SRCREV_pn-fso-specs ?= "99e821f6eb865cd6a526baa808298275e96ab582"
SRCREV_pn-gsmd2 ?= "c16883a079aeff8780e5d461ec4e8348537ab4d8"
SRCREV_pn-libfso-glib ?= "f1a0b3fe2ed6e15d83ad4880b4eb7aece00f9d57"
SRCREV_pn-libframeworkd-glib ?= "487b092dd3daa12a5beff0abe1be3f53d82f4bf0"
SRCREV_pn-libgsm0710 ?= "52eea64bdbb79c09002b46e98a5e656509884f72"
SRCREV_pn-libpersistence ?= "217ad803745f8ac1f3c72c6715e2c0faefb3fd06"
FSO_PYTHONHELPERS_SRCREV ?= "63b1dff1bc8ac22efabcee8a90e957c3b2423317"
SRCREV_pn-mdbus ?= "${FSO_PYTHONHELPERS_SRCREV}"
SRCREV_pn-mickeyterm ?= "${FSO_PYTHONHELPERS_SRCREV}"
SRCREV_pn-msmcommd ?= "2ed618dd347c3245c5f62c00ce75c985ad90a0ea"
SRCREV_pn-multicat ?= "${FSO_PYTHONHELPERS_SRCREV}"
SRCREV_pn-python-pyrtc ?= "${FSO_PYTHONHELPERS_SRCREV}"
SRCREV_pn-pycd ?= "${FSO_PYTHONHELPERS_SRCREV}" 
SRCREV_pn-vala-dbus-binding-tool-native ?= "0dda9a5d7f895d67c6a778f559e929ace229e42b"
SRCREV_pn-vala-dbus-binding-tool ?= "0dda9a5d7f895d67c6a778f559e929ace229e42b"
SRCREV_pn-vala-terminal ?= "fda5f26710acfc0befe04c8f2e58b35bdba297f7"
SRCREV_pn-vala-native ?= "e98c5df3db6d47f0e2462e294be63fc8385c5916"
SRCREV_pn-zhone ?= "bd1e895f73a0e5beb2608ebe111d7ef32ee3adbc"
```

## conf/distro/include/sane-toolchain-eglibc.inc
```bitbake
# Originally brought to you by the Angstrom Distribution

# eglibc:
# [23:00] oxo: glibc (any version) on sparc does not like (repeat me) "-Os"

FULL_OPTIMIZATION = "-fexpensive-optimizations -fomit-frame-pointer -frename-registers -Os"
FULL_OPTIMIZATION_pn-perl = "-fexpensive-optimizations -fomit-frame-pointer -frename-registers -O1"
FULL_OPTIMIZATION_sparc = "-fexpensive-optimizations -fomit-frame-pointer -frename-registers -O2"

# JaMa: I promise to report bug upstream, but as it can take a while to fix it, I'll switch to -O2 here
# Tested with gcc-4.4.2 and gcc-4.4.3 on armv4t and armv5te and it fails with -Os, with gcc-4.3.3 it works OK with -Os
# Here is testcase, but you have to rebuild whole libqtxml to test it
# http://lists.shr-project.org/pipermail/shr-devel/2010-February/002169.html
FULL_OPTIMIZATION_pn-qt4-x11-free = "-fexpensive-optimizations -fomit-frame-pointer -frename-registers -O2"
# This I've seen only on armv4t, it segfaults when called from pisi, but whole test unit suite can pass
FULL_OPTIMIZATION_pn-libsyncml = "-fexpensive-optimizations -fomit-frame-pointer -frename-registers -O2"

BUILD_OPTIMIZATION_pn-perl = "-O1"
BUILD_OPTIMIZATION_sparc = "-O2"

TARGET_LINK_HASH_STYLE = "${@['-Wl,--hash-style=gnu',''][bb.data.getVar('TARGET_ARCH',d,1) in ['mips', 'mipsel']]}"

CXXFLAGS += "-fvisibility-inlines-hidden"
```

## conf/distro/include/sane-toolchain-glibc.inc
```bitbake
# Originally brought to you by the Angstrom Distribution

# glibc:

#mess with compiler flags to use -Os instead of -O2
#Please see http://free-electrons.com/doc/embedded_linux_optimizations/img47.html for some more info
# perl has some problems, see http://bugs.openembedded.net/show_bug.cgi?id=1616
# [23:00] oxo: glibc (any version) on sparc does not like (repeat me) "-Os"

FULL_OPTIMIZATION = "-fexpensive-optimizations -frename-registers -fomit-frame-pointer -O2"

FULL_OPTIMIZATION_pn-perl = "-fexpensive-optimizations -fomit-frame-pointer -frename-registers -O1"
FULL_OPTIMIZATION_pn-glibc = "-fexpensive-optimizations -fomit-frame-pointer -O2"
FULL_OPTIMIZATION_sparc = "-fexpensive-optimizations -fomit-frame-pointer -frename-registers -O2"

# gcc 4.4 and 4.5 has a problem with 'leakage' into libgcc.a with -Os
FULL_OPTIMIZATION_powerpc = "-fexpensive-optimizations -fomit-frame-pointer -frename-registers -O2"

BUILD_OPTIMIZATION_pn-perl = "-O1"
BUILD_OPTIMIZATION_pn-glibc = "-O2"
BUILD_OPTIMIZATION_sparc = "-O2"

TARGET_LINK_HASH_STYLE = "${@['-Wl,--hash-style=gnu',''][bb.data.getVar('TARGET_ARCH',d,1) in ['mips', 'mipsel', 'mips64', 'mips64el']]}"

CXXFLAGS += "-fvisibility-inlines-hidden"
```

## conf/distro/include/sane-toolchain-java.inc
```bitbake
# Set PREFFERED and VERSION stuff for working java-toolchain

PREFERRED_PROVIDER_virtual/java-initial ?= "jamvm-initial"
PREFERRED_PROVIDER_virtual/java-native ?= "jamvm-native"

# target cacao is failing to build
# without this provider we get
# DEBUG: sorted providers for java2-runtime are: [
#        '/OE/dev/recipes/cacao/cacao_0.99.4.bb', 
#        '/OE/dev/recipes/jamvm/jamvm_1.5.3.bb', 
#        '/OE/dev/recipes/openjdk/openjdk-5_6b18-1.8.5.bb']
# with this provider we get
# NOTE: selecting openjdk-6-jre to satisfy runtime java2-runtime due to PREFERRED_PROVIDER_openjdk-6-jre = openjdk-6-jre
# DEBUG: sorted providers for java2-runtime are: [
#        '/OE/dev/recipes/openjdk/openjdk-6_6b18-1.8.5.bb', 
#        '/OE/dev/recipes/cacao/cacao_0.99.4.bb', 
#        '/OE/dev/recipes/jamvm/jamvm_1.5.3.bb']
PREFERRED_PROVIDER_openjdk-6-jre = "openjdk-6-jre"

PREFERRED_VERSION_classpath-native = "0.98"
PREFERRED_VERSION_classpath = "0.98"
```

## conf/distro/include/sane-toolchain-uclibc.inc
```bitbake
# Originally brought to you by the Angstrom Distribution

# uclibc:

PREFERRED_PROVIDER_virtual/${TARGET_PREFIX}binutils = "binutils-cross"
PREFERRED_PROVIDER_virtual/${TARGET_PREFIX}libc-for-gcc = "uclibc"
PREFERRED_PROVIDER_linux-libc-headers = "linux-libc-headers"
PREFERRED_PROVIDER_virtual/libc         = "uclibc"
PREFERRED_PROVIDER_linux-libc-headers   = "linux-libc-headers"
PREFERRED_PROVIDER_virtual/libintl      = "proxy-libintl"
PREFERRED_PROVIDER_virtual/libiconv     = "libiconv"

USE_NLS ?= "no"
USE_NLS_glib-2.0-native = "yes"
USE_NLS_gcc-cross = "no"

PREFERRED_VERSION_uclibc                    ?= "${PREFERRED_UCLIBC_VERSION}"
PREFERRED_VERSION_uclibc-initial            ?= "${PREFERRED_UCLIBC_VERSION}"
PREFERRED_VERSION_uclibc-cross              ?= "${PREFERRED_UCLIBC_VERSION}"
PREFERRED_VERSION_uclibc-cross-sdk          ?= "${PREFERRED_UCLIBC_VERSION}"
PREFERRED_VERSION_uclibc-cross-initial      ?= "${PREFERRED_UCLIBC_VERSION}"
PREFERRED_VERSION_uclibc-cross-intermediate ?= "${PREFERRED_UCLIBC_VERSION}"

#mess with compiler flags to use -Os instead of -O2
#Please see http://free-electrons.com/doc/embedded_linux_optimizations/img47.html for some more info
FULL_OPTIMIZATION = "-fexpensive-optimizations -fomit-frame-pointer -frename-registers -Os -pipe"
BUILD_OPTIMIZATION += "-pipe"

# -Os compiled root file system does not boot for powerpc, root cause it still at large
# we use -O2 meanwhile
FULL_OPTIMIZATION_powerpc = "-O2 -pipe"

#Gcc will die with 'internal consistency error when using the above optimizations
#with gcc-4.2.1-atmel.1.0.3 (and probably most other avr32 gcc ports).
#However, some packages require optimizations to compile (e.g. libmad).
#It appears the guilty optimization is "-frename-registers", leaving that one 
#out allows the build to proceed normally.  -fexpensive-optimizations may be OK,
#it was removed while debugging an issue that ultimately turned out to be due
#to the ICE fixed by gcc-pr32889.patch.  It needs to be tested again. 
#Note that this testing was done without the gcc-pr32889.patch.
FULL_OPTIMIZATION_avr32 = "-Os -fomit-frame-pointer"

TARGET_LINK_HASH_STYLE = "${@['-Wl,--hash-style=gnu',''][bb.data.getVar('TARGET_ARCH',d,1) in ['mips', 'mipsel', 'mips64', 'mips64el', 'avr32']]}"

CXXFLAGS += "-fvisibility-inlines-hidden"
```
