## conf/distro/include/preferred-shr-versions.inc
```bitbake
# Upgraded
# use newer version then preferred by default
PREFERRED_VERSION_libmikmod = "3.2.0-beta2"
PREFERRED_VERSION_strace = "4.5.15"
PREFERRED_VERSION_emacs-x11 = "23.1"
PREFERRED_VERSION_python-pycairo = "1.8.0"
PREFERRED_VERSION_libsoup-2.4 = "2.33.6"

# we need new headers for libc, now OLDEST_KERNEL_linux-gnueabi = "2.6.24"
# and 2.6.31 for fsodeviced
LINUX_LIBC_HEADERS_VERSION ?= "2.6.32"
PREFERRED_VERSION_linux-libc-headers = "${LINUX_LIBC_HEADERS_VERSION}"
PREFERRED_VERSION_linux-libc-headers-native = "${LINUX_LIBC_HEADERS_VERSION}"

# specifically set an openssh version
# NOTE: whenever changing the version here make sure
#       to check we won't loose our specific config !!!
PREFERRED_VERSION_openssh = "5.2p1"

# upgrades used in Angstrom
PREFERRED_VERSION_xserver-common = "1.33"
PREFERRED_VERSION_xserver-nodm-init = "2.0"
PREFERRED_VERSION_hal           = "0.5.13"
PREFERRED_VERSION_wpa-supplicant = "0.6.9"
PREFERRED_VERSION_openssl = "1.0.0d"
PREFERRED_VERSION_openssl-native = "1.0.0d"
PREFERRED_VERSION_perl = "5.10.1"
PREFERRED_VERSION_perl-native = "5.10.1"
UDEV_GE_141 = "1"

ANGSTROM_QT_VERSION ?= "4.7.1"
PREFERRED_VERSION_qt4-tools-native = "${ANGSTROM_QT_VERSION}"
PREFERRED_VERSION_qt4-tools-sdk = "${ANGSTROM_QT_VERSION}"
PREFERRED_VERSION_qt4-embedded = "${ANGSTROM_QT_VERSION}"
PREFERRED_VERSION_qt4-embedded-gles = "${ANGSTROM_QT_VERSION}"
PREFERRED_VERSION_qt4-x11-free = "${ANGSTROM_QT_VERSION}"
PREFERRED_VERSION_qt4-x11-free-gles = "${ANGSTROM_QT_VERSION}"

PREFERRED_VERSION_tslib = "1.0+git%"

# epdf needs > 0.12, but recipes have D_P = -1
PREFERRED_VERSION_poppler = "0.12.3"

# git version fails to build
PREFERRED_VERSION_mupdf = "0.6"

# Downgraded
PREFERRED_VERSION_pulseaudio = "0.9.15"
```

## conf/distro/include/preferred-slugos-versions.inc
```bitbake
#===========================================================================#
#===========================================================================#
#                              NOTE NOTE NOTE
#
# This *forces* the preferred kernel version; making it unable to be overridden
# in the local.conf file.  This is a Very Bad Thing.  This is temporary, and
# is intended to facilitate some SlugOS-specific testing without disturbing
# other distros that use the ixp4xx machine type (which is currently where the
# preferred kernel version is set).
#
# This *must* be removed after initial testing is completed.  MJW 08-Dec-2008
#
SRCREV_pn-linux-ixp4xx ?= "1091"
PREFERRED_VERSION_linux-ixp4xx = "2.6.37+svnr${SRCREV_pn-linux-ixp4xx}"
#
#===========================================================================#
#===========================================================================#

### Standard package preferred versions go here, sorted
### alphabetically.  Note that the main slugos.inc file
### may include preferred versions for toolchain components.

PREFERRED_VERSION_atk				?= "1.28.0"
PREFERRED_VERSION_atk-native			?= "1.28.0"
PREFERRED_VERSION_autoconf			?= "2.65"
PREFERRED_VERSION_autoconf-native		?= "2.65"
PREFERRED_VERSION_automake			?= "1.11.1"
PREFERRED_VERSION_automake-native		?= "1.11.1"
PREFERRED_VERSION_busybox			?= "1.18.3"
PREFERRED_VERSION_dbus				?= "1.4.1"
PREFERRED_VERSION_glib-2.0			?= "2.26.1"
PREFERRED_VERSION_glib-2.0-native		?= "2.26.1"
PREFERRED_VERSION_gvfs				?= "1.6.6"
PREFERRED_VERSION_linux-libc-headers		?= "2.6.31"
PREFERRED_VERSION_m4				?= "1.4.14"
PREFERRED_VERSION_m4-native			?= "1.4.14"
PREFERRED_VERSION_nslu2-linksys-firmware	?= "2.3r63"
PREFERRED_VERSION_perl				?= "5.10.1"
PREFERRED_VERSION_perl-native			?= "5.10.1"
PREFERRED_VERSION_pkgconfig			?= "0.23"
PREFERRED_VERSION_pkgconfig-native		?= "0.23"
PREFERRED_VERSION_udev				?= "118"
```
