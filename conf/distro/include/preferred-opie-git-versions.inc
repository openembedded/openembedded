## conf/distro/include/preferred-xorg-versions-X11R7.5.inc
```bitbake
# see http://www.x.org/wiki/Releases/7.5
# 7.5 was released on 2009-10-26

PREFERRED_PROVIDER_virtual/xserver ?= "xserver-xorg"

PREFERRED_PROVIDER_libxext ?= "libxext"
PREFERRED_PROVIDER_xext ?= "libxext"
PREFERRED_PROVIDER_libxi ?= "libxi"
PREFERRED_PROVIDER_libxft ?= "libxft"
PREFERRED_PROVIDER_virtual/libx11 ?= "libx11"
PREFERRED_PROVIDER_libxpm ?= "libxpm"
PREFERRED_PROVIDER_xpm ?= "libxpm"
PREFERRED_PROVIDER_libxt ?= "libxt"
PREFERRED_PROVIDER_libxaw ?= "libxaw"
PREFERRED_PROVIDER_libice ?= "libice"
PREFERRED_PROVIDER_libxrender ?= "libxrender"
PREFERRED_PROVIDER_libxcursor ?= "libxcursor"
PREFERRED_PROVIDER_xextensions ?= "xextensions"
PREFERRED_PROVIDER_xproto ?= "xproto"
PREFERRED_PROVIDER_x11 ?= "libx11"
PREFERRED_PROVIDER_libxv ?= "libxv"
PREFERRED_PROVIDER_xft ?= "libxft"
PREFERRED_PROVIDER_libxrandr ?= "libxrandr"
PREFERRED_PROVIDER_libxdamage ?= "libxdamage"
PREFERRED_PROVIDER_libxcomposite ?= "libxcomposite"
PREFERRED_PROVIDER_libxfixes ?= "libxfixes"
PREFERRED_PROVIDER_libxinerama ?= "libxinerama"
PREFERRED_PROVIDER_libxxf86vm ?= "libxxf86vm"
PREFERRED_PROVIDER_libxmu ?= "libxmu"
PREFERRED_PROVIDER_libsm ?= "libsm"
PREFERRED_PROVIDER_xrandr ?= "xrandr"
PREFERRED_PROVIDER_xserver ?= "xserver-xorg"
PREFERRED_PROVIDER_virtual/xorg ?= "xserver-xorg"

PREFERRED_VERSION_task-xorg ?= "X11R7.5"

# app
PREFERRED_VERSION_bdftopcf ?= "1.0.2"
PREFERRED_VERSION_bdftopcf-native ?= "1.0.2"
PREFERRED_VERSION_iceauth ?= "1.0.3"
PREFERRED_VERSION_luit ?= "1.0.4"
PREFERRED_VERSION_mkfontdir ?= "1.0.5"
PREFERRED_VERSION_mkfontdir-native ?= "1.0.5"
PREFERRED_VERSION_mkfontscale ?= "1.0.7"
PREFERRED_VERSION_mkfontscale-native ?= "1.0.7"
PREFERRED_VERSION_sessreg ?= "1.0.5"
PREFERRED_VERSION_setxkbmap ?= "1.1.0"
PREFERRED_VERSION_smproxy ?= "1.0.3"
PREFERRED_VERSION_x11perf ?= "1.5.1"
PREFERRED_VERSION_xauth ?= "1.0.4"
PREFERRED_VERSION_xbacklight ?= "1.1.1"
PREFERRED_VERSION_xcmsdb ?= "1.0.2"
PREFERRED_VERSION_xcursorgen ?= "1.0.3"
PREFERRED_VERSION_xcursorgen-native ?= "1.0.3"
PREFERRED_VERSION_xdpyinfo ?= "1.1.0"
PREFERRED_VERSION_xdriinfo ?= "1.0.3"
PREFERRED_VERSION_xev ?= "1.0.4"
PREFERRED_VERSION_xgamma ?= "1.0.3"
PREFERRED_VERSION_xhost ?= "1.0.3"
PREFERRED_VERSION_xinput ?= "1.5.0"
PREFERRED_VERSION_xkbcomp ?= "1.1.1"
PREFERRED_VERSION_xkbcomp-native ?= "1.1.1"
PREFERRED_VERSION_xkbevd ?= "1.1.0"
PREFERRED_VERSION_xkbutils ?= "1.0.2"
PREFERRED_VERSION_xkill ?= "1.0.2"
PREFERRED_VERSION_xlsatoms ?= "1.0.2"
PREFERRED_VERSION_xlsclients ?= "1.0.2"
PREFERRED_VERSION_xmodmap ?= "1.0.4"
PREFERRED_VERSION_xpr ?= "1.0.3"
PREFERRED_VERSION_xprop ?= "1.1.0"
PREFERRED_VERSION_xrandr ?= "1.3.2"
PREFERRED_VERSION_xrdb ?= "1.0.6"
PREFERRED_VERSION_xrefresh ?= "1.0.3"
PREFERRED_VERSION_xset ?= "1.1.0"
PREFERRED_VERSION_xsetroot ?= "1.0.3"
PREFERRED_VERSION_xvinfo ?= "1.1.0"
PREFERRED_VERSION_xwd ?= "1.0.3"
PREFERRED_VERSION_xwininfo ?= "1.0.5"
PREFERRED_VERSION_xwud ?= "1.0.2"

# data
PREFERRED_VERSION_xbitmaps ?= "1.1.0"
PREFERRED_VERSION_xcursor-themes ?= "1.0.2"

# doc
PREFERRED_VERSION_xorg-docs ?= "1.5"
PREFERRED_VERSION_xorg-sgml-doctools ?= "1.3"

# driver
PREFERRED_VERSION_xf86-input-acecad ?= "1.4.0"
PREFERRED_VERSION_xf86-input-aiptek ?= "1.3.0"
PREFERRED_VERSION_xf86-input-evdev ?= "2.3.0"
PREFERRED_VERSION_xf86-input-joystick ?= "1.5.0"
PREFERRED_VERSION_xf86-input-keyboard ?= "1.4.0"
PREFERRED_VERSION_xf86-input-mouse ?= "1.5.0"
PREFERRED_VERSION_xf86-input-synaptics ?= "1.2.0"
PREFERRED_VERSION_xf86-input-vmmouse ?= "12.6.5"
PREFERRED_VERSION_xf86-input-void ?= "1.3.0"
PREFERRED_VERSION_xf86-video-apm ?= "1.2.2"
PREFERRED_VERSION_xf86-video-ark ?= "0.7.2"
PREFERRED_VERSION_xf86-video-ast ?= "0.89.9"
PREFERRED_VERSION_xf86-video-ati ?= "6.12.4"
PREFERRED_VERSION_xf86-video-chips ?= "1.2.2"
PREFERRED_VERSION_xf86-video-cirrus ?= "1.3.2"
PREFERRED_VERSION_xf86-video-dummy ?= "0.3.2"
PREFERRED_VERSION_xf86-video-fbdev ?= "0.4.1"
PREFERRED_VERSION_xf86-video-geode ?= "2.11.6"
PREFERRED_VERSION_xf86-video-glint ?= "1.2.4"
PREFERRED_VERSION_xf86-video-i128 ?= "1.3.3"
PREFERRED_VERSION_xf86-video-i740 ?= "1.3.2"
PREFERRED_VERSION_xf86-video-intel ?= "2.9.1"
PREFERRED_VERSION_xf86-video-mach64 ?= "6.8.2"
PREFERRED_VERSION_xf86-video-mga ?= "1.4.11"
PREFERRED_VERSION_xf86-video-neomagic ?= "1.2.4"
PREFERRED_VERSION_xf86-video-newport ?= "0.2.3"
PREFERRED_VERSION_xf86-video-nv ?= "2.1.15"
PREFERRED_VERSION_xf86-video-openchrome ?= "0.2.904"
PREFERRED_VERSION_xf86-video-r128 ?= "6.8.1"
PREFERRED_VERSION_xf86-video-rendition ?= "4.2.3"
PREFERRED_VERSION_xf86-video-s3 ?= "0.6.3"
PREFERRED_VERSION_xf86-video-s3virge ?= "1.10.4"
PREFERRED_VERSION_xf86-video-savage ?= "2.3.1"
PREFERRED_VERSION_xf86-video-siliconmotion ?= "1.7.3"
PREFERRED_VERSION_xf86-video-sis ?= "0.10.2"
PREFERRED_VERSION_xf86-video-sisusb ?= "0.9.3"
PREFERRED_VERSION_xf86-video-suncg14 ?= "1.1.1"
PREFERRED_VERSION_xf86-video-suncg3 ?= "1.1.1"
PREFERRED_VERSION_xf86-video-suncg6 ?= "1.1.1"
PREFERRED_VERSION_xf86-video-sunffb ?= "1.2.1"
PREFERRED_VERSION_xf86-video-sunleo ?= "1.2.0"
PREFERRED_VERSION_xf86-video-suntcx ?= "1.1.1"
PREFERRED_VERSION_xf86-video-tdfx ?= "1.4.3"
PREFERRED_VERSION_xf86-video-tga ?= "1.2.1"
PREFERRED_VERSION_xf86-video-trident ?= "1.3.3"
PREFERRED_VERSION_xf86-video-tseng ?= "1.2.3"
PREFERRED_VERSION_xf86-video-v4l ?= "0.2.0"
PREFERRED_VERSION_xf86-video-vesa ?= "2.2.1"
PREFERRED_VERSION_xf86-video-vmware ?= "10.16.8"
PREFERRED_VERSION_xf86-video-voodoo ?= "1.2.3"
PREFERRED_VERSION_xf86-video-wsfb ?= "0.3.0"
PREFERRED_VERSION_xf86-video-xgi ?= "1.5.1"
PREFERRED_VERSION_xf86-video-xgixp ?= "1.7.99.4"

# font
PREFERRED_VERSION_encodings ?= "1.0.3"
PREFERRED_VERSION_font-adobe-100dpi ?= "1.0.1"
PREFERRED_VERSION_font-adobe-75dpi ?= "1.0.1"
PREFERRED_VERSION_font-adobe-utopia-100dpi ?= "1.0.2"
PREFERRED_VERSION_font-adobe-utopia-75dpi ?= "1.0.2"
PREFERRED_VERSION_font-adobe-utopia-type1 ?= "1.0.2"
PREFERRED_VERSION_font-alias ?= "1.0.2"
PREFERRED_VERSION_font-arabic-misc ?= "1.0.1"
PREFERRED_VERSION_font-bh-100dpi ?= "1.0.1"
PREFERRED_VERSION_font-bh-75dpi ?= "1.0.1"
PREFERRED_VERSION_font-bh-lucidatypewriter-100dpi ?= "1.0.1"
PREFERRED_VERSION_font-bh-lucidatypewriter-75dpi ?= "1.0.1"
PREFERRED_VERSION_font-bh-ttf ?= "1.0.1"
PREFERRED_VERSION_font-bh-type1 ?= "1.0.1"
PREFERRED_VERSION_font-bitstream-100dpi ?= "1.0.1"
PREFERRED_VERSION_font-bitstream-75dpi ?= "1.0.1"
PREFERRED_VERSION_font-bitstream-type1 ?= "1.0.1"
PREFERRED_VERSION_font-cronyx-cyrillic ?= "1.0.1"
PREFERRED_VERSION_font-cursor-misc ?= "1.0.1"
PREFERRED_VERSION_font-daewoo-misc ?= "1.0.1"
PREFERRED_VERSION_font-dec-misc ?= "1.0.1"
PREFERRED_VERSION_font-ibm-type1 ?= "1.0.1"
PREFERRED_VERSION_font-isas-misc ?= "1.0.1"
PREFERRED_VERSION_font-jis-misc ?= "1.0.1"
PREFERRED_VERSION_font-micro-misc ?= "1.0.1"
PREFERRED_VERSION_font-misc-cyrillic ?= "1.0.1"
PREFERRED_VERSION_font-misc-ethiopic ?= "1.0.1"
PREFERRED_VERSION_font-misc-meltho ?= "1.0.1"
PREFERRED_VERSION_font-misc-misc ?= "1.1.0"
PREFERRED_VERSION_font-mutt-misc ?= "1.0.1"
PREFERRED_VERSION_font-schumacher-misc ?= "1.1.0"
PREFERRED_VERSION_font-screen-cyrillic ?= "1.0.2"
PREFERRED_VERSION_font-sony-misc ?= "1.0.1"
PREFERRED_VERSION_font-sun-misc ?= "1.0.1"
PREFERRED_VERSION_font-util ?= "1.1.1"
PREFERRED_VERSION_font-util-native ?= "1.1.1"
PREFERRED_VERSION_font-winitzki-cyrillic ?= "1.0.1"
PREFERRED_VERSION_font-xfree86-type1 ?= "1.0.2"

# lib
PREFERRED_VERSION_libapplewm ?= "1.4.0"
PREFERRED_VERSION_libfs ?= "1.0.2"
PREFERRED_VERSION_libice ?= "1.0.6"
PREFERRED_VERSION_libice-native ?= "1.0.6"
PREFERRED_VERSION_libsm ?= "1.1.1"
PREFERRED_VERSION_libsm-native ?= "1.1.1"
PREFERRED_VERSION_libwindowswm ?= "1.0.1"
PREFERRED_VERSION_libx11 ?= "1.3.2"
PREFERRED_VERSION_libx11-native ?= "1.3.2"
PREFERRED_VERSION_libxscrnsaver ?= "1.2.0"
PREFERRED_VERSION_libxau ?= "1.0.5"
PREFERRED_VERSION_libxau-native ?= "1.0.5"
PREFERRED_VERSION_libxaw ?= "1.0.7"
PREFERRED_VERSION_libxcomposite ?= "0.4.1"
PREFERRED_VERSION_libxcursor ?= "1.1.10"
PREFERRED_VERSION_libxcursor-native ?= "1.1.10"
PREFERRED_VERSION_libxdamage ?= "1.1.2"
PREFERRED_VERSION_libxdmcp ?= "1.0.3"
PREFERRED_VERSION_libxdmcp-native ?= "1.0.3"
PREFERRED_VERSION_libxext ?= "1.1.1"
PREFERRED_VERSION_libxext-native ?= "1.1.1"
PREFERRED_VERSION_libxfixes ?= "4.0.4"
PREFERRED_VERSION_libxfixes-native ?= "4.0.4"
PREFERRED_VERSION_libxfont ?= "1.4.1"
PREFERRED_VERSION_libxfont-native ?= "1.4.1"
PREFERRED_VERSION_libxft ?= "2.1.14"
PREFERRED_VERSION_libxi ?= "1.3"
PREFERRED_VERSION_libxinerama ?= "1.1"
PREFERRED_VERSION_libxmu ?= "1.0.5"
PREFERRED_VERSION_libxpm ?= "3.5.8"
PREFERRED_VERSION_libxrandr ?= "1.3.0"
PREFERRED_VERSION_libxrender ?= "0.9.5"
PREFERRED_VERSION_libxrender-native ?= "0.9.5"
PREFERRED_VERSION_libxres ?= "1.0.4"
PREFERRED_VERSION_libxt ?= "1.0.7"
PREFERRED_VERSION_libxt-native ?= "1.0.7"
PREFERRED_VERSION_libxtst ?= "1.1.0"
PREFERRED_VERSION_libxv ?= "1.0.5"
PREFERRED_VERSION_libxvmc ?= "1.0.5"
PREFERRED_VERSION_libxxf86dga ?= "1.1.1"
PREFERRED_VERSION_libxxf86vm ?= "1.1.0"
PREFERRED_VERSION_libdmx ?= "1.1.0"
PREFERRED_VERSION_libfontenc ?= "1.0.5"
PREFERRED_VERSION_libfontenc-native ?= "1.0.5"
PREFERRED_VERSION_libpciaccess ?= "0.10.9"
PREFERRED_VERSION_libxkbfile ?= "1.0.6"
PREFERRED_VERSION_libxkbfile-native ?= "1.0.6"
PREFERRED_VERSION_mesa ?= "7.2"
PREFERRED_VERSION_mesa-dri ?= "7.2"
PREFERRED_VERSION_mesa-xlib ?= "7.2"
PREFERRED_VERSION_xtrans ?= "1.2.5"
PREFERRED_VERSION_xtrans-native ?= "1.2.5"

# proto
PREFERRED_VERSION_applewmproto ?= "1.4.1"
PREFERRED_VERSION_bigreqsproto ?= "1.1.0"
PREFERRED_VERSION_bigreqsproto-native ?= "1.1.0"
PREFERRED_VERSION_compositeproto ?= "0.4.1"
PREFERRED_VERSION_damageproto ?= "1.2.0"
PREFERRED_VERSION_dmxproto ?= "2.3"
PREFERRED_VERSION_dri2proto ?= "2.1"
PREFERRED_VERSION_fixesproto ?= "4.1.1"
PREFERRED_VERSION_fixesproto-native ?= "4.1.1"
PREFERRED_VERSION_fontsproto ?= "2.1.0"
PREFERRED_VERSION_fontsproto-native ?= "2.1.0"
PREFERRED_VERSION_glproto ?= "1.4.10"
PREFERRED_VERSION_inputproto ?= "2.0"
PREFERRED_VERSION_inputproto-native ?= "2.0"
PREFERRED_VERSION_kbproto ?= "1.0.4"
PREFERRED_VERSION_kbproto-native ?= "1.0.4"
PREFERRED_VERSION_randrproto ?= "1.3.1"
PREFERRED_VERSION_recordproto ?= "1.14"
PREFERRED_VERSION_renderproto ?= "0.11"
PREFERRED_VERSION_renderproto-native ?= "0.11"
PREFERRED_VERSION_resourceproto ?= "1.1.0"
PREFERRED_VERSION_scrnsaverproto ?= "1.2.0"
PREFERRED_VERSION_videoproto ?= "2.3.0"
PREFERRED_VERSION_windowswmproto ?= "1.0.4"
PREFERRED_VERSION_xcmiscproto ?= "1.2.0"
PREFERRED_VERSION_xcmiscproto-native ?= "1.2.0"
PREFERRED_VERSION_xextproto ?= "7.1.1"
PREFERRED_VERSION_xextproto-native ?= "7.1.1"
PREFERRED_VERSION_xf86bigfontproto ?= "1.2.0"
PREFERRED_VERSION_xf86bigfontproto-native ?= "1.2.0"
PREFERRED_VERSION_xf86dgaproto ?= "2.1"
PREFERRED_VERSION_xf86driproto ?= "2.1.0"
PREFERRED_VERSION_xf86vidmodeproto ?= "2.3"
PREFERRED_VERSION_xineramaproto ?= "1.2"
PREFERRED_VERSION_xproto ?= "7.0.16"
PREFERRED_VERSION_xproto-native ?= "7.0.16"

# util
PREFERRED_VERSION_makedepend ?= "1.0.2"
PREFERRED_VERSION_makedepend-native ?= "1.0.2"
PREFERRED_VERSION_util-macros ?= "1.3.0"
PREFERRED_VERSION_util-macros-native ?= "1.3.0"

# xserver
PREFERRED_VERSION_xserver-xorg ?= "1.7.1"

require conf/distro/include/preferred-xorg-versions-X11R7.5-latest.inc
```
