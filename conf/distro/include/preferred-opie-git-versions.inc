## conf/distro/include/preferred-opie-versions-1.2.4-pre.inc
```bitbake
#
# Default versions
QTE_VERSION ?= "2.3.10"
PALMTOP_USE_MULTITHREADED_QT ?= "yes"

OPIE_SRCDATE ?= "20070727"
OPIE_VERSION ?= "1.2.3+cvs${OPIE_SRCDATE}"
OPIE_CVS_PV ?= "1.2.3+cvs${OPIE_SRCDATE}"

#
#
# Opie libraries
#
PREFERRED_PROVIDER_virtual/libqte2 = '${@base_conditional("PALMTOP_USE_MULTITHREADED_QT", "yes", "qte-mt", "qte", d)}'
PREFERRED_PROVIDER_virtual/libqpe1 = "libqpe-opie"
PREFERRED_VERSION_qte-mt = "${QTE_VERSION}"
PREFERRED_VERSION_qte = "${QTE_VERSION}"

PREFERRED_VERSION_libopie2 ?= "${OPIE_VERSION}"
PREFERRED_VERSION_libopieobex0 = "${OPIE_VERSION}"
PREFERRED_VERSION_libopietooth1 = "${OPIE_VERSION}"
PREFERRED_VERSION_libqpe-opie = "${OPIE_VERSION}"
PREFERRED_VERSION_libqtaux2 = "${OPIE_VERSION}"
PREFERRED_VERSION_libmailwrapper = "${OPIE_VERSION}"

SRCDATE_libopie2 ?= "${OPIE_SRCDATE}"
SRCDATE_libopieobex0 = "${OPIE_SRCDATE}"
SRCDATE_libopietooth1 = "${OPIE_SRCDATE}"
SRCDATE_libqpe-opie = "${OPIE_SRCDATE}"
SRCDATE_libqtaux2 = "${OPIE_SRCDATE}"
SRCDATE_libmailwrapper = "${OPIE_SRCDATE}"

#
# Opie applications
#
PREFERRED_VERSION_opie-aboutapplet = "${OPIE_VERSION}"
PREFERRED_VERSION_opie-addressbook = "${OPIE_VERSION}"
PREFERRED_VERSION_opie-advancedfm = "${OPIE_VERSION}"
PREFERRED_VERSION_opie-alarm = "${OPIE_VERSION}"
PREFERRED_VERSION_opie-appearance = "${OPIE_VERSION}"
PREFERRED_VERSION_opie-aqpkg = "${OPIE_VERSION}"
PREFERRED_VERSION_opie-autorotateapplet = "${OPIE_VERSION}"
PREFERRED_VERSION_opie-backgammon = "${OPIE_VERSION}"
PREFERRED_VERSION_opie-backup = "${OPIE_VERSION}"
PREFERRED_VERSION_opie-bartender = "${OPIE_VERSION}"
PREFERRED_VERSION_opie-batteryapplet = "${OPIE_VERSION}"
PREFERRED_VERSION_opie-bluepin ?= "${OPIE_VERSION}"
PREFERRED_VERSION_opie-bluetoothapplet ?= "${OPIE_VERSION}"
PREFERRED_VERSION_opie-bluetoothmanager ?= "${OPIE_VERSION}"
PREFERRED_VERSION_opie-bounce = "${OPIE_VERSION}"
PREFERRED_VERSION_opie-brightnessapplet = "${OPIE_VERSION}"
PREFERRED_VERSION_opie-button-settings = "${OPIE_VERSION}"
PREFERRED_VERSION_opie-buzzword = "${OPIE_VERSION}"
PREFERRED_VERSION_opie-calculator = "${OPIE_VERSION}"
PREFERRED_VERSION_opie-calibrate = "${OPIE_VERSION}"
PREFERRED_VERSION_opie-camera = "${OPIE_VERSION}"
PREFERRED_VERSION_opie-cardmon = "${OPIE_VERSION}"
PREFERRED_VERSION_opie-checkbook = "${OPIE_VERSION}"
PREFERRED_VERSION_opie-citytime = "${OPIE_VERSION}"
PREFERRED_VERSION_opie-clipboardapplet = "${OPIE_VERSION}"
PREFERRED_VERSION_opie-clockapplet = "${OPIE_VERSION}"
PREFERRED_VERSION_opie-clock = "${OPIE_VERSION}"
PREFERRED_VERSION_opie-confeditor = "${OPIE_VERSION}"
PREFERRED_VERSION_opie-console = "${OPIE_VERSION}"
PREFERRED_VERSION_opie-dagger = "${OPIE_VERSION}"
PREFERRED_VERSION_opie-dasher = "${OPIE_VERSION}"
PREFERRED_VERSION_opie-datebook = "${OPIE_VERSION}"
PREFERRED_VERSION_opie-datebook-chrisholidayplugin = "${OPIE_VERSION}"
PREFERRED_VERSION_opie-datebook-nationalholidayplugin = "${OPIE_VERSION}"
PREFERRED_VERSION_opie-datebook-birthdayplugin = "${OPIE_VERSION}"
PREFERRED_VERSION_opie-deco-flat = "${OPIE_VERSION}"
PREFERRED_VERSION_opie-deco-liquid = "${OPIE_VERSION}"
PREFERRED_VERSION_opie-deco-polished = "${OPIE_VERSION}"
PREFERRED_VERSION_opie-doctab = "${OPIE_VERSION}"
PREFERRED_VERSION_opie-drawpad = "${OPIE_VERSION}"
PREFERRED_VERSION_opie-dvorak = "${OPIE_VERSION}"
PREFERRED_VERSION_opie-embeddedkonsole = "${OPIE_VERSION}"
PREFERRED_VERSION_opie-euroconv = "${OPIE_VERSION}"
PREFERRED_VERSION_opie-examples-python = "${OPIE_VERSION}"
PREFERRED_VERSION_opie-examples = "${OPIE_VERSION}"
PREFERRED_VERSION_opie-eye = "${OPIE_VERSION}"
PREFERRED_VERSION_opie-fifteen = "${OPIE_VERSION}"
PREFERRED_VERSION_opie-formatter = "${OPIE_VERSION}"
PREFERRED_VERSION_opie-freetype = "${OPIE_VERSION}"
PREFERRED_VERSION_opie-ftplib = "${OPIE_VERSION}"
PREFERRED_VERSION_opie-ftp = "${OPIE_VERSION}"
PREFERRED_VERSION_opie-go = "${OPIE_VERSION}"
PREFERRED_VERSION_opie-gutenbrowser = "${OPIE_VERSION}"
PREFERRED_VERSION_opie-handwriting = "${OPIE_VERSION}"
PREFERRED_VERSION_opie-helpbrowser = "${OPIE_VERSION}"
PREFERRED_VERSION_opie-help-en = "${OPIE_VERSION}"
PREFERRED_VERSION_opie-homeapplet = "${OPIE_VERSION}"
PREFERRED_VERSION_opie-i18n = "${OPIE_VERSION}"
PREFERRED_VERSION_opie-lrelease-native = "${OPIE_VERSION}"
PREFERRED_VERSION_opie-lupdate-native = "${OPIE_VERSION}"
PREFERRED_VERSION_opie-icon-reload = "${OPIE_VERSION}"
PREFERRED_VERSION_opie-irc = "${OPIE_VERSION}"
PREFERRED_VERSION_opie-irdaapplet = "${OPIE_VERSION}"
PREFERRED_VERSION_opie-jumpx = "${OPIE_VERSION}"
PREFERRED_VERSION_opie-kbill = "${OPIE_VERSION}"
PREFERRED_VERSION_opie-kcheckers = "${OPIE_VERSION}"
PREFERRED_VERSION_opie-keyboard = "${OPIE_VERSION}"
PREFERRED_VERSION_opie-keypebble = "${OPIE_VERSION}"
PREFERRED_VERSION_opie-keytabs = "${OPIE_VERSION}"
PREFERRED_VERSION_opie-keyview = "${OPIE_VERSION}"
PREFERRED_VERSION_opie-kjumpx = "${OPIE_VERSION}"
PREFERRED_VERSION_opie-kpacman = "${OPIE_VERSION}"
PREFERRED_VERSION_opie-language = "${OPIE_VERSION}"
PREFERRED_VERSION_opie-launcher-settings = "${OPIE_VERSION}"
PREFERRED_VERSION_opie-libqrsync = "${OPIE_VERSION}"
PREFERRED_VERSION_opie-light-and-power = "${OPIE_VERSION}"
PREFERRED_VERSION_opie-lockapplet = "${OPIE_VERSION}"
PREFERRED_VERSION_opie-login = "${OPIE_VERSION}"
PREFERRED_VERSION_opie-logoutapplet = "${OPIE_VERSION}"
PREFERRED_VERSION_opie-mailapplet = "${OPIE_VERSION}"
PREFERRED_VERSION_opie-mail = "${OPIE_VERSION}"
PREFERRED_VERSION_opie-mediaplayer1-libmadplugin = "${OPIE_VERSION}"
PREFERRED_VERSION_opie-mediaplayer1-libmodplugin = "${OPIE_VERSION}"
PREFERRED_VERSION_opie-mediaplayer1-libtremorplugin = "${OPIE_VERSION}"
PREFERRED_VERSION_opie-mediaplayer1-libwavplugin = "${OPIE_VERSION}"
PREFERRED_VERSION_opie-mediaplayer1-core = "${OPIE_VERSION}"
PREFERRED_VERSION_opie-mediaplayer1 = "${OPIE_VERSION}"
PREFERRED_VERSION_opie-mediaplayer2 = "${OPIE_VERSION}"
PREFERRED_VERSION_opie-mediaplayer2-skin-default = "${OPIE_VERSION}"
PREFERRED_VERSION_opie-mediaplayer2-skin-default-landscape = "${OPIE_VERSION}"
PREFERRED_VERSION_opie-mediaplayer2-skin-pod = "${OPIE_VERSION}"
PREFERRED_VERSION_opie-mediaplayer2-skin-techno = "${OPIE_VERSION}"
PREFERRED_VERSION_opie-mediummount = "${OPIE_VERSION}"
PREFERRED_VERSION_opie-memoryapplet = "${OPIE_VERSION}"
PREFERRED_VERSION_opie-mindbreaker = "${OPIE_VERSION}"
PREFERRED_VERSION_opie-minesweep = "${OPIE_VERSION}"
PREFERRED_VERSION_opie-mobilemsg = "${OPIE_VERSION}"
PREFERRED_VERSION_opie-multikeyapplet = "${OPIE_VERSION}"
PREFERRED_VERSION_opie-multikey = "${OPIE_VERSION}"
PREFERRED_VERSION_opie-networkapplet = "${OPIE_VERSION}"
PREFERRED_VERSION_opie-networksettings = "${OPIE_VERSION}"
PREFERRED_VERSION_opie-notesapplet = "${OPIE_VERSION}"
PREFERRED_VERSION_opie-odict = "${OPIE_VERSION}"
PREFERRED_VERSION_opie-osearch = "${OPIE_VERSION}"
PREFERRED_VERSION_opie-oxygen = "${OPIE_VERSION}"
PREFERRED_VERSION_opie-oyatzee = "${OPIE_VERSION}"
PREFERRED_VERSION_opie-packagemanager = "${OPIE_VERSION}"
PREFERRED_VERSION_opie-parashoot = "${OPIE_VERSION}"
PREFERRED_VERSION_opie-pcmciaapplet = "${OPIE_VERSION}"
PREFERRED_VERSION_opie-performance = "${OPIE_VERSION}"
PREFERRED_VERSION_opie-pickboard = "${OPIE_VERSION}"
PREFERRED_VERSION_opie-pics = "${OPIE_VERSION}"
PREFERRED_VERSION_opie-pimconverter = "${OPIE_VERSION}"
PREFERRED_VERSION_opie-powerchord = "${OPIE_VERSION}"
PREFERRED_VERSION_opie-pyquicklaunchapplet = "${OPIE_VERSION}"
PREFERRED_VERSION_opie-qasteroids = "${OPIE_VERSION}"
PREFERRED_VERSION_opie-qcop = "${OPIE_VERSION}"
PREFERRED_VERSION_opie-quicklauncher = "${OPIE_VERSION}"
PREFERRED_VERSION_opie-qss = "${OPIE_VERSION}"
PREFERRED_VERSION_opie-rdesktop = "${OPIE_VERSION}"
PREFERRED_VERSION_opie-reader = "${OPIE_VERSION}"
PREFERRED_VERSION_opie-recorder = "${OPIE_VERSION}"
PREFERRED_VERSION_opie-remote = "${OPIE_VERSION}"
PREFERRED_VERSION_opie-restartapplet2 = "${OPIE_VERSION}"
PREFERRED_VERSION_opie-restartapplet = "${OPIE_VERSION}"
PREFERRED_VERSION_opie-restartapplet = "${OPIE_VERSION}"
PREFERRED_VERSION_opie-rotateapplet = "${OPIE_VERSION}"
PREFERRED_VERSION_opie-screenshotapplet = "${OPIE_VERSION}"
PREFERRED_VERSION_opie-search = "${OPIE_VERSION}"
PREFERRED_VERSION_opie-security = "${OPIE_VERSION}"
PREFERRED_VERSION_opie-securityplugin-blueping = "${OPIE_VERSION}"
PREFERRED_VERSION_opie-securityplugin-dummy = "${OPIE_VERSION}"
PREFERRED_VERSION_opie-securityplugin-notice = "${OPIE_VERSION}"
PREFERRED_VERSION_opie-securityplugin-pin = "${OPIE_VERSION}"
PREFERRED_VERSION_opie-sfcave = "${OPIE_VERSION}"
PREFERRED_VERSION_opie-sheet = "${OPIE_VERSION}"
PREFERRED_VERSION_opie-sh = "${OPIE_VERSION}"
PREFERRED_VERSION_opie-showimg = "${OPIE_VERSION}"
PREFERRED_VERSION_opie-snake = "${OPIE_VERSION}"
PREFERRED_VERSION_opie-solitaire = "${OPIE_VERSION}"
PREFERRED_VERSION_opie-sshkeys = "${OPIE_VERSION}"
PREFERRED_VERSION_opie-style-flat = "${OPIE_VERSION}"
PREFERRED_VERSION_opie-style-fresh = "${OPIE_VERSION}"
PREFERRED_VERSION_opie-style-liquid = "${OPIE_VERSION}"
PREFERRED_VERSION_opie-style-metal = "${OPIE_VERSION}"
PREFERRED_VERSION_opie-style-phase = "${OPIE_VERSION}"
PREFERRED_VERSION_opie-style-web = "${OPIE_VERSION}"
PREFERRED_VERSION_opie-sounds = "${OPIE_VERSION}"
PREFERRED_VERSION_opie-suspendapplet = "${OPIE_VERSION}"
PREFERRED_VERSION_opie-symlinker = "${OPIE_VERSION}"
PREFERRED_VERSION_opie-sysinfo = "${OPIE_VERSION}"
PREFERRED_VERSION_opie-systemtime = "${OPIE_VERSION}"
PREFERRED_VERSION_opie-tableviewer = "${OPIE_VERSION}"
PREFERRED_VERSION_opie-tabmanager = "${OPIE_VERSION}"
PREFERRED_VERSION_opie-taskbar = "${OPIE_VERSION}"
PREFERRED_VERSION_opie-taskbar-images = "${OPIE_VERSION}"
PREFERRED_VERSION_opie-tetrix = "${OPIE_VERSION}"
PREFERRED_VERSION_opie-textedit = "${OPIE_VERSION}"
PREFERRED_VERSION_opie-theme = "${OPIE_VERSION}"
PREFERRED_VERSION_opie-tictac = "${OPIE_VERSION}"
PREFERRED_VERSION_opie-tinykate = "${OPIE_VERSION}"
PREFERRED_VERSION_opie-today-addressbookplugin = "${OPIE_VERSION}"
PREFERRED_VERSION_opie-today-datebookplugin = "${OPIE_VERSION}"
PREFERRED_VERSION_opie-today-fortuneplugin = "${OPIE_VERSION}"
PREFERRED_VERSION_opie-today-mailplugin = "${OPIE_VERSION}"
PREFERRED_VERSION_opie-today = "${OPIE_VERSION}"
PREFERRED_VERSION_opie-today-stocktickerplugin = "${OPIE_VERSION}"
PREFERRED_VERSION_opie-today-todolistplugin = "${OPIE_VERSION}"
PREFERRED_VERSION_opie-today-weatherplugin = "${OPIE_VERSION}"
PREFERRED_VERSION_opie-todo = "${OPIE_VERSION}"
PREFERRED_VERSION_opie-tonleiter = "${OPIE_VERSION}"
PREFERRED_VERSION_opie-unikeyboard = "${OPIE_VERSION}"
PREFERRED_VERSION_opie-usermanager = "${OPIE_VERSION}"
PREFERRED_VERSION_opie-vmemo = "${OPIE_VERSION}"
PREFERRED_VERSION_opie-vmemo-settings = "${OPIE_VERSION}"
PREFERRED_VERSION_opie-volumeapplet = "${OPIE_VERSION}"
PREFERRED_VERSION_opie-vtapplet = "${OPIE_VERSION}"
PREFERRED_VERSION_opie-wellenreiter = "${OPIE_VERSION}"
PREFERRED_VERSION_opie-wirelessapplet = "${OPIE_VERSION}"
PREFERRED_VERSION_opie-wordgame = "${OPIE_VERSION}"
PREFERRED_VERSION_opie-write = "${OPIE_VERSION}"
PREFERRED_VERSION_opie-zkbapplet = "${OPIE_VERSION}"
PREFERRED_VERSION_opie-zlines = "${OPIE_VERSION}"
PREFERRED_VERSION_opie-zsafe = "${OPIE_VERSION}"
PREFERRED_VERSION_opie-zsame = "${OPIE_VERSION}"
PREFERRED_VERSION_opie-sh-snes = "${OPIE_VERSION}"
PREFERRED_VERSION_opie-stumbler = "${OPIE_VERSION}"

PREFERRED_VERSION_konqueror-embedded = "20070212"


SRCDATE_opie-aboutapplet = "${OPIE_SRCDATE}"
SRCDATE_opie-addressbook = "${OPIE_SRCDATE}"
SRCDATE_opie-advancedfm = "${OPIE_SRCDATE}"
SRCDATE_opie-alarm = "${OPIE_SRCDATE}"
SRCDATE_opie-appearance = "${OPIE_SRCDATE}"
SRCDATE_opie-aqpkg = "${OPIE_SRCDATE}"
SRCDATE_opie-autorotateapplet = "${OPIE_SRCDATE}"
SRCDATE_opie-backgammon = "${OPIE_SRCDATE}"
SRCDATE_opie-backup = "${OPIE_SRCDATE}"
SRCDATE_opie-bartender = "${OPIE_SRCDATE}"
SRCDATE_opie-batteryapplet = "${OPIE_SRCDATE}"
SRCDATE_opie-bluepin ?= "${OPIE_SRCDATE}"
SRCDATE_opie-bluetoothapplet ?= "${OPIE_SRCDATE}"
SRCDATE_opie-bluetoothmanager ?= "${OPIE_SRCDATE}"
SRCDATE_opie-bounce = "${OPIE_SRCDATE}"
SRCDATE_opie-brightnessapplet = "${OPIE_SRCDATE}"
SRCDATE_opie-button-settings = "${OPIE_SRCDATE}"
SRCDATE_opie-buzzword = "${OPIE_SRCDATE}"
SRCDATE_opie-calculator = "${OPIE_SRCDATE}"
SRCDATE_opie-calibrate = "${OPIE_SRCDATE}"
SRCDATE_opie-camera = "${OPIE_SRCDATE}"
SRCDATE_opie-cardmon = "${OPIE_SRCDATE}"
SRCDATE_opie-checkbook = "${OPIE_SRCDATE}"
SRCDATE_opie-citytime = "${OPIE_SRCDATE}"
SRCDATE_opie-clipboardapplet = "${OPIE_SRCDATE}"
SRCDATE_opie-clockapplet = "${OPIE_SRCDATE}"
SRCDATE_opie-clock = "${OPIE_SRCDATE}"
SRCDATE_opie-confeditor = "${OPIE_SRCDATE}"
SRCDATE_opie-console = "${OPIE_SRCDATE}"
SRCDATE_opie-dagger = "${OPIE_SRCDATE}"
SRCDATE_opie-dasher = "${OPIE_SRCDATE}"
SRCDATE_opie-datebook = "${OPIE_SRCDATE}"
SRCDATE_opie-datebook-chrisholidayplugin = "${OPIE_SRCDATE}"
SRCDATE_opie-datebook-nationalholidayplugin = "${OPIE_SRCDATE}"
SRCDATE_opie-datebook-birthdayplugin = "${OPIE_SRCDATE}"
SRCDATE_opie-deco-flat = "${OPIE_SRCDATE}"
SRCDATE_opie-deco-liquid = "${OPIE_SRCDATE}"
SRCDATE_opie-deco-polished = "${OPIE_SRCDATE}"
SRCDATE_opie-doctab = "${OPIE_SRCDATE}"
SRCDATE_opie-drawpad = "${OPIE_SRCDATE}"
SRCDATE_opie-dvorak = "${OPIE_SRCDATE}"
SRCDATE_opie-embeddedkonsole = "${OPIE_SRCDATE}"
SRCDATE_opie-euroconv = "${OPIE_SRCDATE}"
SRCDATE_opie-examples-python = "${OPIE_SRCDATE}"
SRCDATE_opie-examples = "${OPIE_SRCDATE}"
SRCDATE_opie-eye = "${OPIE_SRCDATE}"
SRCDATE_opie-fifteen = "${OPIE_SRCDATE}"
SRCDATE_opie-formatter = "${OPIE_SRCDATE}"
SRCDATE_opie-freetype = "${OPIE_SRCDATE}"
SRCDATE_opie-ftplib = "${OPIE_SRCDATE}"
SRCDATE_opie-ftp = "${OPIE_SRCDATE}"
SRCDATE_opie-go = "${OPIE_SRCDATE}"
SRCDATE_opie-gutenbrowser = "${OPIE_SRCDATE}"
SRCDATE_opie-handwriting = "${OPIE_SRCDATE}"
SRCDATE_opie-helpbrowser = "${OPIE_SRCDATE}"
SRCDATE_opie-help-en = "${OPIE_SRCDATE}"
SRCDATE_opie-homeapplet = "${OPIE_SRCDATE}"
SRCDATE_opie-i18n = "${OPIE_SRCDATE}"
SRCDATE_opie-lrelease-native = "${OPIE_SRCDATE}"
SRCDATE_opie-lupdate-native = "${OPIE_SRCDATE}"
SRCDATE_opie-icon-reload = "${OPIE_SRCDATE}"
SRCDATE_opie-irc = "${OPIE_SRCDATE}"
SRCDATE_opie-irdaapplet = "${OPIE_SRCDATE}"
SRCDATE_opie-jumpx = "${OPIE_SRCDATE}"
SRCDATE_opie-kbill = "${OPIE_SRCDATE}"
SRCDATE_opie-kcheckers = "${OPIE_SRCDATE}"
SRCDATE_opie-keyboard = "${OPIE_SRCDATE}"
SRCDATE_opie-keypebble = "${OPIE_SRCDATE}"
SRCDATE_opie-keytabs = "${OPIE_SRCDATE}"
SRCDATE_opie-keyview = "${OPIE_SRCDATE}"
SRCDATE_opie-kjumpx = "${OPIE_SRCDATE}"
SRCDATE_opie-kpacman = "${OPIE_SRCDATE}"
SRCDATE_opie-language = "${OPIE_SRCDATE}"
SRCDATE_opie-launcher-settings = "${OPIE_SRCDATE}"
SRCDATE_opie-libqrsync = "${OPIE_SRCDATE}"
SRCDATE_opie-light-and-power = "${OPIE_SRCDATE}"
SRCDATE_opie-lockapplet = "${OPIE_SRCDATE}"
SRCDATE_opie-login = "${OPIE_SRCDATE}"
SRCDATE_opie-logoutapplet = "${OPIE_SRCDATE}"
SRCDATE_opie-mailapplet = "${OPIE_SRCDATE}"
SRCDATE_opie-mail = "${OPIE_SRCDATE}"
SRCDATE_opie-mediaplayer1-libmadplugin = "${OPIE_SRCDATE}"
SRCDATE_opie-mediaplayer1-libmodplugin = "${OPIE_SRCDATE}"
SRCDATE_opie-mediaplayer1-libtremorplugin = "${OPIE_SRCDATE}"
SRCDATE_opie-mediaplayer1-libwavplugin = "${OPIE_SRCDATE}"
SRCDATE_opie-mediaplayer1-core = "${OPIE_SRCDATE}"
SRCDATE_opie-mediaplayer1 = "${OPIE_SRCDATE}"
SRCDATE_opie-mediaplayer2 = "${OPIE_SRCDATE}"
SRCDATE_opie-mediaplayer2-skin-default = "${OPIE_SRCDATE}"
SRCDATE_opie-mediaplayer2-skin-default-landscape = "${OPIE_SRCDATE}"
SRCDATE_opie-mediaplayer2-skin-pod = "${OPIE_SRCDATE}"
SRCDATE_opie-mediaplayer2-skin-techno = "${OPIE_SRCDATE}"
SRCDATE_opie-mediummount = "${OPIE_SRCDATE}"
SRCDATE_opie-memoryapplet = "${OPIE_SRCDATE}"
SRCDATE_opie-mindbreaker = "${OPIE_SRCDATE}"
SRCDATE_opie-minesweep = "${OPIE_SRCDATE}"
SRCDATE_opie-mobilemsg = "${OPIE_SRCDATE}"
SRCDATE_opie-multikeyapplet = "${OPIE_SRCDATE}"
SRCDATE_opie-multikey = "${OPIE_SRCDATE}"
SRCDATE_opie-networkapplet = "${OPIE_SRCDATE}"
SRCDATE_opie-networksettings = "${OPIE_SRCDATE}"
SRCDATE_opie-notesapplet = "${OPIE_SRCDATE}"
SRCDATE_opie-odict = "${OPIE_SRCDATE}"
SRCDATE_opie-osearch = "${OPIE_SRCDATE}"
SRCDATE_opie-oxygen = "${OPIE_SRCDATE}"
SRCDATE_opie-oyatzee = "${OPIE_SRCDATE}"
SRCDATE_opie-packagemanager = "${OPIE_SRCDATE}"
SRCDATE_opie-parashoot = "${OPIE_SRCDATE}"
SRCDATE_opie-pcmciaapplet = "${OPIE_SRCDATE}"
SRCDATE_opie-performance = "${OPIE_SRCDATE}"
SRCDATE_opie-pickboard = "${OPIE_SRCDATE}"
SRCDATE_opie-pics = "${OPIE_SRCDATE}"
SRCDATE_opie-pimconverter = "${OPIE_SRCDATE}"
SRCDATE_opie-powerchord = "${OPIE_SRCDATE}"
SRCDATE_opie-pyquicklaunchapplet = "${OPIE_SRCDATE}"
SRCDATE_opie-qasteroids = "${OPIE_SRCDATE}"
SRCDATE_opie-qcop = "${OPIE_SRCDATE}"
SRCDATE_opie-quicklauncher = "${OPIE_SRCDATE}"
SRCDATE_opie-qss = "${OPIE_SRCDATE}"
SRCDATE_opie-rdesktop = "${OPIE_SRCDATE}"
SRCDATE_opie-reader = "${OPIE_SRCDATE}"
SRCDATE_opie-recorder = "${OPIE_SRCDATE}"
SRCDATE_opie-remote = "${OPIE_SRCDATE}"
SRCDATE_opie-restartapplet2 = "${OPIE_SRCDATE}"
SRCDATE_opie-restartapplet = "${OPIE_SRCDATE}"
SRCDATE_opie-restartapplet = "${OPIE_SRCDATE}"
SRCDATE_opie-rotateapplet = "${OPIE_SRCDATE}"
SRCDATE_opie-screenshotapplet = "${OPIE_SRCDATE}"
SRCDATE_opie-search = "${OPIE_SRCDATE}"
SRCDATE_opie-security = "${OPIE_SRCDATE}"
SRCDATE_opie-securityplugin-blueping = "${OPIE_SRCDATE}"
SRCDATE_opie-securityplugin-dummy = "${OPIE_SRCDATE}"
SRCDATE_opie-securityplugin-notice = "${OPIE_SRCDATE}"
SRCDATE_opie-securityplugin-pin = "${OPIE_SRCDATE}"
SRCDATE_opie-sfcave = "${OPIE_SRCDATE}"
SRCDATE_opie-sheet = "${OPIE_SRCDATE}"
SRCDATE_opie-sh = "${OPIE_SRCDATE}"
SRCDATE_opie-showimg = "${OPIE_SRCDATE}"
SRCDATE_opie-snake = "${OPIE_SRCDATE}"
SRCDATE_opie-solitaire = "${OPIE_SRCDATE}"
SRCDATE_opie-sshkeys = "${OPIE_SRCDATE}"
SRCDATE_opie-style-flat = "${OPIE_SRCDATE}"
SRCDATE_opie-style-fresh = "${OPIE_SRCDATE}"
SRCDATE_opie-style-liquid = "${OPIE_SRCDATE}"
SRCDATE_opie-style-metal = "${OPIE_SRCDATE}"
SRCDATE_opie-style-phase = "${OPIE_SRCDATE}"
SRCDATE_opie-style-web = "${OPIE_SRCDATE}"
SRCDATE_opie-sounds = "${OPIE_SRCDATE}"
SRCDATE_opie-suspendapplet = "${OPIE_SRCDATE}"
SRCDATE_opie-symlinker = "${OPIE_SRCDATE}"
SRCDATE_opie-sysinfo = "${OPIE_SRCDATE}"
SRCDATE_opie-systemtime = "${OPIE_SRCDATE}"
SRCDATE_opie-tableviewer = "${OPIE_SRCDATE}"
SRCDATE_opie-tabmanager = "${OPIE_SRCDATE}"
SRCDATE_opie-taskbar = "${OPIE_SRCDATE}"
SRCDATE_opie-taskbar-images = "${OPIE_SRCDATE}"
SRCDATE_opie-tetrix = "${OPIE_SRCDATE}"
SRCDATE_opie-textedit = "${OPIE_SRCDATE}"
SRCDATE_opie-theme = "${OPIE_SRCDATE}"
SRCDATE_opie-tictac = "${OPIE_SRCDATE}"
SRCDATE_opie-tinykate = "${OPIE_SRCDATE}"
SRCDATE_opie-today-addressbookplugin = "${OPIE_SRCDATE}"
SRCDATE_opie-today-datebookplugin = "${OPIE_SRCDATE}"
SRCDATE_opie-today-fortuneplugin = "${OPIE_SRCDATE}"
SRCDATE_opie-today-mailplugin = "${OPIE_SRCDATE}"
SRCDATE_opie-today = "${OPIE_SRCDATE}"
SRCDATE_opie-today-stocktickerplugin = "${OPIE_SRCDATE}"
SRCDATE_opie-today-todolistplugin = "${OPIE_SRCDATE}"
SRCDATE_opie-today-weatherplugin = "${OPIE_SRCDATE}"
SRCDATE_opie-todo = "${OPIE_SRCDATE}"
SRCDATE_opie-tonleiter = "${OPIE_SRCDATE}"
SRCDATE_opie-unikeyboard = "${OPIE_SRCDATE}"
SRCDATE_opie-usermanager = "${OPIE_SRCDATE}"
SRCDATE_opie-vmemo = "${OPIE_SRCDATE}"
SRCDATE_opie-vmemo-settings = "${OPIE_SRCDATE}"
SRCDATE_opie-volumeapplet = "${OPIE_SRCDATE}"
SRCDATE_opie-vtapplet = "${OPIE_SRCDATE}"
SRCDATE_opie-wellenreiter = "${OPIE_SRCDATE}"
SRCDATE_opie-wirelessapplet = "${OPIE_SRCDATE}"
SRCDATE_opie-wordgame = "${OPIE_SRCDATE}"
SRCDATE_opie-write = "${OPIE_SRCDATE}"
SRCDATE_opie-zkbapplet = "${OPIE_SRCDATE}"
SRCDATE_opie-zlines = "${OPIE_SRCDATE}"
SRCDATE_opie-zsafe = "${OPIE_SRCDATE}"
SRCDATE_opie-zsame = "${OPIE_SRCDATE}"
SRCDATE_opie-sh-snes = "${OPIE_SRCDATE}"
SRCDATE_opie-stumbler = "${OPIE_SRCDATE}"
```
