## conf/distro/include/preferred-xorg-versions-X11R7.1.inc
```bitbake
PREFERRED_PROVIDER_virtual/xserver ?= "xserver-xorg"

PREFERRED_PROVIDER_libxext ?= "libxext"
PREFERRED_PROVIDER_xext ?= "libxext"
PREFERRED_PROVIDER_libxi ?= "libxi"
PREFERRED_PROVIDER_libxft ?= "libxft"
PREFERRED_PROVIDER_virtual/libx11 ?= "libx11"
PREFERRED_PROVIDER_libxpm ?= "libxpm"
PREFERRED_PROVIDER_xpm ?= "libxpm"
PREFERRED_PROVIDER_libxt ?= "libxt"
PREFERRED_PROVIDER_libxaw ?= "libxaw"
PREFERRED_PROVIDER_libice ?= "libice"
PREFERRED_PROVIDER_libxrender ?= "libxrender"
PREFERRED_PROVIDER_libxcursor ?= "libxcursor"
PREFERRED_PROVIDER_xextensions ?= "xextensions"
PREFERRED_PROVIDER_xproto ?= "xproto"
PREFERRED_PROVIDER_x11 ?= "libx11"
PREFERRED_PROVIDER_libxv ?= "libxv"
PREFERRED_PROVIDER_xft ?= "libxft"
PREFERRED_PROVIDER_libxrandr ?= "libxrandr"
PREFERRED_PROVIDER_libxdamage ?= "libxdamage"
PREFERRED_PROVIDER_libxcomposite ?= "libxcomposite"
PREFERRED_PROVIDER_libxfixes ?= "libxfixes"
PREFERRED_PROVIDER_libxinerama ?= "libxinerama"
PREFERRED_PROVIDER_libxxf86vm ?= "libxxf86vm"
PREFERRED_PROVIDER_libxmu ?= "libxmu"
PREFERRED_PROVIDER_libsm ?= "libsm"
PREFERRED_PROVIDER_xrandr ?= "xrandr"
PREFERRED_PROVIDER_xserver ?= "xserver-xorg"
PREFERRED_PROVIDER_virtual/xorg ?= "xserver-xorg"

PREFERRED_VERSION_task-xorg ?= "X11R7.1"

PREFERRED_VERSION_bitmap ?= "X11R7.1-1.0.2"
PREFERRED_VERSION_fstobdf ?= "X11R7.1-1.0.2"
PREFERRED_VERSION_mkfontdir-native ?= "X11R7.1-1.0.2"
PREFERRED_VERSION_mkfontdir ?= "X11R7.1-1.0.2"
PREFERRED_VERSION_rgb ?= "X11R7.1-1.0.1"
PREFERRED_VERSION_rstart ?= "X11R7.1-1.0.2"
PREFERRED_VERSION_setxkbmap ?= "X11R7.1-1.0.2"
PREFERRED_VERSION_smproxy ?= "X11R7.1-1.0.2"
PREFERRED_VERSION_x11perf ?= "X11R7.1-1.4.1"
PREFERRED_VERSION_xclock ?= "X11R7.1-1.0.2"
PREFERRED_VERSION_xconsole ?= "X11R7.1-1.0.2"
PREFERRED_VERSION_xcursorgen ?= "X11R7.1-1.0.1"
PREFERRED_VERSION_xdm ?= "X11R7.1-1.0.4"
PREFERRED_VERSION_xdriinfo ?= "X11R7.1-1.0.1"
PREFERRED_VERSION_xedit ?= "X11R7.1-1.0.2"
PREFERRED_VERSION_xfs ?= "X11R7.1-1.0.2"
PREFERRED_VERSION_xhost ?= "X11R7.1-1.0.1"
PREFERRED_VERSION_xinit ?= "X11R7.1-1.0.2"
PREFERRED_VERSION_xkbcomp ?= "X11R7.1-1.0.2"
PREFERRED_VERSION_xkbevd ?= "X11R7.1-1.0.2"
PREFERRED_VERSION_xman ?= "X11R7.1-1.0.2"
PREFERRED_VERSION_xmodmap ?= "X11R7.1-1.0.1"
PREFERRED_VERSION_xrandr ?= "X11R7.1-1.0.2"
PREFERRED_VERSION_xrdb ?= "X11R7.1-1.0.2"
PREFERRED_VERSION_xrefresh ?= "X11R7.1-1.0.2"
PREFERRED_VERSION_xset ?= "X11R7.1-1.0.2"
PREFERRED_VERSION_xtrap ?= "X11R7.1-1.0.2"
PREFERRED_VERSION_xwininfo ?= "X11R7.1-1.0.2"
PREFERRED_VERSION_xorg-docs ?= "X11R7.1-1.2"
PREFERRED_VERSION_xorg-sgml-doctools ?= "X11R7.1-1.1"
PREFERRED_VERSION_xf86-input-acecad ?= "X11R7.1-1.1.0"
PREFERRED_VERSION_xf86-input-aiptek ?= "X11R7.1-1.0.1"
PREFERRED_VERSION_xf86-input-calcomp ?= "X11R7.1-1.1.0"
PREFERRED_VERSION_xf86-input-citron ?= "X11R7.1-2.2.0"
PREFERRED_VERSION_xf86-input-digitaledge ?= "X11R7.1-1.1.0"
PREFERRED_VERSION_xf86-input-dmc ?= "X11R7.1-1.1.0"
PREFERRED_VERSION_xf86-input-dynapro ?= "X11R7.1-1.1.0"
PREFERRED_VERSION_xf86-input-elo2300 ?= "X11R7.1-1.1.0"
PREFERRED_VERSION_xf86-input-evdev ?= "X11R7.1-1.1.2"
PREFERRED_VERSION_xf86-input-fpit ?= "X11R7.1-1.1.0"
PREFERRED_VERSION_xf86-input-hyperpen ?= "X11R7.1-1.1.0"
PREFERRED_VERSION_xf86-input-jamstudio ?= "X11R7.1-1.1.0"
PREFERRED_VERSION_xf86-input-joystick ?= "X11R7.1-1.1.0"
PREFERRED_VERSION_xf86-input-keyboard ?= "X11R7.1-1.1.0"
PREFERRED_VERSION_xf86-input-magellan ?= "X11R7.1-1.1.0"
PREFERRED_VERSION_xf86-input-magictouch ?= "X11R7.1-1.0.0.5"
PREFERRED_VERSION_xf86-input-microtouch ?= "X11R7.1-1.1.0"
PREFERRED_VERSION_xf86-input-mouse ?= "X11R7.1-1.1.0"
PREFERRED_VERSION_xf86-input-mutouch ?= "X11R7.1-1.1.0"
PREFERRED_VERSION_xf86-input-palmax ?= "X11R7.1-1.1.0"
PREFERRED_VERSION_xf86-input-penmount ?= "X11R7.1-1.1.0"
PREFERRED_VERSION_xf86-input-spaceorb ?= "X11R7.1-1.1.0"
PREFERRED_VERSION_xf86-input-summa ?= "X11R7.1-1.1.0"
PREFERRED_VERSION_xf86-input-tek4957 ?= "X11R7.1-1.1.0"
PREFERRED_VERSION_xf86-input-ur98 ?= "X11R7.1-1.1.0"
PREFERRED_VERSION_xf86-input-vmmouse ?= "X11R7.1-12.4.0"
PREFERRED_VERSION_xf86-input-void ?= "X11R7.1-1.1.0"
PREFERRED_VERSION_xf86-video-apm ?= "X11R7.1-1.1.1"
PREFERRED_VERSION_xf86-video-ark ?= "X11R7.1-0.6.0"
PREFERRED_VERSION_xf86-video-ast ?= "X11R7.1-0.81.0"
PREFERRED_VERSION_xf86-video-ati ?= "X11R7.1-6.6.0"
PREFERRED_VERSION_xf86-video-chips ?= "X11R7.1-1.1.1"
PREFERRED_VERSION_xf86-video-cirrus ?= "X11R7.1-1.1.0"
PREFERRED_VERSION_xf86-video-cyrix ?= "X11R7.1-1.1.0"
PREFERRED_VERSION_xf86-video-dummy ?= "X11R7.1-0.2.0"
PREFERRED_VERSION_xf86-video-fbdev ?= "X11R7.1-0.3.0"
PREFERRED_VERSION_xf86-video-glint ?= "X11R7.1-1.1.1"
PREFERRED_VERSION_xf86-video-i128 ?= "X11R7.1-1.1.0.5"
PREFERRED_VERSION_xf86-video-i740 ?= "X11R7.1-1.1.0"
PREFERRED_VERSION_xf86-video-i810 ?= "X11R7.1-1.6.0"
PREFERRED_VERSION_xf86-video-imstt ?= "X11R7.1-1.1.0"
PREFERRED_VERSION_xf86-video-mga ?= "X11R7.1-1.4.1"
PREFERRED_VERSION_xf86-video-neomagic ?= "X11R7.1-1.1.1"
PREFERRED_VERSION_xf86-video-newport ?= "X11R7.1-0.2.0"
PREFERRED_VERSION_xf86-video-nsc ?= "X11R7.1-2.8.1"
PREFERRED_VERSION_xf86-video-nv ?= "X11R7.1-1.1.1"
PREFERRED_VERSION_xf86-video-rendition ?= "X11R7.1-4.1.0"
PREFERRED_VERSION_xf86-video-s3 ?= "X11R7.1-0.4.1"
PREFERRED_VERSION_xf86-video-s3virge ?= "X11R7.1-1.9.1"
PREFERRED_VERSION_xf86-video-savage ?= "X11R7.1-2.1.1"
PREFERRED_VERSION_xf86-video-siliconmotion ?= "X11R7.1-1.4.1"
PREFERRED_VERSION_xf86-video-sis ?= "X11R7.1-0.9.1"
PREFERRED_VERSION_xf86-video-sisusb ?= "X11R7.1-0.8.1"
PREFERRED_VERSION_xf86-video-sunbw2 ?= "X11R7.1-1.1.0"
PREFERRED_VERSION_xf86-video-suncg14 ?= "X11R7.1-1.1.0"
PREFERRED_VERSION_xf86-video-suncg3 ?= "X11R7.1-1.1.0"
PREFERRED_VERSION_xf86-video-suncg6 ?= "X11R7.1-1.1.0"
PREFERRED_VERSION_xf86-video-sunffb ?= "X11R7.1-1.1.0"
PREFERRED_VERSION_xf86-video-sunleo ?= "X11R7.1-1.1.0"
PREFERRED_VERSION_xf86-video-suntcx ?= "X11R7.1-1.1.0"
PREFERRED_VERSION_xf86-video-tdfx ?= "X11R7.1-1.2.1"
PREFERRED_VERSION_xf86-video-tga ?= "X11R7.1-1.1.0"
PREFERRED_VERSION_xf86-video-trident ?= "X11R7.1-1.2.1"
PREFERRED_VERSION_xf86-video-tseng ?= "X11R7.1-1.1.0"
PREFERRED_VERSION_xf86-video-v4l ?= "X11R7.1-0.1.1"
PREFERRED_VERSION_xf86-video-vesa ?= "X11R7.1-1.2.0"
PREFERRED_VERSION_xf86-video-vga ?= "X11R7.1-4.1.0"
PREFERRED_VERSION_xf86-video-via ?= "X11R7.1-0.2.1"
PREFERRED_VERSION_xf86-video-vmware ?= "X11R7.1-10.13.0"
PREFERRED_VERSION_xf86-video-voodoo ?= "X11R7.1-1.1.0"
PREFERRED_VERSION_font-util-native ?= "X11R7.1-1.0.1"
PREFERRED_VERSION_font-util ?= "X11R7.1-1.0.1"
PREFERRED_VERSION_diet-x11 ?= "X11R7.1-1.0.1"
PREFERRED_VERSION_libdmx ?= "X11R7.1-1.0.2"
PREFERRED_VERSION_libfontenc-native ?= "X11R7.1-1.0.2"
PREFERRED_VERSION_libfontenc ?= "X11R7.1-1.0.2"
PREFERRED_VERSION_libice ?= "X11R7.1-1.0.1"
PREFERRED_VERSION_liblbxutil ?= "X11R7.1-1.0.1"
PREFERRED_VERSION_libsm ?= "X11R7.1-1.0.1"
PREFERRED_VERSION_libx11-native ?= "X11R7.1-1.0.1"
PREFERRED_VERSION_libx11 ?= "X11R7.1-1.0.1"
PREFERRED_VERSION_libxau-native ?= "X11R7.1-1.0.1"
PREFERRED_VERSION_libxau ?= "X11R7.1-1.0.1"
PREFERRED_VERSION_libxaw ?= "X11R7.1-1.0.2"
PREFERRED_VERSION_libxcomposite ?= "X11R7.1-0.3"
PREFERRED_VERSION_libxcursor ?= "X11R7.1-1.1.6"
PREFERRED_VERSION_libxdamage ?= "X11R7.1-1.0.3"
PREFERRED_VERSION_libxdmcp-native ?= "X11R7.1-1.0.1"
PREFERRED_VERSION_libxdmcp ?= "X11R7.1-1.0.1"
PREFERRED_VERSION_libxevie ?= "X11R7.1-1.0.1"
PREFERRED_VERSION_libxext ?= "X11R7.1-1.0.1"
PREFERRED_VERSION_libxfixes ?= "X11R7.1-4.0.1"
PREFERRED_VERSION_libxfont-native ?= "X11R7.1-1.2.0"
PREFERRED_VERSION_libxfont ?= "X11R7.1-1.2.0"
PREFERRED_VERSION_libxfontcache ?= "X11R7.1-1.0.2"
PREFERRED_VERSION_libxi ?= "X11R7.1-1.0.1"
PREFERRED_VERSION_libxkbfile ?= "X11R7.1-1.0.3"
PREFERRED_VERSION_libxkbui ?= "X11R7.1-1.0.2"
PREFERRED_VERSION_libxmu ?= "X11R7.1-1.0.1"
PREFERRED_VERSION_libxpm ?= "X11R7.1-3.5.5"
PREFERRED_VERSION_libxrandr ?= "X11R7.1-1.1.1"
PREFERRED_VERSION_libxrender ?= "X11R7.1-0.9.1"
PREFERRED_VERSION_libxres ?= "X11R7.1-1.0.1"
PREFERRED_VERSION_libxscrnsaver ?= "X11R7.1-1.1.0"
PREFERRED_VERSION_libxt ?= "X11R7.1-1.0.2"
PREFERRED_VERSION_libxvmc ?= "X11R7.1-1.0.2"
PREFERRED_VERSION_libxxf86dga ?= "X11R7.1-1.0.1"
PREFERRED_VERSION_libxxf86misc ?= "X11R7.1-1.0.1"
PREFERRED_VERSION_libxxf86vm ?= "X11R7.1-1.0.1"
PREFERRED_VERSION_compositeproto ?= "X11R7.1-0.3.1"
PREFERRED_VERSION_fixesproto ?= "X11R7.1-4.0"
PREFERRED_VERSION_glproto ?= "X11R7.1-1.4.7"
PREFERRED_VERSION_scrnsaverproto ?= "X11R7.1-1.1.0"
PREFERRED_VERSION_xproto-native ?= "X11R7.1-7.0.5"
PREFERRED_VERSION_xproto ?= "X11R7.1-7.0.5"
PREFERRED_VERSION_gccmakedep ?= "X11R7.1-1.0.2"
PREFERRED_VERSION_imake ?= "X11R7.1-1.0.2"
PREFERRED_VERSION_util-macros-native ?= "X11R7.1-1.0.2"
PREFERRED_VERSION_util-macros ?= "X11R7.1-1.0.2"
PREFERRED_VERSION_xorg-cf-files ?= "X11R7.1-1.0.2"
PREFERRED_VERSION_xserver-kdrive ?= "X11R7.1-1.1.0"
PREFERRED_VERSION_xserver-xorg ?= "X11R7.1-1.1.0"
```
