## conf/distro/include/preferred-opie-git-versions.inc
```bitbake
#
# Default versions
QTE_VERSION ?= "2.3.10"
PALMTOP_USE_MULTITHREADED_QT ?= "yes"

OPIE_SRCREV ?= "8c3beef263bc9c34443eacfc821e99813e17554f"

OPIE_VERSION = "1.2.4+gitr${OPIE_SRCREV}"
OPIE_GIT_PV = "${OPIE_VERSION}"


#
#
# Opie libraries
#
PREFERRED_PROVIDER_virtual/libqte2 ?= '${@base_conditional("PALMTOP_USE_MULTITHREADED_QT", "yes", "qte-mt", "qte", d)}'
PREFERRED_PROVIDER_virtual/libqpe1 ?= "libqpe-opie"
PREFERRED_VERSION_qte-mt ?= "${QTE_VERSION}"
PREFERRED_VERSION_qte ?= "${QTE_VERSION}"
SRCREV_pn-libopie2 ?= "${OPIE_SRCREV}"
SRCREV_pn-libopieobex0 ?= "${OPIE_SRCREV}"
SRCREV_pn-libopietooth1 ?= "${OPIE_SRCREV}"
SRCREV_pn-libqpe-opie ?= "${OPIE_SRCREV}"
SRCREV_pn-libqtaux2 ?= "${OPIE_SRCREV}"
SRCREV_pn-libmailwrapper ?= "${OPIE_SRCREV}"
#
# Opie applications
#
SRCREV_pn-opie-aboutapplet ?= "${OPIE_SRCREV}"
SRCREV_pn-opie-addressbook ?= "${OPIE_SRCREV}"
SRCREV_pn-opie-advancedfm ?= "${OPIE_SRCREV}"
SRCREV_pn-opie-alarm ?= "${OPIE_SRCREV}"
SRCREV_pn-opie-appearance ?= "${OPIE_SRCREV}"
SRCREV_pn-opie-aqpkg ?= "${OPIE_SRCREV}"
SRCREV_pn-opie-autorotateapplet ?= "${OPIE_SRCREV}"
SRCREV_pn-opie-backgammon ?= "${OPIE_SRCREV}"
SRCREV_pn-opie-backup ?= "${OPIE_SRCREV}"
SRCREV_pn-opie-bartender ?= "${OPIE_SRCREV}"
SRCREV_pn-opie-batteryapplet ?= "${OPIE_SRCREV}"
SRCREV_pn-opie-bluepin ?= "${OPIE_SRCREV}"
SRCREV_pn-opie-bluetoothapplet ?= "${OPIE_SRCREV}"
SRCREV_pn-opie-bluetoothmanager ?= "${OPIE_SRCREV}"
SRCREV_pn-opie-bounce ?= "${OPIE_SRCREV}"
SRCREV_pn-opie-brightnessapplet ?= "${OPIE_SRCREV}"
SRCREV_pn-opie-button-settings ?= "${OPIE_SRCREV}"
SRCREV_pn-opie-buzzword ?= "${OPIE_SRCREV}"
SRCREV_pn-opie-calculator ?= "${OPIE_SRCREV}"
SRCREV_pn-opie-calibrate ?= "${OPIE_SRCREV}"
SRCREV_pn-opie-camera ?= "${OPIE_SRCREV}"
SRCREV_pn-opie-cardapplet ?= "${OPIE_SRCREV}"
SRCREV_pn-opie-checkbook ?= "${OPIE_SRCREV}"
SRCREV_pn-opie-citytime ?= "${OPIE_SRCREV}"
SRCREV_pn-opie-clipboardapplet ?= "${OPIE_SRCREV}"
SRCREV_pn-opie-clockapplet ?= "${OPIE_SRCREV}"
SRCREV_pn-opie-clock ?= "${OPIE_SRCREV}"
SRCREV_pn-opie-confeditor ?= "${OPIE_SRCREV}"
SRCREV_pn-opie-console ?= "${OPIE_SRCREV}"
SRCREV_pn-opie-dagger ?= "${OPIE_SRCREV}"
SRCREV_pn-opie-dasher ?= "${OPIE_SRCREV}"
SRCREV_pn-opie-datebook ?= "${OPIE_SRCREV}"
SRCREV_pn-opie-datebook-chrisholidayplugin ?= "${OPIE_SRCREV}"
SRCREV_pn-opie-datebook-nationalholidayplugin ?= "${OPIE_SRCREV}"
SRCREV_pn-opie-datebook-birthdayplugin ?= "${OPIE_SRCREV}"
SRCREV_pn-opie-deco-flat ?= "${OPIE_SRCREV}"
SRCREV_pn-opie-deco-liquid ?= "${OPIE_SRCREV}"
SRCREV_pn-opie-deco-polished ?= "${OPIE_SRCREV}"
SRCREV_pn-opie-doctab ?= "${OPIE_SRCREV}"
SRCREV_pn-opie-drawpad ?= "${OPIE_SRCREV}"
SRCREV_pn-opie-dvorak ?= "${OPIE_SRCREV}"
SRCREV_pn-opie-embeddedkonsole ?= "${OPIE_SRCREV}"
SRCREV_pn-opie-euroconv ?= "${OPIE_SRCREV}"
SRCREV_pn-opie-examples-python ?= "${OPIE_SRCREV}"
SRCREV_pn-opie-examples ?= "${OPIE_SRCREV}"
SRCREV_pn-opie-eye ?= "${OPIE_SRCREV}"
SRCREV_pn-opie-fifteen ?= "${OPIE_SRCREV}"
SRCREV_pn-opie-formatter ?= "${OPIE_SRCREV}"
SRCREV_pn-opie-freetype ?= "${OPIE_SRCREV}"
SRCREV_pn-opie-ftplib ?= "${OPIE_SRCREV}"
SRCREV_pn-opie-ftp ?= "${OPIE_SRCREV}"
SRCREV_pn-opie-go ?= "${OPIE_SRCREV}"
SRCREV_pn-opie-gutenbrowser ?= "${OPIE_SRCREV}"
SRCREV_pn-opie-handwriting ?= "${OPIE_SRCREV}"
SRCREV_pn-opie-helpbrowser ?= "${OPIE_SRCREV}"
SRCREV_pn-opie-help-en ?= "${OPIE_SRCREV}"
SRCREV_pn-opie-homeapplet ?= "${OPIE_SRCREV}"
SRCREV_pn-opie-i18n ?= "${OPIE_SRCREV}"
SRCREV_pn-opie-lrelease-native ?= "${OPIE_SRCREV}"
SRCREV_pn-opie-lupdate-native ?= "${OPIE_SRCREV}"
SRCREV_pn-opie-icon-reload ?= "${OPIE_SRCREV}"
SRCREV_pn-opie-irc ?= "${OPIE_SRCREV}"
SRCREV_pn-opie-irdaapplet ?= "${OPIE_SRCREV}"
SRCREV_pn-opie-jumpx ?= "${OPIE_SRCREV}"
SRCREV_pn-opie-kbill ?= "${OPIE_SRCREV}"
SRCREV_pn-opie-kcheckers ?= "${OPIE_SRCREV}"
SRCREV_pn-opie-keyboard ?= "${OPIE_SRCREV}"
SRCREV_pn-opie-keypebble ?= "${OPIE_SRCREV}"
SRCREV_pn-opie-keytabs ?= "${OPIE_SRCREV}"
SRCREV_pn-opie-keyview ?= "${OPIE_SRCREV}"
SRCREV_pn-opie-kjumpx ?= "${OPIE_SRCREV}"
SRCREV_pn-opie-kpacman ?= "${OPIE_SRCREV}"
SRCREV_pn-opie-language ?= "${OPIE_SRCREV}"
SRCREV_pn-opie-launcher-settings ?= "${OPIE_SRCREV}"
SRCREV_pn-opie-libqrsync ?= "${OPIE_SRCREV}"
SRCREV_pn-opie-light-and-power ?= "${OPIE_SRCREV}"
SRCREV_pn-opie-lockapplet ?= "${OPIE_SRCREV}"
SRCREV_pn-opie-login ?= "${OPIE_SRCREV}"
SRCREV_pn-opie-logoutapplet ?= "${OPIE_SRCREV}"
SRCREV_pn-opie-mailapplet ?= "${OPIE_SRCREV}"
SRCREV_pn-opie-mail ?= "${OPIE_SRCREV}"
SRCREV_pn-opie-mediaplayer1-libmadplugin ?= "${OPIE_SRCREV}"
SRCREV_pn-opie-mediaplayer1-libmodplugin ?= "${OPIE_SRCREV}"
SRCREV_pn-opie-mediaplayer1-libtremorplugin ?= "${OPIE_SRCREV}"
SRCREV_pn-opie-mediaplayer1-libwavplugin ?= "${OPIE_SRCREV}"
SRCREV_pn-opie-mediaplayer1-libwavplugin ?= "${OPIE_SRCREV}"
SRCREV_pn-opie-mediaplayer1-core ?= "${OPIE_SRCREV}"
SRCREV_pn-opie-mediaplayer2 ?= "${OPIE_SRCREV}"
SRCREV_pn-opie-mediaplayer2-skin-default ?= "${OPIE_SRCREV}"
SRCREV_pn-opie-mediaplayer2-skin-default-landscape ?= "${OPIE_SRCREV}"
SRCREV_pn-opie-mediaplayer2-skin-pod ?= "${OPIE_SRCREV}"
SRCREV_pn-opie-mediaplayer2-skin-techno ?= "${OPIE_SRCREV}"
SRCREV_pn-opie-mediummount ?= "${OPIE_SRCREV}"
SRCREV_pn-opie-memoryapplet ?= "${OPIE_SRCREV}"
SRCREV_pn-opie-mindbreaker ?= "${OPIE_SRCREV}"
SRCREV_pn-opie-minesweep ?= "${OPIE_SRCREV}"
SRCREV_pn-opie-mobilemsg ?= "${OPIE_SRCREV}"
SRCREV_pn-opie-multikeyapplet ?= "${OPIE_SRCREV}"
SRCREV_pn-opie-multikey ?= "${OPIE_SRCREV}"
SRCREV_pn-opie-networkapplet ?= "${OPIE_SRCREV}"
SRCREV_pn-opie-networksettings ?= "${OPIE_SRCREV}"
SRCREV_pn-opie-notes ?= "${OPIE_SRCREV}"
SRCREV_pn-opie-notesapplet ?= "${OPIE_SRCREV}"
SRCREV_pn-opie-odict ?= "${OPIE_SRCREV}"
SRCREV_pn-opie-osearch ?= "${OPIE_SRCREV}"
SRCREV_pn-opie-oxygen ?= "${OPIE_SRCREV}"
SRCREV_pn-opie-oyatzee ?= "${OPIE_SRCREV}"
SRCREV_pn-opie-packagemanager ?= "${OPIE_SRCREV}"
SRCREV_pn-opie-parashoot ?= "${OPIE_SRCREV}"
SRCREV_pn-opie-performance ?= "${OPIE_SRCREV}"
SRCREV_pn-opie-pickboard ?= "${OPIE_SRCREV}"
SRCREV_pn-opie-pics ?= "${OPIE_SRCREV}"
SRCREV_pn-opie-pimconverter ?= "${OPIE_SRCREV}"
SRCREV_pn-opie-powerchord ?= "${OPIE_SRCREV}"
SRCREV_pn-opie-pyquicklaunchapplet ?= "${OPIE_SRCREV}"
SRCREV_pn-opie-qasteroids ?= "${OPIE_SRCREV}"
SRCREV_pn-opie-qcop ?= "${OPIE_SRCREV}"
SRCREV_pn-opie-quicklauncher ?= "${OPIE_SRCREV}"
SRCREV_pn-opie-qss ?= "${OPIE_SRCREV}"
SRCREV_pn-opie-rdesktop ?= "${OPIE_SRCREV}"
SRCREV_pn-opie-reader ?= "${OPIE_SRCREV}"
SRCREV_pn-opie-recorder ?= "${OPIE_SRCREV}"
SRCREV_pn-opie-remote ?= "${OPIE_SRCREV}"
SRCREV_pn-opie-restartapplet2 ?= "${OPIE_SRCREV}"
SRCREV_pn-opie-restartapplet ?= "${OPIE_SRCREV}"
SRCREV_pn-opie-restartapplet ?= "${OPIE_SRCREV}"
SRCREV_pn-opie-rotateapplet ?= "${OPIE_SRCREV}"
SRCREV_pn-opie-screenshotapplet ?= "${OPIE_SRCREV}"
SRCREV_pn-opie-search ?= "${OPIE_SRCREV}"
SRCREV_pn-opie-security ?= "${OPIE_SRCREV}"
SRCREV_pn-opie-securityplugin-blueping ?= "${OPIE_SRCREV}"
SRCREV_pn-opie-securityplugin-dummy ?= "${OPIE_SRCREV}"
SRCREV_pn-opie-securityplugin-notice ?= "${OPIE_SRCREV}"
SRCREV_pn-opie-securityplugin-pin ?= "${OPIE_SRCREV}"
SRCREV_pn-opie-sfcave ?= "${OPIE_SRCREV}"
SRCREV_pn-opie-sheet ?= "${OPIE_SRCREV}"
SRCREV_pn-opie-sh ?= "${OPIE_SRCREV}"
SRCREV_pn-opie-showimg ?= "${OPIE_SRCREV}"
SRCREV_pn-opie-snake ?= "${OPIE_SRCREV}"
SRCREV_pn-opie-solitaire ?= "${OPIE_SRCREV}"
SRCREV_pn-opie-sshkeys ?= "${OPIE_SRCREV}"
SRCREV_pn-opie-style-flat ?= "${OPIE_SRCREV}"
SRCREV_pn-opie-style-fresh ?= "${OPIE_SRCREV}"
SRCREV_pn-opie-style-liquid ?= "${OPIE_SRCREV}"
SRCREV_pn-opie-style-metal ?= "${OPIE_SRCREV}"
SRCREV_pn-opie-style-phase ?= "${OPIE_SRCREV}"
SRCREV_pn-opie-style-web ?= "${OPIE_SRCREV}"
SRCREV_pn-opie-sounds ?= "${OPIE_SRCREV}"
SRCREV_pn-opie-stumbler ?= "${OPIE_SRCREV}"
SRCREV_pn-opie-suspendapplet ?= "${OPIE_SRCREV}"
SRCREV_pn-opie-symlinker ?= "${OPIE_SRCREV}"
SRCREV_pn-opie-sysinfo ?= "${OPIE_SRCREV}"
SRCREV_pn-opie-systemtime ?= "${OPIE_SRCREV}"
SRCREV_pn-opie-tableviewer ?= "${OPIE_SRCREV}"
SRCREV_pn-opie-tabmanager ?= "${OPIE_SRCREV}"
SRCREV_pn-opie-taskbar-images ?= "${OPIE_SRCREV}"
SRCREV_pn-opie-taskbar ?= "${OPIE_SRCREV}"
SRCREV_pn-opie-tetrix ?= "${OPIE_SRCREV}"
SRCREV_pn-opie-textedit ?= "${OPIE_SRCREV}"
SRCREV_pn-opie-theme ?= "${OPIE_SRCREV}"
SRCREV_pn-opie-tictac ?= "${OPIE_SRCREV}"
SRCREV_pn-opie-tinykate ?= "${OPIE_SRCREV}"
SRCREV_pn-opie-today-addressbookplugin ?= "${OPIE_SRCREV}"
SRCREV_pn-opie-today-datebookplugin ?= "${OPIE_SRCREV}"
SRCREV_pn-opie-today-fortuneplugin ?= "${OPIE_SRCREV}"
SRCREV_pn-opie-today-mailplugin ?= "${OPIE_SRCREV}"
SRCREV_pn-opie-today ?= "${OPIE_SRCREV}"
SRCREV_pn-opie-today-stocktickerplugin ?= "${OPIE_SRCREV}"
SRCREV_pn-opie-today-todolistplugin ?= "${OPIE_SRCREV}"
SRCREV_pn-opie-today-weatherplugin ?= "${OPIE_SRCREV}"
SRCREV_pn-opie-todo ?= "${OPIE_SRCREV}"
SRCREV_pn-opie-tonleiter ?= "${OPIE_SRCREV}"
SRCREV_pn-opie-unikeyboard ?= "${OPIE_SRCREV}"
SRCREV_pn-opie-usermanager ?= "${OPIE_SRCREV}"
SRCREV_pn-opie-vmemo ?= "${OPIE_SRCREV}"
SRCREV_pn-opie-vmemo-settings ?= "${OPIE_SRCREV}"
SRCREV_pn-opie-volumeapplet ?= "${OPIE_SRCREV}"
SRCREV_pn-opie-vtapplet ?= "${OPIE_SRCREV}"
SRCREV_pn-opie-wellenreiter ?= "${OPIE_SRCREV}"
SRCREV_pn-opie-wirelessapplet ?= "${OPIE_SRCREV}"
SRCREV_pn-opie-wordgame ?= "${OPIE_SRCREV}"
SRCREV_pn-opie-write ?= "${OPIE_SRCREV}"
SRCREV_pn-opie-zkbapplet ?= "${OPIE_SRCREV}"
SRCREV_pn-opie-zlines ?= "${OPIE_SRCREV}"
SRCREV_pn-opie-zsafe ?= "${OPIE_SRCREV}"
SRCREV_pn-opie-zsame ?= "${OPIE_SRCREV}"
PREFERRED_VERSION_konqueror-embedded = "20070316"
```
