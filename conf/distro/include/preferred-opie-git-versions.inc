## conf/distro/include/preferred-xorg-versions-live.inc
```bitbake
#Thu Feb 25 10:36:35 CET 2010
#app
PREFERRED_VERSION_appres ?= "1.0.2"
PREFERRED_VERSION_bdftopcf ?= "1.0.2"
PREFERRED_VERSION_bdftopcf-native ?= "1.0.2"
PREFERRED_VERSION_beforelight ?= "1.0.3"
PREFERRED_VERSION_bitmap ?= "1.0.4"
PREFERRED_VERSION_constype ?= "1.0.2"
PREFERRED_VERSION_editres ?= "1.0.4"
PREFERRED_VERSION_fonttosfnt ?= "1.0.4"
PREFERRED_VERSION_fslsfonts ?= "1.0.2"
PREFERRED_VERSION_fstobdf ?= "1.0.3"
PREFERRED_VERSION_iceauth ?= "1.0.3"
PREFERRED_VERSION_ico ?= "1.0.2"
PREFERRED_VERSION_lbxproxy ?= "1.0.2"
PREFERRED_VERSION_listres ?= "1.0.2"
PREFERRED_VERSION_luit ?= "1.0.5"
PREFERRED_VERSION_mkcfm ?= "1.0.1"
PREFERRED_VERSION_mkcomposecache ?= "1.2.1"
PREFERRED_VERSION_mkfontdir ?= "1.0.5"
PREFERRED_VERSION_mkfontdir-native ?= "1.0.5"
PREFERRED_VERSION_mkfontscale ?= "1.0.7"
PREFERRED_VERSION_mkfontscale-native ?= "1.0.7"
PREFERRED_VERSION_oclock ?= "1.0.1"
PREFERRED_VERSION_proxymngr ?= "1.0.1"
PREFERRED_VERSION_rendercheck ?= "1.3"
PREFERRED_VERSION_rgb ?= "1.0.3"
PREFERRED_VERSION_rstart ?= "1.0.3"
PREFERRED_VERSION_scripts ?= "1.0.1"
PREFERRED_VERSION_sessreg ?= "1.0.5"
PREFERRED_VERSION_setxkbmap ?= "1.1.0"
PREFERRED_VERSION_showfont ?= "1.0.2"
PREFERRED_VERSION_smproxy ?= "1.0.3"
PREFERRED_VERSION_twm ?= "1.0.4"
PREFERRED_VERSION_viewres ?= "1.0.2"
PREFERRED_VERSION_x11perf ?= "1.5.1"
PREFERRED_VERSION_xauth ?= "1.0.4"
PREFERRED_VERSION_xbacklight ?= "1.1.1"
PREFERRED_VERSION_xbiff ?= "1.0.2"
PREFERRED_VERSION_xcalc ?= "1.0.3"
PREFERRED_VERSION_xclipboard ?= "1.1.0"
PREFERRED_VERSION_xclock ?= "1.0.4"
PREFERRED_VERSION_xcmsdb ?= "1.0.2"
PREFERRED_VERSION_xcompmgr ?= "1.1.5"
PREFERRED_VERSION_xconsole ?= "1.0.3"
PREFERRED_VERSION_xcursorgen ?= "1.0.3"
PREFERRED_VERSION_xcursorgen-native ?= "1.0.3"
PREFERRED_VERSION_xdbedizzy ?= "1.0.2"
PREFERRED_VERSION_xditview ?= "1.0.1"
PREFERRED_VERSION_xdm ?= "1.1.9"
PREFERRED_VERSION_xdpyinfo ?= "1.1.0"
PREFERRED_VERSION_xdriinfo ?= "1.0.3"
PREFERRED_VERSION_xedit ?= "1.1.2"
PREFERRED_VERSION_xev ?= "1.0.4"
PREFERRED_VERSION_xeyes ?= "1.1.0"
PREFERRED_VERSION_xf86dga ?= "1.0.2"
PREFERRED_VERSION_xfd ?= "1.0.1"
PREFERRED_VERSION_xfindproxy ?= "1.0.1"
PREFERRED_VERSION_xfontsel ?= "1.0.2"
PREFERRED_VERSION_xfs ?= "1.1.0"
PREFERRED_VERSION_xfsinfo ?= "1.0.2"
PREFERRED_VERSION_xfwp ?= "1.0.1"
PREFERRED_VERSION_xgamma ?= "1.0.3"
PREFERRED_VERSION_xgc ?= "1.0.2"
PREFERRED_VERSION_xhost ?= "1.0.3"
PREFERRED_VERSION_xinit ?= "1.2.0"
PREFERRED_VERSION_xinput ?= "1.5.0"
PREFERRED_VERSION_xkbcomp ?= "1.1.1"
PREFERRED_VERSION_xkbcomp-native ?= "1.1.1"
PREFERRED_VERSION_xkbevd ?= "1.1.0"
PREFERRED_VERSION_xkbprint ?= "1.0.2"
PREFERRED_VERSION_xkbutils ?= "1.0.2"
PREFERRED_VERSION_xkill ?= "1.0.2"
PREFERRED_VERSION_xload ?= "1.0.2"
PREFERRED_VERSION_xlogo ?= "1.0.2"
PREFERRED_VERSION_xlsatoms ?= "1.0.2"
PREFERRED_VERSION_xlsclients ?= "1.0.2"
PREFERRED_VERSION_xlsfonts ?= "1.0.2"
PREFERRED_VERSION_xmag ?= "1.0.3"
PREFERRED_VERSION_xman ?= "1.1.0"
PREFERRED_VERSION_xmessage ?= "1.0.3"
PREFERRED_VERSION_xmh ?= "1.0.1"
PREFERRED_VERSION_xmodmap ?= "1.0.4"
PREFERRED_VERSION_xmore ?= "1.0.1"
PREFERRED_VERSION_xphelloworld ?= "1.0.1"
PREFERRED_VERSION_xplsprinters ?= "1.0.1"
PREFERRED_VERSION_xpr ?= "1.0.3"
PREFERRED_VERSION_xprehashprinterlist ?= "1.0.1"
PREFERRED_VERSION_xprop ?= "1.1.0"
PREFERRED_VERSION_xrandr ?= "1.3.2"
PREFERRED_VERSION_xrdb ?= "1.0.6"
PREFERRED_VERSION_xrefresh ?= "1.0.3"
PREFERRED_VERSION_xrx ?= "1.0.3"
PREFERRED_VERSION_xset ?= "1.1.0"
PREFERRED_VERSION_xsetmode ?= "1.0.0"
PREFERRED_VERSION_xsetpointer ?= "1.0.1"
PREFERRED_VERSION_xsetroot ?= "1.0.3"
PREFERRED_VERSION_xsm ?= "1.0.1"
PREFERRED_VERSION_xstdcmap ?= "1.0.1"
PREFERRED_VERSION_xtrap ?= "1.0.2"
PREFERRED_VERSION_xvidtune ?= "1.0.2"
PREFERRED_VERSION_xvinfo ?= "1.1.0"
PREFERRED_VERSION_xwd ?= "1.0.3"
PREFERRED_VERSION_xwininfo ?= "1.0.5"
PREFERRED_VERSION_xwud ?= "1.0.2"
#data
PREFERRED_VERSION_xbitmaps ?= "1.1.0"
PREFERRED_VERSION_xcursor-themes ?= "1.0.2"
PREFERRED_VERSION_xkbdata ?= "1.0.1"
#doc
PREFERRED_VERSION_xorg-docs ?= "1.5"
PREFERRED_VERSION_xorg-sgml-doctools ?= "1.3"
#driver
PREFERRED_VERSION_xf86-input-acecad ?= "1.4.0"
PREFERRED_VERSION_xf86-input-aiptek ?= "1.3.0"
PREFERRED_VERSION_xf86-input-calcomp ?= "1.1.2"
PREFERRED_VERSION_xf86-input-citron ?= "2.2.2"
PREFERRED_VERSION_xf86-input-digitaledge ?= "1.1.1"
PREFERRED_VERSION_xf86-input-dmc ?= "1.1.2"
PREFERRED_VERSION_xf86-input-dynapro ?= "1.1.2"
PREFERRED_VERSION_xf86-input-elo2300 ?= "1.1.2"
PREFERRED_VERSION_xf86-input-elographics ?= "1.2.3"
PREFERRED_VERSION_xf86-input-evdev ?= "2.3.2"
PREFERRED_VERSION_xf86-input-fpit ?= "1.3.0"
PREFERRED_VERSION_xf86-input-hyperpen ?= "1.3.0"
PREFERRED_VERSION_xf86-input-jamstudio ?= "1.2.0"
PREFERRED_VERSION_xf86-input-joystick ?= "1.5.0"
PREFERRED_VERSION_xf86-input-keyboard ?= "1.4.0"
PREFERRED_VERSION_xf86-input-magellan ?= "1.2.0"
PREFERRED_VERSION_xf86-input-magictouch ?= "1.0.0.5"
PREFERRED_VERSION_xf86-input-microtouch ?= "1.2.0"
PREFERRED_VERSION_xf86-input-mouse ?= "1.5.0"
PREFERRED_VERSION_xf86-input-mutouch ?= "1.2.1"
PREFERRED_VERSION_xf86-input-palmax ?= "1.2.0"
PREFERRED_VERSION_xf86-input-penmount ?= "1.4.0"
PREFERRED_VERSION_xf86-input-spaceorb ?= "1.1.1"
PREFERRED_VERSION_xf86-input-summa ?= "1.2.0"
PREFERRED_VERSION_xf86-input-synaptics ?= "1.2.1"
PREFERRED_VERSION_xf86-input-tek4957 ?= "1.2.0"
PREFERRED_VERSION_xf86-input-ur98 ?= "1.1.0"
PREFERRED_VERSION_xf86-input-vmmouse ?= "12.6.6"
PREFERRED_VERSION_xf86-input-void ?= "1.3.0"
PREFERRED_VERSION_xf86-video-apm ?= "1.2.2"
PREFERRED_VERSION_xf86-video-ark ?= "0.7.2"
PREFERRED_VERSION_xf86-video-ast ?= "0.89.9"
PREFERRED_VERSION_xf86-video-ati ?= "6.12.4"
PREFERRED_VERSION_xf86-video-chips ?= "1.2.2"
PREFERRED_VERSION_xf86-video-cirrus ?= "1.3.2"
PREFERRED_VERSION_xf86-video-cyrix ?= "1.1.0"
PREFERRED_VERSION_xf86-video-dummy ?= "0.3.3"
PREFERRED_VERSION_xf86-video-fbdev ?= "0.4.1"
PREFERRED_VERSION_xf86-video-geode ?= "2.11.7"
PREFERRED_VERSION_xf86-video-glint ?= "1.2.4"
PREFERRED_VERSION_xf86-video-i128 ?= "1.3.3"
PREFERRED_VERSION_xf86-video-i740 ?= "1.3.2"
PREFERRED_VERSION_xf86-video-i810 ?= "1.7.4"
PREFERRED_VERSION_xf86-video-impact ?= "0.2.0"
PREFERRED_VERSION_xf86-video-imstt ?= "1.1.0"
PREFERRED_VERSION_xf86-video-intel ?= "2.10.0"
PREFERRED_VERSION_xf86-video-mach64 ?= "6.8.2"
PREFERRED_VERSION_xf86-video-mga ?= "1.9.100"
PREFERRED_VERSION_xf86-video-neomagic ?= "1.2.4"
PREFERRED_VERSION_xf86-video-newport ?= "0.2.3"
PREFERRED_VERSION_xf86-video-nsc ?= "2.8.3"
PREFERRED_VERSION_xf86-video-nv ?= "2.1.16"
PREFERRED_VERSION_xf86-video-openchrome ?= "0.2.904"
PREFERRED_VERSION_xf86-video-r128 ?= "6.8.1"
PREFERRED_VERSION_xf86-video-radeonhd ?= "1.3.0"
PREFERRED_VERSION_xf86-video-rendition ?= "4.2.3"
PREFERRED_VERSION_xf86-video-s3 ?= "0.6.3"
PREFERRED_VERSION_xf86-video-s3virge ?= "1.10.4"
PREFERRED_VERSION_xf86-video-savage ?= "2.3.1"
PREFERRED_VERSION_xf86-video-siliconmotion ?= "1.7.3"
PREFERRED_VERSION_xf86-video-sis ?= "0.10.2"
PREFERRED_VERSION_xf86-video-sisusb ?= "0.9.3"
PREFERRED_VERSION_xf86-video-sunbw2 ?= "1.1.0"
PREFERRED_VERSION_xf86-video-suncg14 ?= "1.1.1"
PREFERRED_VERSION_xf86-video-suncg3 ?= "1.1.1"
PREFERRED_VERSION_xf86-video-suncg6 ?= "1.1.1"
PREFERRED_VERSION_xf86-video-sunffb ?= "1.2.1"
PREFERRED_VERSION_xf86-video-sunleo ?= "1.2.0"
PREFERRED_VERSION_xf86-video-suntcx ?= "1.1.1"
PREFERRED_VERSION_xf86-video-tdfx ?= "1.4.3"
PREFERRED_VERSION_xf86-video-tga ?= "1.2.1"
PREFERRED_VERSION_xf86-video-trident ?= "1.3.3"
PREFERRED_VERSION_xf86-video-tseng ?= "1.2.3"
PREFERRED_VERSION_xf86-video-v4l ?= "0.2.0"
PREFERRED_VERSION_xf86-video-vermilion ?= "1.0.1"
PREFERRED_VERSION_xf86-video-vesa ?= "2.3.0"
PREFERRED_VERSION_xf86-video-vga ?= "4.1.0"
PREFERRED_VERSION_xf86-video-via ?= "0.2.2"
PREFERRED_VERSION_xf86-video-vmware ?= "10.16.9"
PREFERRED_VERSION_xf86-video-voodoo ?= "1.2.3"
PREFERRED_VERSION_xf86-video-wsfb ?= "0.3.0"
PREFERRED_VERSION_xf86-video-xgi ?= "1.5.1"
PREFERRED_VERSION_xf86-video-xgixp ?= "1.7.99.4"
#font
PREFERRED_VERSION_encodings ?= "1.0.3"
PREFERRED_VERSION_font-adobe-100dpi ?= "1.0.1"
PREFERRED_VERSION_font-adobe-75dpi ?= "1.0.1"
PREFERRED_VERSION_font-adobe-utopia-100dpi ?= "1.0.2"
PREFERRED_VERSION_font-adobe-utopia-75dpi ?= "1.0.2"
PREFERRED_VERSION_font-adobe-utopia-type1 ?= "1.0.2"
PREFERRED_VERSION_font-alias ?= "1.0.2"
PREFERRED_VERSION_font-arabic-misc ?= "1.0.1"
PREFERRED_VERSION_font-bh-100dpi ?= "1.0.1"
PREFERRED_VERSION_font-bh-75dpi ?= "1.0.1"
PREFERRED_VERSION_font-bh-lucidatypewriter-100dpi ?= "1.0.1"
PREFERRED_VERSION_font-bh-lucidatypewriter-75dpi ?= "1.0.1"
PREFERRED_VERSION_font-bh-ttf ?= "1.0.1"
PREFERRED_VERSION_font-bh-type1 ?= "1.0.1"
PREFERRED_VERSION_font-bitstream-100dpi ?= "1.0.1"
PREFERRED_VERSION_font-bitstream-75dpi ?= "1.0.1"
PREFERRED_VERSION_font-bitstream-speedo ?= "1.0.1"
PREFERRED_VERSION_font-bitstream-type1 ?= "1.0.1"
PREFERRED_VERSION_font-cronyx-cyrillic ?= "1.0.1"
PREFERRED_VERSION_font-cursor-misc ?= "1.0.1"
PREFERRED_VERSION_font-daewoo-misc ?= "1.0.1"
PREFERRED_VERSION_font-dec-misc ?= "1.0.1"
PREFERRED_VERSION_font-ibm-type1 ?= "1.0.1"
PREFERRED_VERSION_font-isas-misc ?= "1.0.1"
PREFERRED_VERSION_font-jis-misc ?= "1.0.1"
PREFERRED_VERSION_font-micro-misc ?= "1.0.1"
PREFERRED_VERSION_font-misc-cyrillic ?= "1.0.1"
PREFERRED_VERSION_font-misc-ethiopic ?= "1.0.1"
PREFERRED_VERSION_font-misc-meltho ?= "1.0.1"
PREFERRED_VERSION_font-misc-misc ?= "1.1.0"
PREFERRED_VERSION_font-mutt-misc ?= "1.0.1"
PREFERRED_VERSION_font-schumacher-misc ?= "1.1.0"
PREFERRED_VERSION_font-screen-cyrillic ?= "1.0.2"
PREFERRED_VERSION_font-sony-misc ?= "1.0.1"
PREFERRED_VERSION_font-sun-misc ?= "1.0.1"
PREFERRED_VERSION_font-util ?= "1.1.1"
PREFERRED_VERSION_font-util-native ?= "1.1.1"
PREFERRED_VERSION_font-winitzki-cyrillic ?= "1.0.1"
PREFERRED_VERSION_font-xfree86-type1 ?= "1.0.2"
#lib
PREFERRED_VERSION_libapplewm ?= "1.4.0"
PREFERRED_VERSION_libfs ?= "1.0.2"
PREFERRED_VERSION_libice ?= "1.0.6"
PREFERRED_VERSION_libice-native ?= "1.0.6"
PREFERRED_VERSION_libsm ?= "1.1.1"
PREFERRED_VERSION_libsm-native ?= "1.1.1"
PREFERRED_VERSION_libwindowswm ?= "1.0.1"
PREFERRED_VERSION_libx11 ?= "1.3.3"
PREFERRED_VERSION_libx11-native ?= "1.3.3"
PREFERRED_VERSION_libxscrnsaver ?= "1.2.0"
PREFERRED_VERSION_libxtrap ?= "1.0.0"
PREFERRED_VERSION_libxau ?= "1.0.5"
PREFERRED_VERSION_libxau-native ?= "1.0.5"
PREFERRED_VERSION_libxaw ?= "1.0.7"
PREFERRED_VERSION_libxcomposite ?= "0.4.1"
PREFERRED_VERSION_libxcursor ?= "1.1.10"
PREFERRED_VERSION_libxcursor-native ?= "1.1.10"
PREFERRED_VERSION_libxdamage ?= "1.1.2"
PREFERRED_VERSION_libxdmcp ?= "1.0.3"
PREFERRED_VERSION_libxdmcp-native ?= "1.0.3"
PREFERRED_VERSION_libxevie ?= "1.0.2"
PREFERRED_VERSION_libxext ?= "1.1.1"
PREFERRED_VERSION_libxext-native ?= "1.1.1"
PREFERRED_VERSION_libxfixes ?= "4.0.4"
PREFERRED_VERSION_libxfixes-native ?= "4.0.4"
PREFERRED_VERSION_libxfont ?= "1.4.1"
PREFERRED_VERSION_libxfont-native ?= "1.4.1"
PREFERRED_VERSION_libxfontcache ?= "1.0.5"
PREFERRED_VERSION_libxft ?= "2.1.14"
PREFERRED_VERSION_libxi ?= "1.3"
PREFERRED_VERSION_libxinerama ?= "1.1"
PREFERRED_VERSION_libxmu ?= "1.0.5"
PREFERRED_VERSION_libxp ?= "1.0.0"
PREFERRED_VERSION_libxpm ?= "3.5.8"
PREFERRED_VERSION_libxprintapputil ?= "1.0.1"
PREFERRED_VERSION_libxprintutil ?= "1.0.1"
PREFERRED_VERSION_libxrandr ?= "1.3.0"
PREFERRED_VERSION_libxrender ?= "0.9.5"
PREFERRED_VERSION_libxrender-native ?= "0.9.5"
PREFERRED_VERSION_libxres ?= "1.0.4"
PREFERRED_VERSION_libxt ?= "1.0.7"
PREFERRED_VERSION_libxt-native ?= "1.0.7"
PREFERRED_VERSION_libxtst ?= "1.1.0"
PREFERRED_VERSION_libxv ?= "1.0.5"
PREFERRED_VERSION_libxvmc ?= "1.0.5"
PREFERRED_VERSION_libxxf86dga ?= "1.1.1"
PREFERRED_VERSION_libxxf86misc ?= "1.0.2"
PREFERRED_VERSION_libxxf86vm ?= "1.1.0"
PREFERRED_VERSION_libdmx ?= "1.1.0"
PREFERRED_VERSION_libfontenc ?= "1.0.5"
PREFERRED_VERSION_libfontenc-native ?= "1.0.5"
PREFERRED_VERSION_liblbxutil ?= "1.1.0"
PREFERRED_VERSION_liboldx ?= "1.0.1"
PREFERRED_VERSION_libpciaccess ?= "0.11.0"
PREFERRED_VERSION_libxkbfile ?= "1.0.6"
PREFERRED_VERSION_libxkbfile-native ?= "1.0.6"
PREFERRED_VERSION_libxkbui ?= "1.0.2"
PREFERRED_VERSION_pixman ?= "0.17.8"
PREFERRED_VERSION_xtrans ?= "1.2.5"
PREFERRED_VERSION_xtrans-native ?= "1.2.5"
#proto
PREFERRED_VERSION_applewmproto ?= "1.4.1"
PREFERRED_VERSION_bigreqsproto ?= "1.1.0"
PREFERRED_VERSION_bigreqsproto-native ?= "1.1.0"
PREFERRED_VERSION_compositeproto ?= "0.4.1"
PREFERRED_VERSION_damageproto ?= "1.2.0"
PREFERRED_VERSION_dmxproto ?= "2.3"
PREFERRED_VERSION_dri2proto ?= "2.3"
PREFERRED_VERSION_evieext ?= "1.1.0"
PREFERRED_VERSION_fixesproto ?= "4.1.1"
PREFERRED_VERSION_fixesproto-native ?= "4.1.1"
PREFERRED_VERSION_fontcacheproto ?= "0.1.3"
PREFERRED_VERSION_fontcacheproto-native ?= "0.1.3"
PREFERRED_VERSION_fontsproto ?= "2.1.0"
PREFERRED_VERSION_fontsproto-native ?= "2.1.0"
PREFERRED_VERSION_glproto ?= "1.4.11"
PREFERRED_VERSION_inputproto ?= "2.0"
PREFERRED_VERSION_inputproto-native ?= "2.0"
PREFERRED_VERSION_kbproto ?= "1.0.4"
PREFERRED_VERSION_kbproto-native ?= "1.0.4"
PREFERRED_VERSION_printproto ?= "1.0.4"
PREFERRED_VERSION_randrproto ?= "1.3.1"
PREFERRED_VERSION_recordproto ?= "1.14"
PREFERRED_VERSION_renderproto ?= "0.11"
PREFERRED_VERSION_renderproto-native ?= "0.11"
PREFERRED_VERSION_resourceproto ?= "1.1.0"
PREFERRED_VERSION_scrnsaverproto ?= "1.2.0"
PREFERRED_VERSION_trapproto ?= "3.4.3"
PREFERRED_VERSION_videoproto ?= "2.3.0"
PREFERRED_VERSION_windowswmproto ?= "1.0.4"
PREFERRED_VERSION_xcmiscproto ?= "1.2.0"
PREFERRED_VERSION_xcmiscproto-native ?= "1.2.0"
PREFERRED_VERSION_xextproto ?= "7.1.1"
PREFERRED_VERSION_xextproto-native ?= "7.1.1"
PREFERRED_VERSION_xf86bigfontproto ?= "1.2.0"
PREFERRED_VERSION_xf86bigfontproto-native ?= "1.2.0"
PREFERRED_VERSION_xf86dgaproto ?= "2.1"
PREFERRED_VERSION_xf86driproto ?= "2.1.0"
PREFERRED_VERSION_xf86miscproto ?= "0.9.3"
PREFERRED_VERSION_xf86rushproto ?= "1.1.2"
PREFERRED_VERSION_xf86vidmodeproto ?= "2.3"
PREFERRED_VERSION_xineramaproto ?= "1.2"
PREFERRED_VERSION_xproto ?= "7.0.16"
PREFERRED_VERSION_xproto-native ?= "7.0.16"
PREFERRED_VERSION_xproxymanagementprotocol ?= "1.0.3"
#util
PREFERRED_VERSION_gccmakedep ?= "1.0.2"
PREFERRED_VERSION_imake ?= "1.0.2"
PREFERRED_VERSION_lndir ?= "1.0.1"
PREFERRED_VERSION_makedepend ?= "1.0.2"
PREFERRED_VERSION_makedepend-native ?= "1.0.2"
PREFERRED_VERSION_util-macros ?= "1.6.0"
PREFERRED_VERSION_util-macros-native ?= "1.6.0"
PREFERRED_VERSION_xorg-cf-files ?= "1.0.3"
#xserver
PREFERRED_VERSION_xserver-xorg ?= "1.7.999"
```
