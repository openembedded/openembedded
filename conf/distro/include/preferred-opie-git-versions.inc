## conf/distro/include/preferred-xorg-versions-X11R7.0.inc
```bitbake
PREFERRED_PROVIDER_virtual/xserver = "xserver-xorg"

PREFERRED_PROVIDER_libxext = "libxext"
PREFERRED_PROVIDER_xext = "libxext"
PREFERRED_PROVIDER_libxi = "libxi"
PREFERRED_PROVIDER_libxft = "libxft"
PREFERRED_PROVIDER_virtual/libx11 = "libx11"
PREFERRED_PROVIDER_libxpm = "libxpm"
PREFERRED_PROVIDER_xpm = "libxpm"
PREFERRED_PROVIDER_libxt = "libxt"
PREFERRED_PROVIDER_libxaw = "libxaw"
PREFERRED_PROVIDER_libice = "libice"
PREFERRED_PROVIDER_libxrender = "libxrender"
PREFERRED_PROVIDER_libxcursor = "libxcursor"
PREFERRED_PROVIDER_xextensions = "xextensions"
PREFERRED_PROVIDER_xproto = "xproto"
PREFERRED_PROVIDER_x11 = "libx11"
PREFERRED_PROVIDER_libxv = "libxv"
PREFERRED_PROVIDER_xft = "libxft"
PREFERRED_PROVIDER_libxrandr = "libxrandr"
PREFERRED_PROVIDER_libxdamage = "libxdamage"
PREFERRED_PROVIDER_libxcomposite = "libxcomposite"
PREFERRED_PROVIDER_libxfixes = "libxfixes"
PREFERRED_PROVIDER_libxinerama = "libxinerama"
PREFERRED_PROVIDER_libxxf86vm = "libxxf86vm"
PREFERRED_PROVIDER_libxmu = "libxmu"
PREFERRED_PROVIDER_libsm = "libsm"
PREFERRED_PROVIDER_xrandr = "xrandr"
PREFERRED_PROVIDER_xserver = "xserver-xorg"
PREFERRED_PROVIDER_virtual/xorg = "xserver-xorg"

PREFERRED_VERSION_task-xorg = "X11R7.0"

PREFERRED_VERSION_appres = "X11R7.0-1.0.0"
PREFERRED_VERSION_bdftopcf-native = "X11R7.0-1.0.0"
PREFERRED_VERSION_bdftopcf = "X11R7.0-1.0.0"
PREFERRED_VERSION_beforelight = "X11R7.0-1.0.1"
PREFERRED_VERSION_bitmap = "X11R7.0-1.0.1"
PREFERRED_VERSION_editres = "X11R7.0-1.0.1"
PREFERRED_VERSION_fonttosfnt = "X11R7.0-1.0.1"
PREFERRED_VERSION_fslsfonts = "X11R7.0-1.0.1"
PREFERRED_VERSION_fstobdf = "X11R7.0-1.0.1"
PREFERRED_VERSION_iceauth = "X11R7.0-1.0.1"
PREFERRED_VERSION_ico = "X11R7.0-1.0.1"
PREFERRED_VERSION_lbxproxy = "X11R7.0-1.0.1"
PREFERRED_VERSION_listres = "X11R7.0-1.0.1"
PREFERRED_VERSION_luit = "X11R7.0-1.0.1"
PREFERRED_VERSION_mkcfm = "X11R7.0-1.0.1"
PREFERRED_VERSION_mkfontdir-native = "X11R7.0-1.0.1"
PREFERRED_VERSION_mkfontdir = "X11R7.0-1.0.1"
PREFERRED_VERSION_mkfontscale-native = "X11R7.0-1.0.1"
PREFERRED_VERSION_mkfontscale = "X11R7.0-1.0.1"
PREFERRED_VERSION_oclock = "X11R7.0-1.0.1"
PREFERRED_VERSION_proxymngr = "X11R7.0-1.0.1"
PREFERRED_VERSION_rgb = "X11R7.0-1.0.0"
PREFERRED_VERSION_rstart = "X11R7.0-1.0.1"
PREFERRED_VERSION_scripts = "X11R7.0-1.0.1"
PREFERRED_VERSION_sessreg = "X11R7.0-1.0.0"
PREFERRED_VERSION_setxkbmap = "X11R7.0-1.0.1"
PREFERRED_VERSION_showfont = "X11R7.0-1.0.1"
PREFERRED_VERSION_smproxy = "X11R7.0-1.0.1"
PREFERRED_VERSION_twm = "X11R7.0-1.0.1"
PREFERRED_VERSION_viewres = "X11R7.0-1.0.1"
PREFERRED_VERSION_x11perf = "X11R7.0-1.0.1"
PREFERRED_VERSION_xauth = "X11R7.0-1.0.1"
PREFERRED_VERSION_xbiff = "X11R7.0-1.0.1"
PREFERRED_VERSION_xcalc = "X11R7.0-1.0.1"
PREFERRED_VERSION_xclipboard = "X11R7.0-1.0.1"
PREFERRED_VERSION_xclock = "X11R7.0-1.0.1"
PREFERRED_VERSION_xcmsdb = "X11R7.0-1.0.1"
PREFERRED_VERSION_xconsole = "X11R7.0-1.0.1"
PREFERRED_VERSION_xcursorgen = "X11R7.0-1.0.0"
PREFERRED_VERSION_xdbedizzy = "X11R7.0-1.0.1"
PREFERRED_VERSION_xditview = "X11R7.0-1.0.1"
PREFERRED_VERSION_xdm = "X11R7.0-1.0.1"
PREFERRED_VERSION_xdpyinfo = "X11R7.0-1.0.1"
PREFERRED_VERSION_xdriinfo = "X11R7.0-1.0.0"
PREFERRED_VERSION_xedit = "X11R7.0-1.0.1"
PREFERRED_VERSION_xev = "X11R7.0-1.0.1"
PREFERRED_VERSION_xeyes = "X11R7.0-1.0.1"
PREFERRED_VERSION_xf86dga = "X11R7.0-1.0.1"
PREFERRED_VERSION_xfd = "X11R7.0-1.0.1"
PREFERRED_VERSION_xfindproxy = "X11R7.0-1.0.1"
PREFERRED_VERSION_xfontsel = "X11R7.0-1.0.1"
PREFERRED_VERSION_xfs = "X11R7.0-1.0.1"
PREFERRED_VERSION_xfsinfo = "X11R7.0-1.0.1"
PREFERRED_VERSION_xfwp = "X11R7.0-1.0.1"
PREFERRED_VERSION_xgamma = "X11R7.0-1.0.1"
PREFERRED_VERSION_xgc = "X11R7.0-1.0.1"
PREFERRED_VERSION_xhost = "X11R7.0-1.0.0"
PREFERRED_VERSION_xinit = "X11R7.0-1.0.1"
PREFERRED_VERSION_xkbcomp = "X11R7.0-1.0.1"
PREFERRED_VERSION_xkbevd = "X11R7.0-1.0.1"
PREFERRED_VERSION_xkbprint = "X11R7.0-1.0.1"
PREFERRED_VERSION_xkbutils = "X11R7.0-1.0.1"
PREFERRED_VERSION_xkill = "X11R7.0-1.0.1"
PREFERRED_VERSION_xload = "X11R7.0-1.0.1"
PREFERRED_VERSION_xlogo = "X11R7.0-1.0.1"
PREFERRED_VERSION_xlsatoms = "X11R7.0-1.0.1"
PREFERRED_VERSION_xlsclients = "X11R7.0-1.0.1"
PREFERRED_VERSION_xlsfonts = "X11R7.0-1.0.1"
PREFERRED_VERSION_xmag = "X11R7.0-1.0.1"
PREFERRED_VERSION_xman = "X11R7.0-1.0.1"
PREFERRED_VERSION_xmessage = "X11R7.0-1.0.1"
PREFERRED_VERSION_xmh = "X11R7.0-1.0.1"
PREFERRED_VERSION_xmodmap = "X11R7.0-1.0.0"
PREFERRED_VERSION_xmore = "X11R7.0-1.0.1"
PREFERRED_VERSION_xphelloworld = "X11R7.0-1.0.1"
PREFERRED_VERSION_xplsprinters = "X11R7.0-1.0.1"
PREFERRED_VERSION_xpr = "X11R7.0-1.0.1"
PREFERRED_VERSION_xprehashprinterlist = "X11R7.0-1.0.1"
PREFERRED_VERSION_xprop = "X11R7.0-1.0.1"
PREFERRED_VERSION_xrandr = "X11R7.0-1.0.1"
PREFERRED_VERSION_xrdb = "X11R7.0-1.0.1"
PREFERRED_VERSION_xrefresh = "X11R7.0-1.0.1"
PREFERRED_VERSION_xrx = "X11R7.0-1.0.1"
PREFERRED_VERSION_xset = "X11R7.0-1.0.1"
PREFERRED_VERSION_xsetmode = "X11R7.0-1.0.0"
PREFERRED_VERSION_xsetpointer = "X11R7.0-1.0.0"
PREFERRED_VERSION_xsetroot = "X11R7.0-1.0.1"
PREFERRED_VERSION_xsm = "X11R7.0-1.0.1"
PREFERRED_VERSION_xstdcmap = "X11R7.0-1.0.1"
PREFERRED_VERSION_xtrap = "X11R7.0-1.0.1"
PREFERRED_VERSION_xvidtune = "X11R7.0-1.0.1"
PREFERRED_VERSION_xvinfo = "X11R7.0-1.0.1"
PREFERRED_VERSION_xwd = "X11R7.0-1.0.1"
PREFERRED_VERSION_xwininfo = "X11R7.0-1.0.1"
PREFERRED_VERSION_xwud = "X11R7.0-1.0.1"
PREFERRED_VERSION_xbitmaps = "X11R7.0-1.0.1"
PREFERRED_VERSION_xcursor-themes = "X11R7.0-1.0.1"
PREFERRED_VERSION_xkbdata = "X11R7.0-1.0.1"
PREFERRED_VERSION_xorg-docs = "X11R7.0-1.0.1"
PREFERRED_VERSION_xorg-sgml-doctools = "X11R7.0-1.0.1"
PREFERRED_VERSION_xf86-input-acecad = "X11R7.0-1.0.0.5"
PREFERRED_VERSION_xf86-input-aiptek = "X11R7.0-1.0.0.5"
PREFERRED_VERSION_xf86-input-calcomp = "X11R7.0-1.0.0.5"
PREFERRED_VERSION_xf86-input-citron = "X11R7.0-2.1.1.5"
PREFERRED_VERSION_xf86-input-digitaledge = "X11R7.0-1.0.1.3"
PREFERRED_VERSION_xf86-input-dmc = "X11R7.0-1.0.0.5"
PREFERRED_VERSION_xf86-input-dynapro = "X11R7.0-1.0.0.5"
PREFERRED_VERSION_xf86-input-elo2300 = "X11R7.0-1.0.0.5"
PREFERRED_VERSION_xf86-input-elographics = "X11R7.0-1.0.0.5"
PREFERRED_VERSION_xf86-input-evdev = "X11R7.0-1.0.0.5"
PREFERRED_VERSION_xf86-input-fpit = "X11R7.0-1.0.0.5"
PREFERRED_VERSION_xf86-input-hyperpen = "X11R7.0-1.0.0.5"
PREFERRED_VERSION_xf86-input-jamstudio = "X11R7.0-1.0.0.5"
PREFERRED_VERSION_xf86-input-joystick = "X11R7.0-1.0.0.5"
PREFERRED_VERSION_xf86-input-keyboard = "X11R7.0-1.0.1.3"
PREFERRED_VERSION_xf86-input-magellan = "X11R7.0-1.0.0.5"
PREFERRED_VERSION_xf86-input-magictouch = "X11R7.0-1.0.0.5"
PREFERRED_VERSION_xf86-input-microtouch = "X11R7.0-1.0.0.5"
PREFERRED_VERSION_xf86-input-mouse = "X11R7.0-1.0.3.1"
PREFERRED_VERSION_xf86-input-mutouch = "X11R7.0-1.0.0.5"
PREFERRED_VERSION_xf86-input-palmax = "X11R7.0-1.0.0.5"
PREFERRED_VERSION_xf86-input-penmount = "X11R7.0-1.0.0.5"
PREFERRED_VERSION_xf86-input-spaceorb = "X11R7.0-1.0.0.5"
PREFERRED_VERSION_xf86-input-summa = "X11R7.0-1.0.0.5"
PREFERRED_VERSION_xf86-input-tek4957 = "X11R7.0-1.0.0.5"
PREFERRED_VERSION_xf86-input-ur98 = "X11R7.0-1.0.0.5"
PREFERRED_VERSION_xf86-input-void = "X11R7.0-1.0.0.5"
PREFERRED_VERSION_xf86-video-apm = "X11R7.0-1.0.1.5"
PREFERRED_VERSION_xf86-video-ark = "X11R7.0-0.5.0.5"
PREFERRED_VERSION_xf86-video-ati = "X11R7.0-6.5.7.3"
PREFERRED_VERSION_xf86-video-chips = "X11R7.0-1.0.1.3"
PREFERRED_VERSION_xf86-video-cirrus = "X11R7.0-1.0.0.5"
PREFERRED_VERSION_xf86-video-cyrix = "X11R7.0-1.0.0.5"
PREFERRED_VERSION_xf86-video-dummy = "X11R7.0-0.1.0.5"
PREFERRED_VERSION_xf86-video-fbdev = "X11R7.0-0.1.0.5"
PREFERRED_VERSION_xf86-video-glint = "X11R7.0-1.0.1.3"
PREFERRED_VERSION_xf86-video-i128 = "X11R7.0-1.1.0.5"
PREFERRED_VERSION_xf86-video-i740 = "X11R7.0-1.0.0.5"
PREFERRED_VERSION_xf86-video-i810 = "X11R7.0-1.4.1.3"
PREFERRED_VERSION_xf86-video-imstt = "X11R7.0-1.0.0.5"
PREFERRED_VERSION_xf86-video-mga = "X11R7.0-1.2.1.3"
PREFERRED_VERSION_xf86-video-neomagic = "X11R7.0-1.0.0.5"
PREFERRED_VERSION_xf86-video-newport = "X11R7.0-0.1.4.1"
PREFERRED_VERSION_xf86-video-nsc = "X11R7.0-2.7.6.5"
PREFERRED_VERSION_xf86-video-nv = "X11R7.0-1.0.1.5"
PREFERRED_VERSION_xf86-video-rendition = "X11R7.0-4.0.1.3"
PREFERRED_VERSION_xf86-video-s3 = "X11R7.0-0.3.5.5"
PREFERRED_VERSION_xf86-video-s3virge = "X11R7.0-1.8.6.5"
PREFERRED_VERSION_xf86-video-savage = "X11R7.0-2.0.2.3"
PREFERRED_VERSION_xf86-video-siliconmotion = "X11R7.0-1.3.1.5"
PREFERRED_VERSION_xf86-video-sis = "X11R7.0-0.8.1.3"
PREFERRED_VERSION_xf86-video-sisusb = "X11R7.0-0.7.1.3"
PREFERRED_VERSION_xf86-video-sunbw2 = "X11R7.0-1.0.0.5"
PREFERRED_VERSION_xf86-video-suncg14 = "X11R7.0-1.0.0.5"
PREFERRED_VERSION_xf86-video-suncg3 = "X11R7.0-1.0.0.5"
PREFERRED_VERSION_xf86-video-suncg6 = "X11R7.0-1.0.0.5"
PREFERRED_VERSION_xf86-video-sunffb = "X11R7.0-1.0.1.3"
PREFERRED_VERSION_xf86-video-sunleo = "X11R7.0-1.0.0.5"
PREFERRED_VERSION_xf86-video-suntcx = "X11R7.0-1.0.0.5"
PREFERRED_VERSION_xf86-video-tdfx = "X11R7.0-1.1.1.3"
PREFERRED_VERSION_xf86-video-tga = "X11R7.0-1.0.0.5"
PREFERRED_VERSION_xf86-video-trident = "X11R7.0-1.0.1.2"
PREFERRED_VERSION_xf86-video-tseng = "X11R7.0-1.0.0.5"
PREFERRED_VERSION_xf86-video-v4l = "X11R7.0-0.0.1.5"
PREFERRED_VERSION_xf86-video-vesa = "X11R7.0-1.0.1.3"
PREFERRED_VERSION_xf86-video-vga = "X11R7.0-4.0.0.5"
PREFERRED_VERSION_xf86-video-via = "X11R7.0-0.1.33.2"
PREFERRED_VERSION_xf86-video-vmware = "X11R7.0-10.11.1.3"
PREFERRED_VERSION_xf86-video-voodoo = "X11R7.0-1.0.0.5"
PREFERRED_VERSION_encodings = "X11R7.0-1.0.0"
PREFERRED_VERSION_font-adobe-100dpi = "X11R7.0-1.0.0"
PREFERRED_VERSION_font-adobe-75dpi = "X11R7.0-1.0.0"
PREFERRED_VERSION_font-adobe-utopia-100dpi = "X11R7.0-1.0.1"
PREFERRED_VERSION_font-adobe-utopia-75dpi = "X11R7.0-1.0.1"
PREFERRED_VERSION_font-adobe-utopia-type1 = "X11R7.0-1.0.1"
PREFERRED_VERSION_font-alias = "X11R7.0-1.0.1"
PREFERRED_VERSION_font-arabic-misc = "X11R7.0-1.0.0"
PREFERRED_VERSION_font-bh-100dpi = "X11R7.0-1.0.0"
PREFERRED_VERSION_font-bh-75dpi = "X11R7.0-1.0.0"
PREFERRED_VERSION_font-bh-lucidatypewriter-100dpi = "X11R7.0-1.0.0"
PREFERRED_VERSION_font-bh-lucidatypewriter-75dpi = "X11R7.0-1.0.0"
PREFERRED_VERSION_font-bh-ttf = "X11R7.0-1.0.0"
PREFERRED_VERSION_font-bh-type1 = "X11R7.0-1.0.0"
PREFERRED_VERSION_font-bitstream-100dpi = "X11R7.0-1.0.0"
PREFERRED_VERSION_font-bitstream-75dpi = "X11R7.0-1.0.0"
PREFERRED_VERSION_font-bitstream-speedo = "X11R7.0-1.0.0"
PREFERRED_VERSION_font-bitstream-type1 = "X11R7.0-1.0.0"
PREFERRED_VERSION_font-cronyx-cyrillic = "X11R7.0-1.0.0"
PREFERRED_VERSION_font-cursor-misc = "X11R7.0-1.0.0"
PREFERRED_VERSION_font-daewoo-misc = "X11R7.0-1.0.0"
PREFERRED_VERSION_font-dec-misc = "X11R7.0-1.0.0"
PREFERRED_VERSION_font-ibm-type1 = "X11R7.0-1.0.0"
PREFERRED_VERSION_font-isas-misc = "X11R7.0-1.0.0"
PREFERRED_VERSION_font-jis-misc = "X11R7.0-1.0.0"
PREFERRED_VERSION_font-micro-misc = "X11R7.0-1.0.0"
PREFERRED_VERSION_font-misc-cyrillic = "X11R7.0-1.0.0"
PREFERRED_VERSION_font-misc-ethiopic = "X11R7.0-1.0.0"
PREFERRED_VERSION_font-misc-meltho = "X11R7.0-1.0.0"
PREFERRED_VERSION_font-misc-misc = "X11R7.0-1.0.0"
PREFERRED_VERSION_font-mutt-misc = "X11R7.0-1.0.0"
PREFERRED_VERSION_font-schumacher-misc = "X11R7.0-1.0.0"
PREFERRED_VERSION_font-screen-cyrillic = "X11R7.0-1.0.0"
PREFERRED_VERSION_font-sony-misc = "X11R7.0-1.0.0"
PREFERRED_VERSION_font-sun-misc = "X11R7.0-1.0.0"
PREFERRED_VERSION_font-util-native = "X11R7.0-1.0.0"
PREFERRED_VERSION_font-util = "X11R7.0-1.0.0"
PREFERRED_VERSION_font-winitzki-cyrillic = "X11R7.0-1.0.0"
PREFERRED_VERSION_font-xfree86-type1 = "X11R7.0-1.0.0"
PREFERRED_VERSION_diet-x11 = "X11R7.0-1.0.0"
PREFERRED_VERSION_libapplewm = "X11R7.0-1.0.0"
PREFERRED_VERSION_libdmx = "X11R7.0-1.0.1"
PREFERRED_VERSION_libfontenc-native = "X11R7.0-1.0.1"
PREFERRED_VERSION_libfontenc = "X11R7.0-1.0.1"
PREFERRED_VERSION_libfs = "X11R7.0-1.0.0"
PREFERRED_VERSION_libice = "X11R7.0-1.0.0"
PREFERRED_VERSION_liblbxutil = "X11R7.0-1.0.0"
PREFERRED_VERSION_liboldx = "X11R7.0-1.0.1"
PREFERRED_VERSION_libsm = "X11R7.0-1.0.0"
PREFERRED_VERSION_libwindowswm = "X11R7.0-1.0.0"
PREFERRED_VERSION_libx11-native = "X11R7.0-1.0.0"
PREFERRED_VERSION_libx11 = "X11R7.0-1.0.0"
PREFERRED_VERSION_libxau-native = "X11R7.0-1.0.0"
PREFERRED_VERSION_libxau = "X11R7.0-1.0.0"
PREFERRED_VERSION_libxaw = "X11R7.0-1.0.1"
PREFERRED_VERSION_libxcomposite = "X11R7.0-0.2.2.2"
PREFERRED_VERSION_libxcursor = "X11R7.0-1.1.5.2"
PREFERRED_VERSION_libxdamage = "X11R7.0-1.0.2.2"
PREFERRED_VERSION_libxdmcp-native = "X11R7.0-1.0.0"
PREFERRED_VERSION_libxdmcp = "X11R7.0-1.0.0"
PREFERRED_VERSION_libxevie = "X11R7.0-1.0.0"
PREFERRED_VERSION_libxext = "X11R7.0-1.0.0"
PREFERRED_VERSION_libxfixes = "X11R7.0-3.0.1.2"
PREFERRED_VERSION_libxfont-native = "X11R7.0-1.0.0"
PREFERRED_VERSION_libxfont = "X11R7.0-1.0.0"
PREFERRED_VERSION_libxfontcache = "X11R7.0-1.0.1"
PREFERRED_VERSION_libxft = "X11R7.0-2.1.8.2"
PREFERRED_VERSION_libxi = "X11R7.0-1.0.0"
PREFERRED_VERSION_libxinerama = "X11R7.0-1.0.1"
PREFERRED_VERSION_libxkbfile = "X11R7.0-1.0.1"
PREFERRED_VERSION_libxkbui = "X11R7.0-1.0.1"
PREFERRED_VERSION_libxmu = "X11R7.0-1.0.0"
PREFERRED_VERSION_libxp = "X11R7.0-1.0.0"
PREFERRED_VERSION_libxpm = "X11R7.0-3.5.4.2"
PREFERRED_VERSION_libxprintapputil = "X11R7.0-1.0.1"
PREFERRED_VERSION_libxprintutil = "X11R7.0-1.0.1"
PREFERRED_VERSION_libxrandr = "X11R7.0-1.1.0.2"
PREFERRED_VERSION_libxrender = "X11R7.0-0.9.0.2"
PREFERRED_VERSION_libxres = "X11R7.0-1.0.0"
PREFERRED_VERSION_libxscrnsaver = "X11R7.0-1.0.1"
PREFERRED_VERSION_libxt = "X11R7.0-1.0.0"
PREFERRED_VERSION_libxtrap = "X11R7.0-1.0.0"
PREFERRED_VERSION_libxtst = "X11R7.0-1.0.1"
PREFERRED_VERSION_libxv = "X11R7.0-1.0.1"
PREFERRED_VERSION_libxvmc = "X11R7.0-1.0.1"
PREFERRED_VERSION_libxxf86dga = "X11R7.0-1.0.0"
PREFERRED_VERSION_libxxf86misc = "X11R7.0-1.0.0"
PREFERRED_VERSION_libxxf86vm = "X11R7.0-1.0.0"
PREFERRED_VERSION_xtrans-native = "X11R7.0-1.0.0"
PREFERRED_VERSION_xtrans = "X11R7.0-1.0.0"
PREFERRED_VERSION_applewmproto = "X11R7.0-1.0.3"
PREFERRED_VERSION_bigreqsproto-native = "X11R7.0-1.0.2"
PREFERRED_VERSION_bigreqsproto = "X11R7.0-1.0.2"
PREFERRED_VERSION_compositeproto = "X11R7.0-0.2.2"
PREFERRED_VERSION_damageproto = "X11R7.0-1.0.3"
PREFERRED_VERSION_dmxproto = "X11R7.0-2.2.2"
PREFERRED_VERSION_evieext = "X11R7.0-1.0.2"
PREFERRED_VERSION_fixesproto = "X11R7.0-3.0.2"
PREFERRED_VERSION_fontcacheproto-native = "X11R7.0-0.1.2"
PREFERRED_VERSION_fontcacheproto = "X11R7.0-0.1.2"
PREFERRED_VERSION_fontsproto-native = "X11R7.0-2.0.2"
PREFERRED_VERSION_fontsproto = "X11R7.0-2.0.2"
PREFERRED_VERSION_glproto = "X11R7.0-1.4.3"
PREFERRED_VERSION_inputproto-native = "X11R7.0-1.3.2"
PREFERRED_VERSION_inputproto = "X11R7.0-1.3.2"
PREFERRED_VERSION_kbproto-native = "X11R7.0-1.0.2"
PREFERRED_VERSION_kbproto = "X11R7.0-1.0.2"
PREFERRED_VERSION_printproto = "X11R7.0-1.0.3"
PREFERRED_VERSION_randrproto = "X11R7.0-1.1.2"
PREFERRED_VERSION_recordproto = "X11R7.0-1.13.2"
PREFERRED_VERSION_renderproto = "X11R7.0-0.9.2"
PREFERRED_VERSION_resourceproto = "X11R7.0-1.0.2"
PREFERRED_VERSION_scrnsaverproto = "X11R7.0-1.0.2"
PREFERRED_VERSION_trapproto = "X11R7.0-3.4.3"
PREFERRED_VERSION_videoproto = "X11R7.0-2.2.2"
PREFERRED_VERSION_windowswmproto = "X11R7.0-1.0.3"
PREFERRED_VERSION_xcmiscproto-native = "X11R7.0-1.1.2"
PREFERRED_VERSION_xcmiscproto = "X11R7.0-1.1.2"
PREFERRED_VERSION_xextproto-native = "X11R7.0-7.0.2"
PREFERRED_VERSION_xextproto = "X11R7.0-7.0.2"
PREFERRED_VERSION_xf86bigfontproto-native = "X11R7.0-1.1.2"
PREFERRED_VERSION_xf86bigfontproto = "X11R7.0-1.1.2"
PREFERRED_VERSION_xf86dgaproto = "X11R7.0-2.0.2"
PREFERRED_VERSION_xf86driproto = "X11R7.0-2.0.3"
PREFERRED_VERSION_xf86miscproto = "X11R7.0-0.9.2"
PREFERRED_VERSION_xf86rushproto = "X11R7.0-1.1.2"
PREFERRED_VERSION_xf86vidmodeproto = "X11R7.0-2.2.2"
PREFERRED_VERSION_xineramaproto = "X11R7.0-1.1.2"
PREFERRED_VERSION_xproto-native = "X11R7.0-7.0.4"
PREFERRED_VERSION_xproto = "X11R7.0-7.0.4"
PREFERRED_VERSION_xproxymanagementprotocol = "X11R7.0-1.0.2"
PREFERRED_VERSION_gccmakedep = "X11R7.0-1.0.1"
PREFERRED_VERSION_imake = "X11R7.0-1.0.1"
PREFERRED_VERSION_lndir = "X11R7.0-1.0.1"
PREFERRED_VERSION_makedepend = "X11R7.0-1.0.0"
PREFERRED_VERSION_util-macros-native = "X11R7.0-1.0.1"
PREFERRED_VERSION_util-macros = "X11R7.0-1.0.1"
PREFERRED_VERSION_xorg-cf-files = "X11R7.0-1.0.1"
PREFERRED_VERSION_xserver-xorg = "X11R7.0-1.0.1"
```
