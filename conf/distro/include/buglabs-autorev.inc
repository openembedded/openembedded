## conf/distro/include/oplinux.inc
```bitbake
# Copyright (C) 2007, Stelios Koroneos - Digital OPSiS, All Rights Reserved
# Released under the MIT license (see packages/COPYING)

# extra checking for needed tools
#
# set minimal version of BitBake needed
BB_MIN_VERSION = "1.8.10"

#OPLinux and OPLinux-uclibc source mirrors
INHERIT += "oplinux-mirrors"

# check for required tools and minimal BitBake version
INHERIT += "sanity"



# Naming schemes
INHERIT += "package_ipk debian"
PARALLEL_INSTALL_MODULES = "1"


#
# Maintainer email
MAINTAINER = "Digital OPSiS Developers Team <oplinux-developers@digital-opsis.com>"


#
# Packaging and output format
IMAGE_FSTYPES = "tar.gz jffs2 ext2.gz cramfs squashfs squashfs-lzma cpio.gz"

# Specifies a location to search for pre-generated tarballs when fetching
# a cvs:// URI. Outcomment this, if you always want to pull directly from CVS.
#CVS_TARBALL_STASH = "http://www.digital-opsis.com/oplinux/sources/"

PREMIRRORS = "(ftp|http)://.*/.*/ http://source.digital-opsis.com/"

#
# Bootstrap & Init
PREFERRED_PROVIDER_task-bootstrap = "task-base"

# We want images supporting the following features (for task-base
DISTRO_FEATURES = "nfs smbfs ext2 usbhost pci"


#We need to set this to avoid problems when building for if host=target
TARGET_VENDOR = "-oplinux"

#URI for base feeds
OPLINUX_URI = "http://www.digital-opsis.com/oplinux"
OPLINUX-uCLIBC_URI = "http://www.digital-opsis.com/oplinux-uclibc"

#Dir config
IMAGE_ROOTFS = "${TMPDIR}/rootfs/${MACHINE}"
DEPLOY_DIR_IMAGE = "${DEPLOY_DIR}/images/${MACHINE}"

#Set the name of the generated images
IMAGE_NAME = "${DISTRO_NAME}-${IMAGE_BASENAME}-${MACHINE}-${DATE}-${SVN_REV}"


#Do not ship kernel image with the rootfs
IMAGE_PREPROCESS_COMMAND_append = "if [ -f ${IMAGE_ROOTFS}/boot/bzImage ]; then rm \
${IMAGE_ROOTFS}/boot/bzImage*;fi;"



#
#Feed definitions
#
#i32 machines
#i486 machines
FEED_ARCH_x86           ="i486"
FEED_ARCH_wrap          ="i486"

#i586 machines
FEED_ARCH_i586-generic  = "i586"
FEED_ARCH_epia          = "i586"

#i686 machines
FEED_ARCH_i686-generic  = "i686"

#powerpc machines
#ppc405
FEED_ARCH_dht-walnut    = "ppc405"
FEED_ARCH_magicbox      = "ppc405"
FEED_ARCH_xilinx-ml403  = "ppc405"

#ppc440e
FEED_ARCH_sequoia       = "ppc440e"

#ppc603e
FEED_ARCH_efika         = "ppc603e"

#ppce300c2
FEED_ARCH_mpc8323e-rdb  = "ppce300c2"

#avr32
FEED_ARCH_atngw100      = "avr32"
FEED_ARCH_at32stk100    = "avr32"



#
#Preferred versions of packages we need
#
PREFERRED_VERSION_busybox = "1.2.1"
PREFERRED_VERSION_u-boot ?= "1.1.4"
PREFERRED_VERSION_fakeroot ?= "1.7.1"
PREFERRED_VERSION_fakeroot-native ?= "1.7.1"
PREFERRED_VERSION_makedev ?= "2.3.1"
PREFERRED_VERSION_makedevs ?= "1.0.0"
PREFERRED_VERSION_makedevs-native ?= "1.0.0"


# Latest linphone supports yeaphone
PREFERRED_VERSION_linphone ?= "1.6.0"

#
#SSH daemon
#
DISTRO_SSH_DAEMON ?= "dropbear"


#PREFERRED_VERSION_opsis-asterisk-bri_dht-walnut = "1.2.17"
#PREFERRED_VERSION_zaptel-bri_dht-walnut = "1.2.19"
#PREFERRED_VERSION_libpri_dht-walnut = "1.2.4"
```

## conf/distro/include/preferred-aurora-versions.inc
```bitbake
# we need new headers for libc, now OLDEST_KERNEL_linux-gnueabi = "2.6.24"
# and 2.6.31 for fsodeviced
LINUX_LIBC_HEADERS_VERSION ?= "2.6.32"
PREFERRED_VERSION_linux-libc-headers = "${LINUX_LIBC_HEADERS_VERSION}"
PREFERRED_VERSION_linux-libc-headers-native = "${LINUX_LIBC_HEADERS_VERSION}"

# We need git version of tslib as the old 1.0 release does not the support the features we
# need for some mobile handset devices
PREFERRED_VERSION_tslib = "1.0+git%"

# Adjust kernel configuration for older udev versions
UDEV_GE_141 = "1"

# specifically set an openssh version
# NOTE: whenever changing the version here make sure
#       to check we won't loose our specific config !!!
PREFERRED_VERSION_openssh = "5.2p1"
```

## conf/distro/include/preferred-gpe-versions-2.8.inc
```bitbake
#
# Specify which versions of GPE (and related) applications to build
#

#set some preferred providers:
PREFERRED_PROVIDER_gconf="gconf-dbus"
PREFERRED_PROVIDER_gnome-vfs="gnome-vfs"

PREFERRED_VERSION_gaim ?= "2.0.0-cvs-mco1-20050904"

#specify versions, as the header says :)
PREFERRED_VERSION_glib-2.0 ?= "2.8.6"
PREFERRED_VERSION_pango ?= "1.8.2"
PREFERRED_VERSION_gtk+ ?= "2.6.10"
PREFERRED_VERSION_gtk-engines ?= "2.6.5"
PREFERRED_VERSION_librsvg ?= "2.16.1"

PREFERRED_VERSION_libgpewidget ?= "0.115"
PREFERRED_VERSION_libgpepimc ?= "0.9"
PREFERRED_VERSION_libgpevtype ?= "0.50"
PREFERRED_VERSION_libschedule ?= "0.17"
PREFERRED_VERSION_libcontactsdb ?= "0.5"
PREFERRED_VERSION_libtododb ?= "0.11"
PREFERRED_VERSION_libhandoff ?= "0.1"
PREFERRED_VERSION_libmimedir ?= "0.4.2"
PREFERRED_VERSION_libsoundgen ?= "0.6"
PREFERRED_VERSION_libdotdesktop ?= "0.11"
PREFERRED_VERSION_libeventdb ?= "0.90"
PREFERRED_VERSION_libgpelaunch ?= "0.14"
PREFERRED_VERSION_libgtkstylus ?= "0.3"
PREFERRED_VERSION_libxsettings-client ?= "0.17"

PREFERRED_VERSION_gpe-icons ?= "0.25"

PREFERRED_VERSION_gpe-login ?= "0.90"
PREFERRED_VERSION_gpe-session-scripts ?= "0.67"
PREFERRED_VERSION_gpe-su ?= "0.19"
PREFERRED_VERSION_keylaunch ?= "2.0.10"
PREFERRED_VERSION_startup-monitor ?= "0.18-2"
PREFERRED_VERSION_gpe-dm ?= "0.51"
PREFERRED_VERSION_ipaq-sleep ?= "0.9"
PREFERRED_VERSION_teleport ?= "0.34"
PREFERRED_VERSION_xst ?= "0.15"

PREFERRED_VERSION_gpe-aerial ?= "0.3.0"
PREFERRED_VERSION_gpe-appmgr ?= "2.8"
PREFERRED_VERSION_gpe-autostarter ?= "0.12"
PREFERRED_VERSION_gpe-todo ?= "0.56"
PREFERRED_VERSION_gpe-calendar ?= "0.91"
PREFERRED_VERSION_gpe-sketchbook ?= "0.2.9"
PREFERRED_VERSION_gpe-contacts ?= "0.47"
PREFERRED_VERSION_gpe-beam ?= "0.2.9" 
PREFERRED_VERSION_gpe-bluetooth ?= "0.55"
PREFERRED_VERSION_gpe-bootsplash ?= "1.15"
PREFERRED_VERSION_gpe-conf ?= "0.2.6"
PREFERRED_VERSION_gpe-confd ?= "0.16"
PREFERRED_VERSION_gpe-clock ?= "0.25"
PREFERRED_VERSION_gpe-mininet ?= "0.7"
PREFERRED_VERSION_gpe-mixer ?= "0.42"
PREFERRED_VERSION_gpe-shield ?= "0.9"
PREFERRED_VERSION_gpe-taskmanager ?= "0.20"
PREFERRED_VERSION_minilite ?= "0.50"
PREFERRED_VERSION_miniclipboard ?= "0.3"
PREFERRED_VERSION_minimix ?= "0.9"
PREFERRED_VERSION_gpe-edit ?= "0.40"
PREFERRED_VERSION_gpe-gallery ?= "0.97"
PREFERRED_VERSION_gpe-calculator ?= "0.2"
PREFERRED_VERSION_gpe-package ?= "0.4"
PREFERRED_VERSION_gpe-soundbite ?= "1.0.6"
PREFERRED_VERSION_gpe-terminal ?= "1.1"
PREFERRED_VERSION_gpe-watch ?= "0.10"
PREFERRED_VERSION_gpe-what ?= "0.43"
PREFERRED_VERSION_gpe-filemanager ?= "0.30"
PREFERRED_VERSION_gpe-mini-browser ?= "0.21"
PREFERRED_VERSION_gpe-scap ?= "1.3"
PREFERRED_VERSION_gpesyncd ?= "2.0"
PREFERRED_VERSION_gpe-synctool ?= "0.2"
PREFERRED_VERSION_gpe-announce ?= "0.13"
PREFERRED_VERSION_gpe-timesheet ?= "0.32"
PREFERRED_VERSION_gpe-irc ?= "0.08"
PREFERRED_VERSION_starling ?= "0.2"
PREFERRED_VERSION_gpe-keylock ?= "0.12"
PREFERRED_VERSION_gpe-ownerinfo ?= "0.28"
PREFERRED_VERSION_gpe-question ?= "0.04"
PREFERRED_VERSION_gpe-soundserver ?= "0.4-1"

PREFERRED_VERSION_gpe-go ?= "0.05"
PREFERRED_VERSION_gpe-julia ?= "0.0.6"
PREFERRED_VERSION_gpe-lights ?= "0.13"
PREFERRED_VERSION_gpe-othello ?= "0.2-1"
PREFERRED_VERSION_gpe-plucker ?= "0.4"
PREFERRED_VERSION_gpe-tetris ?= "0.6-4"
PREFERRED_VERSION_gsoko ?= "0.4.2-gpe6"
PREFERRED_VERSION_xdemineur ?= "2.1.1"

PREFERRED_VERSION_vlc-gpe ?= "0.8.4"
PREFERRED_VERSION_rosetta ?= "0.0+cvs${SRCDATE}"
```

## conf/distro/include/preferred-openmoko-versions.inc
```bitbake
#
# Specify which versions of OpenMoko packages to build
#

#
# Bootloader and Kernel
#

SRCREV_pn-linux-openmoko = "2937"
```
