## conf/distro/include/kaeilos.inc
```bitbake
#@TYPE: Distribution
#@NAME: KaeilOS 
#@DESCRIPTION: Release independent distribution configuration for KaeilOS 
#@MAINTAINER: Marco Cavallini <m.cavallini@koansoftware.com>
# KaeilOS is a registered trade mark of KOAN - Bergamo - Italia
# Product website : http://www.KaeilOS.com 

# Preserve original DISTRO value
USERDISTRO := "${DISTRO}"
DISTRO = "kaeilos"
DISTRO_NAME = "KaeilOS"

BUILDNAME = "KaeilOS ${DISTRO_VERSION}"

TARGET_VENDOR = "-kaeilos"

# Add FEED_ARCH to overrides
OVERRIDES .= ":${FEED_ARCH}"

# Put links to sources in deploy/sources to make it easier for people to be GPL compliant
INHERIT += "src_distribute_local"
SRC_DIST_LOCAL ?= "symlink"

# Can be "glibc", "eglibc" or "uclibc"
KAEILOSLIBC ?= "glibc"
LIBC ?= "${KAEILOSLIBC}"
PSTAGE_EXTRAPATH = "${LIBC}"

CACHE = "${TMPDIR}/cache/${LIBC}/${MACHINE}"
DEPLOY_DIR = "${TMPDIR}/deploy/${LIBC}"
require conf/distro/include/angstrom-${LIBC}.inc

# ARM920T and up can use thumb mode to decrease binary size at the expense of speed
# (the complete story is a bit more nuanced due to cache starvation)
# KaeilOS turns on thumb for armv4t machine according to this RFC:
# http://lists.linuxtogo.org/pipermail/angstrom-distro-devel/2008-October/002714.html

# We can't do ARM_INSTRUCTION_SET_armv4t since that will un-overridable in recipes like gcc
ANGSTROM_ARM_INSTRUCTION_SET ?= "arm"
#ANGSTROM_ARM_INSTRUCTION_SET_armv4t = "thumb"
#ANGSTROM_ARM_INSTRUCTION_SET_armv5te = "thumb"


ARM_INSTRUCTION_SET = "${ANGSTROM_ARM_INSTRUCTION_SET}"
# "arm" "thumb"
#    The instruction set the compiler should use when generating application
#    code.  The kernel is always compiled with arm code at present.  arm code
#    is the original 32 bit ARM instruction set, thumb code is the 16 bit
#    encoded RISC sub-set.  Thumb code is smaller (maybe 70% of the ARM size)
#    but requires more instructions (140% for 70% smaller code) so may be
#    slower.

THUMB_INTERWORK = "yes"
# "yes" "no"
#    Whether to compile with code to allow interworking between the two
#    instruction sets.  This allows thumb code to be executed on a primarily
#    arm system and vice versa.  It is strongly recommended that DISTROs not
#    turn this off - the actual cost is very small.


#Use this variable in feeds and other parts that need a URI
ANGSTROM_URI ?= "http://www.kaeilos.com"

#Use this variable to select which recipe you want to use to get feed configs (/etc/ipkg/, /etc/apt/sources.list)
# usefull for derivative distros and local testing
# As this is runtime we can't and won't use virtual/feed-configs
ANGSTROM_FEED_CONFIGS ?= "angstrom-feed-configs"

#Set the default maintainer of kaeilos
MAINTAINER = "KaeilOS Mantainer <m.cavallini@koansoftware.com>"

#use debian style naming
INHERIT += "debian"

#activate config checker
INHERIT += "sanity" 

#activate the blacklister
INHERIT += "angstrom"

#make devshell available as task
INHERIT += "devshell" 

#use angstrom source mirrors to combat 404s
INHERIT += "angstrom-mirrors" 

#run QA tests on builds and packages and log them  
INHERIT += "insane"
# INHERIT += "packagehistory"
QA_LOG = "1"

#run QA tests on recipes
INHERIT += "recipe_sanity"

#save statistical info on images
INHERIT += "testlab"

ANGSTROM_PKG_FORMAT ?= "ipk"
require conf/distro/include/angstrom-package-${ANGSTROM_PKG_FORMAT}.inc


# We don't want to keep OABI compat
ARM_KEEP_OABI = "0"
# Do keep OABI compat for om-gta01 to keep the gllin binary working
ARM_KEEP_OABI_pn-linux-openmoko-2.6.24_om-gta01 = "1"
ARM_KEEP_OABI_pn-linux-openmoko-2.6.28_om-gta01 = "1"


#Generate locales on the buildsystem instead of on the target. Speeds up first boot, set to "1" to enable
PREFERRED_PROVIDER_qemu-native = "qemu-native"
ENABLE_BINARY_LOCALE_GENERATION ?= "1"

# We only want to build UTF8 locales
LOCALE_UTF8_ONLY = "1"

#qemu doesn't like this fp
ENABLE_BINARY_LOCALE_GENERATION_ep9312 = "0"

#qemu has taken a dislike to armeb as well
ENABLE_BINARY_LOCALE_GENERATION_armeb = "0"

#ARM EABI is softfloat by default, but let's make sure :)
#make it overridable for platforms with FPU, like ep93xx or i.mx31
TARGET_FPU_arm ?= "soft"
TARGET_FPU_armeb ?= "soft"
TARGET_FPU_ixp4xx ?= "soft"
TARGET_FPU_ppc405 ?= "soft"

TARGET_FPU_armv6 ?= "hard"
TARGET_FPU_armv6-novfp ?= "soft"
TARGET_FPU_armv7a ?= "hard"
TARGET_FPU_ppc603e ?= "hard"

# webkit-gtk and cairo have alignment issues with double instructions on armv5 so
# disable them here
TARGET_CC_ARCH_pn-webkit-gtk_armv5te = "-march=armv4t"
TARGET_CC_ARCH_pn-cairo_armv5te = "-march=armv4t"

#Set the right arch for the feeds
#Alphabetically sorted

FEED_ARCH ?= "${BASE_PACKAGE_ARCH}"

#blackfin machines
FEED_ARCH_bfin          = "blackfin"

#Tweak packaging for strongarm machines since they can't use EABI

PACKAGE_EXTRA_ARCHS_collie = "arm-oabi"
PACKAGE_EXTRA_ARCHS_h3600  = "arm-oabi"
PACKAGE_EXTRA_ARCHS_h3800  = "arm-oabi"
PACKAGE_EXTRA_ARCHS_simpad = "arm-oabi"
PACKAGE_EXTRA_ARCHS_htcwallaby = "arm-oabi"


#Name the generated images in a sane way
IMAGE_NAME = "${DISTRO_NAME}-${IMAGE_BASENAME}-${LIBC}-${ANGSTROM_PKG_FORMAT}-${DISTRO_VERSION}-${MACHINE}"
DEPLOY_DIR_IMAGE = "${DEPLOY_DIR}/images/${MACHINE}"

# KaeilOS *always* has some form of release config, so error out if someone thinks he knows better 
DISTRO_CHECK := "${@bb.data.getVar("DISTRO_VERSION",d,1) or bb.fatal('Remove this line or set a dummy DISTRO_VERSION if you really want to build an unversioned distro')}"


# Configuration for tinderbox, so people only need:
# INHERIT          += "tinderclient"
# in their local.conf 

#Name of the client
TINDER_MACHINE  = "${MACHINE}-${LIBC}-build-image"

# Which lof file to write to, which tree to report to
TINDER_LOG        = "${TMPDIR}/tinder.log"
TINDER_TREE       = "KaeilOS"

# HTTP posting    
#TINDER_HOST       ?= "ewi546.ewi.utwente.nl"
#TINDER_URL        ?= "/tinderbox"

# Which branch do we build
TINDER_BRANCH     = "org.openembedded.dev"
   
## Clobbing
## 0 for rebuilding everything from scratch
## 1 for incremental builds
TINDER_CLOBBER    = "1"

## Do a report at all
TINDER_REPORT     = "1"

# Configuration for seppuku autobuilder, people only need to put:
# INHERIT += "seppuku oestats-client"
# SEPPUKU_USER         = "your_bugzilla@user.id"
# SEPPUKU_PASS         = "your_bugzilla_password"
# OESTATS_BUILDER      = "your_name" 
# in their local.conf

# seppuku bbclass
SEPPUKU_LOGIN        = "http://bugs.openembedded.net/query.cgi?"
SEPPUKU_QUERY        = "http://bugs.openembedded.net/buglist.cgi?"
SEPPUKU_NEWREPORT    = "http://bugs.openembedded.net/post_bug.cgi?bug_file_loc=http%3A%2F%2F&version=Angstrom%20unstable&priority=P2&bug_severity=normal&op_sys=Linux&rep_platform=Other&"
SEPPUKU_ADDCOMMENT   = "http://bugs.openembedded.net/process_bug.cgi?bug_file_loc=http%3A%2F%2F&version=Angstrom&priority=P2&bug_severity=normal&op_sys=Linux&rep_platform=Other&"
SEPPUKU_ATTACHMENT   = "http://bugs.openembedded.net/attachment.cgi?"
SEPPUKU_AUTOBUILD    = "1"

SEPPUKU_PRODUCT      = "Openembedded"
SEPPUKU_COMPONENT    = "org.openembedded.dev"

OESTATS_SERVER      ?= "tinderbox.openembedded.org"



# We want images supporting the following features (for task-base)
DISTRO_FEATURES = "nfs smbfs wifi ppp alsa bluetooth ext2 vfat irda pcmcia usbgadget usbhost pci pam"

# Use-like features
DISTRO_FEATURES += "tk"
```

## conf/distro/include/moko-autorev.inc
```bitbake
SRCREV_pn-assassin ?= "${AUTOREV}"
SRCREV_pn-dfu-util ?= "${AUTOREV}"
SRCREV_pn-dfu-util-native ?= "${AUTOREV}"
SRCREV_pn-diversity-daemon ?= "${AUTOREV}"
SRCREV_pn-diversity-radar ?= "${AUTOREV}"
SRCREV_pn-etk-theme-ninja ?= "${AUTOREV}"
SRCREV_pn-exposure ?= "${AUTOREV}"
SRCREV_pn-illume-theme-asu ?= "${AUTOREV}"
SRCREV_pn-libgsmd ?= "${AUTOREV}"
SRCREV_pn-libjana ?= "${AUTOREV}"
SRCREV_pn-libmokogsmd2 ?= "${AUTOREV}"
SRCREV_pn-libmokojournal2 ?= "${AUTOREV}"
SRCREV_pn-libmokopanelui2 ?= "${AUTOREV}"
SRCREV_pn-libmokoui2 ?= "${AUTOREV}"
SRCREV_pn-linux-openmoko-devel ?= "${AUTOREV}"
SRCREV_pn-moko-gtk-engine ?= "${AUTOREV}"
SRCREV_pn-multitap-pad ?= "${AUTOREV}"
SRCREV_pn-moko-gtk-engine ?= "${AUTOREV}"
SRCREV_pn-neod ?= "${AUTOREV}"
SRCREV_pn-om-locations ?= "${AUTOREV}"
SRCREV_pn-openmoko-agpsui ?= "${AUTOREV}"
SRCREV_pn-openmoko-alsa-scenarios ?= "${AUTOREV}"
SRCREV_pn-openmoko-qa-scripts ?= "${AUTOREV}"
SRCREV_pn-openmoko-sample2 ?= "${AUTOREV}"
SRCREV_pn-openmoko-toolchain-scripts ?= "${AUTOREV}"
SRCREV_pn-openmoko-worldclock2 ?= "${AUTOREV}"
SRCREV_pn-openocd ?= "${AUTOREV}"
SRCREV_pn-openocd-native ?= "${AUTOREV}"
SRCREV_pn-opkg ?= "${AUTOREV}"
SRCREV_pn-opkg-native ?= "${AUTOREV}"
SRCREV_pn-opkg-sdk ?= "${AUTOREV}"
SRCREV_pn-packagekit ?= "${AUTOREV}"
SRCREV_pn-paroli ?= "${AUTOREV}"
SRCREV_pn-paroli-elementary ?= "${AUTOREV}"
SRCREV_pn-pyefl-sudoku ?= "${AUTOREV}"
SRCREV_pn-qi ?= "${AUTOREV}"
SRCREV_pn-tichy ?= "${AUTOREV}"
SRCREV_pn-u-boot-openmoko ?= "${AUTOREV}"
SRCREV_pn-u-boot-openmoko-devel ?= "${AUTOREV}"
SRCREV_pn-usbpath ?= "${AUTOREV}"
SRCREV_pn-usbpath-native ?= "${AUTOREV}"
SRCREV_pn-wmiconfig ?= "${AUTOREV}"
```

## conf/distro/include/openmoko-srcdate-now.inc
```bitbake
# Warning! Builds unupgradable packages!

# OpenMoko
SRCDATE_libgsmd ?= "now"
SRCDATE_libmokogsmd2 ?= "now"
SRCDATE_libmokoui2 ?= "now"
SRCDATE_libmokojournal2 ?= "now"
SRCDATE_libmokopanelui2 ?= "now"
SRCDATE_openmoko-today2 ?= "now"
SRCDATE_openmoko-dialer2 ?= "now"
SRCDATE_openmoko-contacts2 ?= "now"

SRCDATE_openmoko-panel-battery ?= "now"
SRCDATE_openmoko-panel-clock ?= "now"
SRCDATE_openmoko-panel-gsm ?= "now"
SRCDATE_openmoko-panel-usb ?= "now"
SRCDATE_openmoko-panel-bt ?= "now"
SRCDATE_openmoko-panel-gps ?= "now"
```

## conf/distro/include/openmoko.inc
```bitbake
#
# Header
#
DISTRO_NAME = "OpenMoko"

#
# Naming schemes
#
INHERIT += "debian multimachine"

#
# Packaging and output format
#
INHERIT += "package_ipk"
IMAGE_FSTYPES = "tar.gz ext2.gz jffs2"
IMAGE_FSTYPES_x86 = "tar.gz"
IMAGE_ROOTFS_SIZE_ext2 = "131072"

#
# Binutils & Compiler
#
PREFERRED_PROVIDERS += " virtual/${TARGET_PREFIX}gcc-initial:gcc-cross-initial"
PREFERRED_PROVIDERS += " virtual/${TARGET_PREFIX}gcc:gcc-cross"
PREFERRED_PROVIDERS += " virtual/${TARGET_PREFIX}g++:gcc-cross"

# EABI stuff
PREFERRED_PROVIDER_virtual/${TARGET_PREFIX}-libc-for-gcc = "glibc-intermediate"
PREFERRED_PROVIDER_virtual/arm-angstrom-linux-gnueabi-libc-for-gcc = "glibc-intermediate"
PREFERRED_PROVIDER_virtual/arm-linux-libc-for-gcc = "glibc-intermediate"

#
# Target OS & FPU system
# 
TARGET_OS = "linux"
TARGET_FPU_arm = "soft"
TARGET_FPU_armeb = "soft"
PREFERRED_PROVIDER_virtual/libiconv = "glibc"
PREFERRED_PROVIDER_virtual/libintl = "glibc"
PREFERRED_VERSION_linux-libc-headers_x86 = "2.6.15.99"
PREFERRED_VERSION_linux-libc_headers = "2.6.18"
#
# Features
#
DISTRO_FEATURES = "alsa bluetooth ext2 ipsec nfs ppp smbfs usbgadget usbhost"

#
# Bootstrap & Init
#
require conf/distro/include/sane-srcdates.inc

#
# Framebuffer & X
#
PREFERRED_PROVIDER_virtual/libx11 ?= "libx11"
PREFERRED_PROVIDER_virtual/ecore ?= "ecore-x11"
PREFERRED_PROVIDER_virtual/evas ?= "evas-x11"
PREFERRED_PROVIDER_virtual/esmart ?= "esmart-x11"
PREFERRED_PROVIDER_virtual/libsdl = "libsdl-x11"
PREFERRED_PROVIDER_virtual/xserver ?= "xserver-kdrive"
PREFERRED_PROVIDER_tslib ?= "tslib"
PREFERRED_PROVIDER_xserver ?= "xserver-kdrive"
require conf/distro/include/preferred-xorg-versions-X11R7.1.inc

#
# Gnome
#
PREFERRED_PROVIDER_dbus-glib = "dbus-glib"
PREFERRED_PROVIDER_gconf = "gconf-dbus"
#new
#PREFERRED_PROVIDER_gnome-vfs = "gnome-vfs"
#old
PREFERRED_PROVIDER_gnome-vfs = "gnome-vfs"
PREFERRED_PROVIDER_gnome-vfs-plugin-file = "gnome-vfs"

PREFERRED_PROVIDER_virtual/xserver = "xserver-kdrive"
PREFERRED_PROVIDER_bluez-utils = "bluez-utils-dbus"

PREFERRED_VERSION_dbus-native = "1.0.2"
PREFERRED_VERSION_dbus = "1.0.2"
PREFERRED_VERSION_dbus-glib-native = "0.71"
PREFERRED_VERSION_dbus-glib = "0.71"
PREFERRED_VERSION_atk = "1.9.0"
PREFERRED_VERSION_pango = "1.8.2"
PREFERRED_VERSION_glib-2.0 = "2.12.3"
PREFERRED_VERSION_gtk+ = "2.6.10"
PREFERRED_VERSION_gtk-engines = "2.6.5"
#PREFERRED_VERSION_gnome-vfs = "2.16.3"

PREFERRED_VERSION_fontconfig = "2.4.1"

# we don't ship gtk-directfb by default
PREFERRED_PROVIDER_gtk+                   ?= "gtk+"
PREFERRED_PROVIDER_gdk-pixbuf-loader-ani  ?= "gtk+"
PREFERRED_PROVIDER_gdk-pixbuf-loader-bmpg ?= "gtk+"
PREFERRED_PROVIDER_gdk-pixbuf-loader-gif  ?= "gtk+"
PREFERRED_PROVIDER_gdk-pixbuf-loader-ico  ?= "gtk+"
PREFERRED_PROVIDER_gdk-pixbuf-loader-jpeg ?= "gtk+"
PREFERRED_PROVIDER_gdk-pixbuf-loader-pcx  ?= "gtk+"
PREFERRED_PROVIDER_gdk-pixbuf-loader-png  ?= "gtk+"
PREFERRED_PROVIDER_gdk-pixbuf-loader-pnm  ?= "gtk+"
PREFERRED_PROVIDER_gdk-pixbuf-loader-ras  ?= "gtk+"
PREFERRED_PROVIDER_gdk-pixbuf-loader-tga  ?= "gtk+"
PREFERRED_PROVIDER_gdk-pixbuf-loader-wbmp ?= "gtk+"
PREFERRED_PROVIDER_gdk-pixbuf-loader-xbm  ?= "gtk+"
PREFERRED_PROVIDER_gdk-pixbuf-loader-xpm  ?= "gtk+"
#
# GPE
#
PREFERRED_PROVIDER_libgpewidget = "libgpewidget"

#
# O-Hand
#
PREFERRED_VERSION_contacts = "0.1"
PREFERRED_VERSION_dates = "0.1"
# PREFERRED_VERSION_web = "???"

#
# Development
#
PREFERRED_PROVIDER_qemu-native = "qemu-native"
PREFERRED_VERSION_qemu-native = "0.9.0+cvs${SRCDATE}"

#
# Opie
#
QTE_VERSION = "2.3.10"
PALMTOP_USE_MULTITHREADED_QTE = "yes"
require conf/distro/include/preferred-opie-versions.inc

#
# Enlightenment
#
require conf/distro/include/preferred-e-versions.inc

#
# OpenMoko
#

#We comment this out since external developers don't needs to use SRCDATE="now" as that generated unneed traffic
#require conf/distro/include/preferred-openmoko-versions.inc
```

## conf/distro/include/openslug-packages.inc
```bitbake
SLUGOS_EXTRA_BBFILES = "${OPENSLUG_EXTRA_BBFILES}"
require conf/distro/include/slugos-packages.conf
```

## conf/distro/include/opie-users-are-too-stupid-too-put-this-in-local.conf.inc
```bitbake
# Opie
#use 1337 mt version of opie to have a webbrowser
PALMTOP_USE_MULTITHREADED_QT = "yes"
QTE_VERSION = "2.3.10"
OPIE_VERSION = "1.2.2"
require conf/distro/include/preferred-opie-versions.inc
-
```
