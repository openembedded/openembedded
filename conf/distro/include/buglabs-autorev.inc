## conf/distro/include/buglabs-autorev.inc
```bitbake
SRCREV_pn-com.buglabs.bug.base = "${AUTOREV}"
SRCREV_pn-com.buglabs.bug.bmi = "${AUTOREV}"
SRCREV_pn-com.buglabs.bug.event = "${AUTOREV}"
SRCREV_pn-com.buglabs.bug.jni.accelerometer = "${AUTOREV}"
SRCREV_pn-com.buglabs.bug.jni.camera = "${AUTOREV}"
SRCREV_pn-com.buglabs.bug.jni.common = "${AUTOREV}"
SRCREV_pn-com.buglabs.bug.jni.gps = "${AUTOREV}"
SRCREV_pn-com.buglabs.bug.jni.input = "${AUTOREV}"
SRCREV_pn-com.buglabs.bug.jni.lcd = "${AUTOREV}"
SRCREV_pn-com.buglabs.bug.jni.libmatthew = "${AUTOREV}"
SRCREV_pn-com.buglabs.bug.jni.pb = "${AUTOREV}"
SRCREV_pn-com.buglabs.bug.jni.rxtx = "${AUTOREV}"
SRCREV_pn-com.buglabs.bug.jni.vonhippel = "${AUTOREV}"
SRCREV_pn-com.buglabs.bug.module = "${AUTOREV}"
SRCREV_pn-com.buglabs.bug.module.camera = "${AUTOREV}"
SRCREV_pn-com.buglabs.bug.module.gps = "${AUTOREV}"
SRCREV_pn-com.buglabs.bug.module.lcd = "${AUTOREV}"
SRCREV_pn-com.buglabs.bug.module.pb = "${AUTOREV}"
SRCREV_pn-com.buglabs.bug.module.video = "${AUTOREV}"
SRCREV_pn-com.buglabs.bug.module.vonhippel = "${AUTOREV}"
SRCREV_pn-com.buglabs.bug.program = "${AUTOREV}"
SRCREV_pn-com.buglabs.bug.service = "${AUTOREV}"
SRCREV_pn-com.buglabs.common = "${AUTOREV}"
SRCREV_pn-com.buglabs.nmea = "${AUTOREV}"
SRCREV_pn-com.buglabs.osgi = "${AUTOREV}"
SRCREV_pn-com.buglabs.osgi.cm = "${AUTOREV}"
SRCREV_pn-com.buglabs.osgi.http = "${AUTOREV}"
SRCREV_pn-com.buglabs.osgi.sewing = "${AUTOREV}"
SRCREV_pn-com.buglabs.osgi.shell = "${AUTOREV}"
SRCREV_pn-com.sun.javax.servlet = "${AUTOREV}"
SRCREV_pn-org.freedesktop.dbus = "${AUTOREV}"
```

## conf/distro/include/debianslug-packages.inc
```bitbake
SLUGOS_EXTRA_BBFILES = "${DEBIANSLUG_EXTRA_BBFILES}"
require conf/distro/include/slugos-packages.conf
```

## conf/distro/include/efl-from-svn.inc
```bitbake
PREFERRED_VERSION_ecore = "1.0.999%"
PREFERRED_VERSION_edbus = "1.0.999%"
PREFERRED_VERSION_edje = "1.0.999%"
PREFERRED_VERSION_eeze = "1.0.999%"
PREFERRED_VERSION_efreet = "1.0.999%"
PREFERRED_VERSION_eina = "1.0.999%"
PREFERRED_VERSION_embryo = "1.0.999%"
PREFERRED_VERSION_evas = "1.0.999%"
```

## conf/distro/include/eglibc-external.inc
```bitbake
# Nothing different than glibc here.
require conf/distro/include/glibc-external.inc
```

## conf/distro/include/eglibc.inc
```bitbake
# Add glibc overrides to the overrides for eglibc.
OVERRIDES =. "libc-glibc:"

# The things eglibc can provide.  We default to wanting eglibc to provide them.
PREFERRED_PROVIDER_virtual/libiconv ?= "eglibc"
PREFERRED_PROVIDER_virtual/libintl ?= "eglibc"
PREFERRED_PROVIDER_virtual/libc = "eglibc"
PREFERRED_PROVIDER_virtual/${TARGET_PREFIX}libc-initial = "eglibc-initial"
PREFERRED_PROVIDER_virtual/${TARGET_PREFIX}libc-for-gcc = "eglibc"

# eglibc is configured for OLDEST_KERNEL kernel version, so we set minimal
# sane versions there

OLDEST_KERNEL ?= "2.4.0"

# ARM OABI is fine with 2.4.0, EABI is not, so we override on "-gnueabi"
# TARGET_OS here, not on architecture which is 'arm' in both cases
OLDEST_KERNEL_linux-gnueabi ?= "2.6.16"
OLDEST_KERNEL_sparc64 ?= "2.4.21"
OLDEST_KERNEL_ppc64 ?= "2.4.21"
DISTRO_FEATURES_EGLIBC ?= "ipv6 backtrace big-macros bsd cxx-tests catgets \
                           charsets crypt crypt-ufc db-aliases envz fcvt fmtmsg \
                           fstab ftraverse getlogin idn inet inet-anl libm \
                           libm-big locales locale-code memusage nis nsswitch \
                           rcmd rtld-debug spawn streams sunrpc utmp utmpx \
                           wordexp posix-clang-wchar posix-regexp \
                           posix-regexp-glibc posix-wchar-io"
```

## conf/distro/include/foonas-uclibc.inc
```bitbake
# uclibc:
#fix some iconv issues, needs to be adjusted when doing uclibc builds
PREFERRED_PROVIDER_virtual/libc = "uclibc"
PREFERRED_PROVIDER_virtual/libiconv ?= "libiconv"
PREFERRED_PROVIDER_virtual/libintl ?= "gettext"

USE_NLS ?= "no"

TARGET_OS = "linux${@['-uclibc','-uclibcgnueabi'][bb.data.getVar('TARGET_ARCH',d,1) in ['arm', 'armeb']]}"

#mess with compiler flags to use -Os instead of -O2
#Please see http://free-electrons.com/doc/embedded_linux_optimizations/img47.html for some more info
FULL_OPTIMIZATION = "-fexpensive-optimizations -fomit-frame-pointer -frename-registers -Os"
BUILD_OPTIMIZATION = "-Os"
CXXFLAGS += "-fvisibility-inlines-hidden"

SRCDATE_uclibc ?= "20070320"
PREFERRED_VERSION_uclibc ?= "0.9.28+svn${SRCDATE_uclibc}"
PREFERRED_VERSION_uclibc-initial ?= "0.9.28+svn${SRCDATE_uclibc}"

PREFERRED_VERSION_linux-libc-headers    = "2.6.18"
#PREFERRED_VERSION_linux-libc-headers_powerpc = "2.6.15.99"
```

## conf/distro/include/foonas.inc
```bitbake
#
# binutils and compilers
#
# Can be "glibc" and "uclibc"
FOONAS_MODE ?= "glibc"

#DEPLOY_DIR = "${TMPDIR}/deploy/${FOONAS_MODE}"
require conf/distro/include/foonas-${FOONAS_MODE}.inc

INHERIT += "package_ipk debian sanity devshell"

#Generate locales on the buildsystem instead of on the target. Speeds up first boot, set to "1" to enable
PREFERRED_PROVIDER_qemu-native = "qemu-native"
ENABLE_BINARY_LOCALE_GENERATION ?= "0"

PREFERRED_PROVIDER_virtual/${TARGET_PREFIX}libc-for-gcc = "glibc-intermediate"
PREFERRED_PROVIDER_virtual/arm-foonas-linux-gnueabi-libc-for-gcc = "glibc-intermediate"
PREFERRED_PROVIDER_virtual/arm-linux-libc-for-gcc = "glibc-intermediate"
PREFERRED_PROVIDER_virtual/powerpc-foonas-linux-libc-for-gcc = "glibc-intermediate"

# not used yet
#PREFERRED_PROVIDER_virtual/armeb-linux-libc-for-gcc = "glibc-intermediate"
#PREFERRED_PROVIDER_virtual/armeb-foonas-linux-gnueabi-libc-for-gcc = "glibc-intermediate"
#PREFERRED_PROVIDER_virtual/mipsel-foonas-linux-libc-for-gcc = "glibc-intermediate"

PREFERRED_PROVIDERS += "virtual/${TARGET_PREFIX}gcc-initial:gcc-cross-initial"
PREFERRED_PROVIDERS += "virtual/${TARGET_PREFIX}gcc:gcc-cross"
PREFERRED_PROVIDERS += "virtual/${TARGET_PREFIX}g++:gcc-cross"
#conflict between this and the last below.
#PREFERRED_PROVIDERS += "virtual/${TARGET_PREFIX}libc-for-gcc:glibc"
# Select 2.6 versions of the depmod support
PREFERRED_PROVIDERS += "virtual/${TARGET_PREFIX}depmod:module-init-tools-cross"
PREFERRED_PROVIDERS += "virtual/${TARGET_PREFIX}libc-for-gcc:glibc-intermediate"

PREFERRED_PROVIDER_virtual/libx11 = "libx11"

PREFERRED_PROVIDER_virtual/db = "db"
PREFERRED_PROVIDER_virtual/db-native = "db-native"

PREFERRED_VERSION_binutils = "2.17.50.0.12"
PREFERRED_VERSION_binutils-cross = "2.17.50.0.12"

PREFERRED_VERSION_gcc = "4.1.1"
PREFERRED_VERSION_gcc-cross = "4.1.1"
PREFERRED_VERSION_gcc-cross-sdk ?= "4.1.1"
PREFERRED_VERSION_gcc-cross-initial = "4.1.1"

PREFERRED_VERSION_glibc = "2.5"
PREFERRED_VERSION_glibc-intermediate = "2.5"
PREFERRED_VERSION_glibc-initial = "2.5"

PREFERRED_VERSION_openlink = "svn"
```

## conf/distro/include/fso-autorev.inc
```bitbake
# FSO
FSO_CORNUCOPIA_SRCREV = "${AUTOREV}"
FSO_PYTHONHELPERS_SRCREV = "${AUTOREV}"

SRCREV_pn-android-image-utils-native = "${AUTOREV}"
SRCREV_pn-dbus-hlid = "${AUTOREV}"
SRCREV_pn-frameworkd = "${AUTOREV}"
SRCREV_pn-frameworkd-devel = "${AUTOREV}"
SRCREV_pn-fso-gsm0710muxd = "${AUTOREV}"
SRCREV_pn-fso-gpsd = "${AUTOREV}"
SRCREV_pn-fso-monitord = "${AUTOREV}"
SRCREV_pn-fso-sounds = "${AUTOREV}"
SRCREV_pn-fso-specs = "${AUTOREV}"
SRCREV_pn-gsmd2 = "${AUTOREV}"
SRCREV_pn-illume-theme-freesmartphone = "${AUTOREV}"
SRCREV_pn-libascenario = "${AUTOREV}"
SRCREV_pn-libeflvala = "${AUTOREV}"
SRCREV_pn-libframeworkd-glib = "${AUTOREV}"
SRCREV_pn-libfso-glib = "${AUTOREV}"
SRCREV_pn-libgee-native = "${AUTOREV}"
SRCREV_pn-libgee = "${AUTOREV}"
SRCREV_pn-libgsm0710 = "${AUTOREV}"
SRCREV_pn-libmsmcomm = "${AUTOREV}"
SRCREV_pn-libpersistence = "${AUTOREV}"
SRCREV_pn-misc-vapi = "${AUTOREV}"
SRCREV_pn-msmcommd = "${AUTOREV}"
SRCREV_pn-vala-dbus-binding-tool-native = "${AUTOREV}"
SRCREV_pn-vala-dbus-binding-tool = "${AUTOREV}"
SRCREV_pn-vala = "${AUTOREV}"
SRCREV_pn-zhone = "${AUTOREV}"
SRCREV_pn-zhone2 = "${AUTOREV}"
```

## conf/distro/include/glibc-external.inc
```bitbake
# Add glibc to the overrides.
OVERRIDES .= ":libc-glibc"

# The things glibc can provide.  We default to wanting glibc to provide them.
PREFERRED_PROVIDER_virtual/libiconv ?= "external-toolchain-${TOOLCHAIN_BRAND}"
PREFERRED_PROVIDER_virtual/libintl ?= "external-toolchain-${TOOLCHAIN_BRAND}"
PREFERRED_PROVIDER_virtual/libc = "external-toolchain-${TOOLCHAIN_BRAND}"
PREFERRED_PROVIDER_virtual/${TARGET_PREFIX}libc-initial = "external-toolchain-${TOOLCHAIN_BRAND}"
PREFERRED_PROVIDER_virtual/${TARGET_PREFIX}libc-for-gcc = "external-toolchain-${TOOLCHAIN_BRAND}"
PREFERRED_PROVIDER_linux-libc-headers ?= "external-toolchain-${TOOLCHAIN_BRAND}"

# glibc is configured for OLDEST_KERNEL kernel version, so we set minimal
# sane versions there

OLDEST_KERNEL ?= "2.4.0"

# ARM OABI is fine with 2.4.0, EABI is not, so we override on "-gnueabi"
# TARGET_OS here, not on architecture which is 'arm' in both cases
OLDEST_KERNEL_linux-gnueabi ?= "2.6.16"
OLDEST_KERNEL_sparc64 ?= "2.4.21"
OLDEST_KERNEL_ppc64 ?= "2.4.21"
```

## conf/distro/include/glibc.inc
```bitbake
# Add glibc to the overrides.
OVERRIDES .= ":libc-glibc"

# The things glibc can provide.  We default to wanting glibc to provide them.
PREFERRED_PROVIDER_virtual/libiconv ?= "glibc"
PREFERRED_PROVIDER_virtual/libintl ?= "glibc"
PREFERRED_PROVIDER_virtual/libc = "glibc"
PREFERRED_PROVIDER_virtual/${TARGET_PREFIX}libc-initial = "glibc-initial"
PREFERRED_PROVIDER_virtual/${TARGET_PREFIX}libc-for-gcc = "glibc"

# glibc is configured for OLDEST_KERNEL kernel version, so we set minimal
# sane versions there

OLDEST_KERNEL ?= "2.4.0"

# ARM OABI is fine with 2.4.0, EABI is not, so we override on "-gnueabi"
# TARGET_OS here, not on architecture which is 'arm' in both cases
OLDEST_KERNEL_linux-gnueabi ?= "2.6.16"
OLDEST_KERNEL_sparc64 ?= "2.4.21"
OLDEST_KERNEL_ppc64 ?= "2.4.21"
```

## conf/distro/include/insane-srcrevs.inc
```bitbake
SRCREV_pn-aircrack-ng ?= "${AUTOREV}"
SRCREV_pn-dfu-util ?= "${AUTOREV}"
SRCREV_pn-dfu-util-native ?= "${AUTOREV}"
SRCREV_pn-eds-dbus ?= "${AUTOREV}"
SRCREV_pn-eglibc ?= "${AUTOREV}"
SRCREV_pn-eglibc-initial ?= "${AUTOREV}"
SRCREV_pn-ezxd ?= "${AUTOREV}"
SRCREV_pn-fbgrab-viewer-native ?= "${AUTOREV}"
SRCREV_pn-fstests ?= "${AUTOREV}"
SRCREV_pn-gnuradio ?= "${AUTOREV}"
SRCREV_pn-gtkhtml2 ?= "${AUTOREV}"
SRCREV_pn-hildon-1 ?= "${AUTOREV}"
SRCREV_pn-kismet ?= "${AUTOREV}"
SRCREV_pn-kismet-newcore ?= "${AUTOREV}"
SRCREV_pn-libgsmd ?= "${AUTOREV}"
SRCREV_pn-libowl ?= "${AUTOREV}"
SRCREV_pn-libxosd ?= "${AUTOREV}"
SRCREV_pn-linux-openmoko ?= "${AUTOREV}"
SRCREV_pn-llvm-gcc4 ?= "${AUTOREV}"
SRCREV_pn-llvm-gcc4-cross ?= "${AUTOREV}"
SRCREV_pn-maemo-mapper ?= "${AUTOREV}"
SRCREV_pn-matchbox-desktop-2 ?= "${AUTOREV}"
SRCREV_pn-matchbox-keyboard ?= "${AUTOREV}"
SRCREV_pn-matchbox-keyboard-inputmethod ?= "${AUTOREV}"
SRCREV_pn-matchbox-panel-2 ?= "${AUTOREV}"
SRCREV_pn-oh-puzzles ?= "${AUTOREV}"
SRCREV_pn-openocd ?= "${AUTOREV}"
SRCREV_pn-openocd-native ?= "${AUTOREV}"
SRCREV_pn-opkg ?= "${AUTOREV}"
SRCREV_pn-opkg-native ?= "${AUTOREV}"
SRCREV_pn-psplash ?= "${AUTOREV}"
SRCREV_pn-settings-daemon ?= "${AUTOREV}"
SRCREV_pn-sjf2410-linux-native ?= "${AUTOREV}"
SRCREV_pn-sphyrna-python ?= "${AUTOREV}"
SRCREV_pn-webkit-gtk ?= "${AUTOREV}"
SRCREV_pn-xoo ?= "${AUTOREV}"
SRCREV_pn-mplayer ?= "${AUTOREV}"
SRCREV_pn-usbpath ?= "${AUTOREV}"
SRCREV_pn-usbpath-native ?= "${AUTOREV}"
SRCREV_pn-libfakekey ?= "${AUTOREV}"

SRCREV ?= "${AUTOREV}"
```

## conf/distro/include/kaeilos-2010.inc
```bitbake
#@TYPE: Distribution
#@NAME: kaeilos-2010
#@DESCRIPTION: Release independent distribution configuration for KaeilOS 
#@MAINTAINER: Marco Cavallini <m.cavallini@koansoftware.com>
#@VERSION: 06-10-2010
#
# KaeilOS is a registered trade mark of KOAN - Bergamo - Italia
# Product website : http://www.KaeilOS.com 

# Preserve original DISTRO value
USERDISTRO := "${DISTRO}"
DISTRO = "kaeilos"
DISTRO_NAME = "KaeilOS"
BUILDNAME = "KaeilOS ${DISTRO_VERSION}"
TARGET_VENDOR = "-kaeilos"

# Add FEED_ARCH to overrides
OVERRIDES .= ":${FEED_ARCH}"

# Put links to sources in deploy/sources to make it easier for people to be GPL compliant
INHERIT += "src_distribute_local"
SRC_DIST_LOCAL ?= "symlink"

# Can be "glibc", "eglibc" or "uclibc"
KAEILOSLIBC ?= "eglibc"
LIBC ?= "${KAEILOSLIBC}"
PSTAGE_EXTRAPATH = "${LIBC}"

CACHE = "${TMPDIR}/cache/${LIBC}/${MACHINE}"
DEPLOY_DIR = "${TMPDIR}/deploy/${LIBC}"
require conf/distro/include/angstrom-${LIBC}.inc

ARM_INSTRUCTION_SET = "arm"
THUMB_INTERWORK = "yes"

#Use this variable in feeds and other parts that need a URI
KAEILOS_URI ?= "http://www.kaeilos.com"

#Use this variable to select which recipe you want to use to get feed configs (/etc/ipkg/, /etc/apt/sources.list)
# useful for derivative distros and local testing
# As this is runtime we can't and won't use virtual/feed-configs
DISTRO_FEED_CONFIGS = ""

#Set the default maintainer of kaeilos
MAINTAINER = "KaeilOS Mantainer <m.cavallini@koansoftware.com>"

#use debian style naming
INHERIT += "debian"

#activate config checker
INHERIT += "sanity" 

#make devshell available as task
INHERIT += "devshell" 

#run QA tests on builds and packages and log them  
INHERIT += "insane"
QA_LOG = "1"

#run QA tests on recipes
INHERIT += "recipe_sanity"

#save statistical info on images
INHERIT += "testlab"

INHERIT += "package_ipk"
PREFERRED_PROVIDER_virtual/update-alternatives-native ?= "opkg-native"
PREFERRED_PROVIDER_virtual/update-alternatives ?= ${PREFERRED_PROVIDER_opkg}

# We don't want to keep OABI compat
ARM_KEEP_OABI = "0"
# Do keep OABI compat for om-gta01 to keep the gllin binary working
ARM_KEEP_OABI_pn-linux-openmoko-2.6.24_om-gta01 = "1"
ARM_KEEP_OABI_pn-linux-openmoko-2.6.28_om-gta01 = "1"


#Generate locales on the buildsystem instead of on the target. Speeds up first boot, set to "1" to enable
PREFERRED_PROVIDER_qemu-native = "qemu-native"
ENABLE_BINARY_LOCALE_GENERATION ?= "1"

# We only want to build UTF8 locales
LOCALE_UTF8_ONLY = "1"

#qemu doesn't like this fp
ENABLE_BINARY_LOCALE_GENERATION_ep9312 = "0"

#qemu has taken a dislike to armeb as well
ENABLE_BINARY_LOCALE_GENERATION_armeb = "0"

#ARM EABI is softfloat by default, but let's make sure :)
#make it overridable for platforms with FPU, like ep93xx or i.mx31
TARGET_FPU_arm ?= "soft"
TARGET_FPU_armeb ?= "soft"
TARGET_FPU_ixp4xx ?= "soft"

TARGET_FPU_armv6 ?= "hard"
TARGET_FPU_armv6-novfp ?= "soft"
TARGET_FPU_armv7a ?= "hard"

# webkit-gtk and cairo have alignment issues with double instructions on armv5 so
# disable them here
TARGET_CC_ARCH_pn-webkit-gtk_armv5te = "-march=armv4t"
TARGET_CC_ARCH_pn-cairo_armv5te = "-march=armv4t"

#Set the right arch for the feeds
#Alphabetically sorted
FEED_ARCH ?= "${BASE_PACKAGE_ARCH}"

#Tweak packaging for strongarm machines since they can't use EABI
PACKAGE_EXTRA_ARCHS_collie = "arm-oabi"
PACKAGE_EXTRA_ARCHS_h3600  = "arm-oabi"
PACKAGE_EXTRA_ARCHS_h3800  = "arm-oabi"
PACKAGE_EXTRA_ARCHS_simpad = "arm-oabi"
PACKAGE_EXTRA_ARCHS_htcwallaby = "arm-oabi"

#Name the generated images in a sane way
IMAGE_NAME = "${DISTRO_NAME}-${IMAGE_BASENAME}-${LIBC}-${PREFERRED_PKG_FORMAT}-${DISTRO_VERSION}-${MACHINE}"
DEPLOY_DIR_IMAGE = "${DEPLOY_DIR}/images/${MACHINE}"

# KaeilOS *always* has some form of release config, so error out if someone thinks he knows better 
DISTRO_CHECK := "${@bb.data.getVar("DISTRO_VERSION",d,1) or bb.fatal('Remove this line or set a dummy DISTRO_VERSION if you really want to build an unversioned distro')}"

OESTATS_SERVER      ?= "tinderbox.openembedded.org"

# We want images supporting the following features (for task-base)
DISTRO_FEATURES = "nfs wifi alsa bluetooth ext2 vfat pcmcia usbgadget usbhost pci pam"

# Following features are for ARM and E500 based machines
DISTRO_FEATURES += "eabi"

# Use-like features
DISTRO_FEATURES += "tk"
```
