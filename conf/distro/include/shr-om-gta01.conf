## conf/distro/maemo5-compat.conf
```bitbake
#@--------------------------------------------------------------------
#@TYPE: Distribution
#@NAME: Maemo5-compatible
#@DESCRIPTION: Distribution which allows building packages compatible to Maemo5
#@--------------------------------------------------------------------

# Note: This is not a complete distribution. Just some definitions to make
# it possible to build packages that are compatible to Nokia's Maemo5 distribution.
# You should *not* replace core libraries of the operating system (glibc,
# glib, gtk+, ..) with those you build in OE.
#
# Furthermore it may be possible that OpenEmbedded lacks specific versions
# of some packages. If you encounter such a problem please provide a recipe
# or file a bug!

DISTRO_NAME = "maemo5-compat"
DISTRO_VERSION = "test-${DATE}"
DISTRO_TYPE = "debug"
#DISTRO_TYPE = "release"

# Needed for e.g. libffi builds on armv6
OVERRIDES .= ":${FEED_ARCH}"

# Set the toolchain type (internal, external) and brand (generic, csl etc.)
TOOLCHAIN_TYPE ?= "internal"
TOOLCHAIN_BRAND ?= ""

LIBC = "glibc"
require conf/distro/include/angstrom-glibc.inc

INHERIT += "package_deb debian"
TARGET_OS  = "linux-gnueabi"

TARGET_FPU_nokia770 = "soft"
TARGET_FPU_nokia800 = "hard"
TARGET_FPU_nokia900 = "hard"

DPKG_ARCH_nokia770 = "armel"
DPKG_ARCH_nokia800 = "armel"
DPKG_ARCH_nokia900 = "armel"

FEED_ARCH_nokia770	= "armv5te"
FEED_ARCH_nokia800		= "armv6"
FEED_ARCH_nokia900		= "armv7"

#Make sure we use 2.6 on machines with a 2.4/2.6 selector
KERNEL = "kernel26"
MACHINE_KERNEL_VERSION = "2.6"

PREFERRED_PROVIDERS += " virtual/${TARGET_PREFIX}gcc-initial:gcc-cross-initial"
PREFERRED_PROVIDERS += " virtual/${TARGET_PREFIX}gcc-intermediate:gcc-cross-intermediate"
PREFERRED_PROVIDERS += " virtual/${TARGET_PREFIX}gcc:gcc-cross"
PREFERRED_PROVIDERS += " virtual/${TARGET_PREFIX}g++:gcc-cross"

PREFERRED_PROVIDER_virtual/arm-linux-gnueabi-binutils = "binutils-cross"
PREFERRED_PROVIDER_linux-libc-header = "linux-libc-headers"
PREFERRED_PROVIDER_virtual/libx11 = "libx11"
PREFERRED_PROVIDER_gconf ?= "gconf-dbus"
PREFERRED_PROVIDER_util-linux = "util-linux"

PREFERRED_VERSION_autoconf-native = "2.63"
PREFERRED_VERSION_automake-native = "1.11.1"

PREFERRED_VERSION_binutils 	    = "2.18.50.0.7"
PREFERRED_VERSION_binutils-cross    = "2.18.50.0.7"

GCCVERSION = "4.2.1+csl-arm-2007q3-53"
PREFERRED_VERSION_gcc = "${GCCVERSION}"
PREFERRED_VERSION_gcc-cross = "${GCCVERSION}"
PREFERRED_VERSION_gcc-cross-initial = "${GCCVERSION}"
PREFERRED_VERSION_gcc-cross-intermediate = "${GCCVERSION}"

# Use recent enough version of the headers to let HAL build successfully.
PREFERRED_VERSION_linux-libc-headers = "2.6.25"

PREFERRED_VERSION_glibc = "2.5"
PREFERRED_VERSION_glibc-initial = "2.5"

PREFERRED_VERSION_libtool-native = "2.2.6b"
PREFERRED_VERSION_libtool-cross = "2.2.6b"
PREFERRED_VERSION_libtool = "2.2.6b"

require conf/distro/include/sane-srcrevs.inc

PREFERRED_VERSION_fontconfig       = "2.6.0"
PREFERRED_VERSION_freetype         = "2.3.6"
PREFERRED_VERSION_freetype-native  = "2.3.6"
PREFERRED_VERSION_cairo            = "1.8.0"
PREFERRED_VERSION_glib-2.0         = "2.20.3"
PREFERRED_VERSION_pango            = "1.24.4"
PREFERRED_VERSION_atk              = "1.20.0"
PREFERRED_VERSION_gtk+             = "2.14.2"
PREFERRED_VERSION_libpng           = "1.2.37"
PREFERRED_VERSION_expat            = "1.95.7"

# only dbus-glib 0.74 works with older dbus 1.0.x
PREFERRED_VERSION_dbus             = "1.2.3"
PREFERRED_VERSION_dbus-glib        = "0.78"

PREFERRED_VERSION_gnome-vfs        = "2.22.0"

# 3.9.1 would be correct
PREFERRED_VERSION_gtkhtml-3.8      = "3.8.2"
PREFERRED_VERSION_libxml2          = "2.7.3"
# 2.16 would be correct
PREFERRED_VERSION_gconf            = "2.6.1"

# gstreamer
PREFERRED_VERSION_gstreamer        = "0.10.25"
PREFERRED_VERSION_gst-plugins-good = "0.10.15"
PREFERRED_VERSION_gst-plugins-base = "0.10.25"
PREFERRED_VERSION_gst-plugins-bad  = "0.10.14"

PREFERRED_VERSION_bluez-libs            = "4.56"

PREFERRED_PROVIDER_virtual/db           = "db"
PREFERRED_PROVIDER_virtual/db-native    = "db-native"
PREFERRED_PROVIDER_virtual/xserver      = "xserver-xorg"

PREFERRED_PROVIDER_virtual/libsdl       = "libsdl-x11"
PREFERRED_VERSION_libsdl-x11	        = "1.2.11"
PREFERRED_VERSION_libsdl-image          = "1.2.3"
PREFERRED_VERSION_libsdl-mixer          = "1.2.6"

PREFERRED_PROVIDER_xserver          = "xserver-kdrive"

PREFERRED_VERSION_libxrandr         = "1.2.1"
PREFERRED_VERSION_xrandr            = "1.2.0"
PREFERRED_VERSION_randrproto        = "1.2.1"

PREFERRED_VERSION_libgnomeui         = "2.18.1"
PREFERRED_VERSION_gnomevfs           = "2.16.3"

PREFERRED_PROVIDER_gtk+                   = "gtk+"
PREFERRED_PROVIDER_gdk-pixbuf-loader-ani  = "gtk+"
PREFERRED_PROVIDER_gdk-pixbuf-loader-bmpg = "gtk+"
PREFERRED_PROVIDER_gdk-pixbuf-loader-gif  = "gtk+"
PREFERRED_PROVIDER_gdk-pixbuf-loader-ico  = "gtk+"
PREFERRED_PROVIDER_gdk-pixbuf-loader-jpeg = "gtk+"
PREFERRED_PROVIDER_gdk-pixbuf-loader-pcx  = "gtk+"
PREFERRED_PROVIDER_gdk-pixbuf-loader-png  = "gtk+"
PREFERRED_PROVIDER_gdk-pixbuf-loader-pnm  = "gtk+"
PREFERRED_PROVIDER_gdk-pixbuf-loader-ras  = "gtk+"
PREFERRED_PROVIDER_gdk-pixbuf-loader-tga  = "gtk+"
PREFERRED_PROVIDER_gdk-pixbuf-loader-wbmp = "gtk+"
PREFERRED_PROVIDER_gdk-pixbuf-loader-xbm  = "gtk+"
PREFERRED_PROVIDER_gdk-pixbuf-loader-xpm  = "gtk+"

PREFERRED_PROVIDER_gconf                  = "gconf-dbus"

PREFERRED_VERSION_pixman                  = "0.13.2"

PREFERRED_PROVIDER_virtual/libqte2	  = "qte-mt"
PREFERRED_PROVIDER_avahi		  = "avahi"

PREFERRED_VERSION_avahi = "0.6.20"

PREFERRED_VERSION_libglade = "2.6.2"

PREFERRED_VERSION_gpe-scap = "1.4"

# various Maemo4 specific libraries
PREFERRED_VERSION_mce-dev = "1.8.15"
PREFERRED_VERSION_libosso = "2.23"
PREFERRED_VERSION_libhildon = "2.2.0"
PREFERRED_VERSION_libhildonmime = "2.1.3"
PREFERRED_VERSION_libhildonfm = "2.28"
PREFERRED_VERSION_hildon-thumbnail = "3.0.41"

PREFERRED_VERSION_shared-mime-info = "0.30"

# Java stuff 
PREFERRED_PROVIDER_midpath = "midpath-maemo"
PREFERRED_PROVIDER_midpath-backend-gtk = "midpath-backend-gtk-hildon"

# Need jamvm-initial since cacao 0.98 seems to get miscompiled with newer GCCs.
PREFERRED_PROVIDER_virtual/java-initial ?= "jamvm-initial"

PREFERRED_PROVIDER_virtual/javac-native = "ecj-bootstrap-native"

PREFERRED_PROVIDER_classpath = "classpath"
PREFERRED_VERSION_classpath = "0.98"

PREFERRED_PROVIDER_swt3.4-gtk = "swt3.4-gtk-hildon"
PREFERRED_VERSION_swt3.4-gtk-hildon = "3.4"

# Does not build with later versions
PREFERRED_VERSION_fakeroot-native = "1.9.6"

# newer Versions needs newer autotools we cant relay on
PREFERRED_VERSION_guile-native = "1.8.2"

# WARNING: If you change these values after the respective package has
# been built the change will have no effect. Edit the package's file in 
# ${STAGING}/pkgdata/runtime then.
PKG_ncurses = "libncurses5"
PKG_ncurses-tools = "ncurses-bin"
PKG_ncurses-terminfo = "ncurses-base"

PKG_gtk+ = "libgtk2.0-0"
PKG_pango = "libpango1.0-0"
PKG_atk = "libatk1.0-0"
PKG_glib-2.0 = "libglib2.0-0"
PKG_gconf = "libgconf2-6"
DEBIANNAME_dbus_pn-dbus = "dbus"
PKG_libhildon = "libhildon1"
DEBIANNAME_eds-dbus_pn-libedataserver-1.2 = "libedataserver"

PKG_zlib = "zlib1g"
PKG_libglade = "libglade2-0"
PKG_libsoup = "libsoup2.2-8"

PKG_libsdl-mixer = "libsdl-mixer1.2"
PKG_libsdl-image = "libsdl-image1.2"
PKG_libsdl-directfb = "libsdl1.2"
PKG_libsdl-ttf = "libsdl-ttf2.0-0"
PKG_libsdl-gfx = "libsdl-gfx1.2-4"

PKG_bluez-libs = "libbluetooth2"
PKG_libgcc = "libgcc1"
```

## conf/distro/mamona.conf
```bitbake
#@--------------------------------------------------------------------
#@TYPE: Distribution
#@NAME: Mamona
#@--------------------------------------------------------------------

DISTRO_NAME = "Mamona"
DISTRO_VERSION = "test-${DATE}"
DISTRO_TYPE = "debug"

MAINTAINER = "Mamona Team <mamona-devel@garage.maemo.org>"

TARGET_VENDOR = "-mamona"

INHERIT += "angstrom-mirrors mamona-mirrors"
INHERIT += "package_deb debian"
INHERIT += "buildallpkgs"

CXXFLAGS += "-fvisibility-inlines-hidden"

# Kernel
# ======

KERNEL = "kernel26"
MACHINE_KERNEL_VERSION = "2.6"
PREFERRED_VERSION_linux-omap1 ?= "2.6.22-omap1"
PREFERRED_VERSION_linux-libc-headers ?= "2.6.22"
PREFERRED_VERSION_linux ?= "2.6.22"
PREFERRED_VERSION_linux-libc-headers_nokia770 = "2.6.16.osso7"
PREFERRED_PROVIDER_linux-libc-headers = "linux-libc-headers"

# Toolchain
# =========

# gcc
PREFERRED_PROVIDER_virtual/${TARGET_PREFIX}gcc-initial = "gcc-cross-initial"
PREFERRED_PROVIDER_virtual/${TARGET_PREFIX}gcc = "gcc-cross"
PREFERRED_PROVIDER_virtual/${TARGET_PREFIX}g++ = "gcc-cross"

PREFERRED_VERSION_gcc ?= "4.1.2"
PREFERRED_VERSION_gcc-cross ?= "4.1.2"
PREFERRED_VERSION_gcc-cross-sdk ?= "4.1.2"
PREFERRED_VERSION_gcc-cross-initial ?= "4.1.2"
PREFERRED_VERSION_gcc-cross-intermediate ?= "4.1.2"

# binutils
PREFERRED_PROVIDER_virtual/${TARGET_PREFIX}binutils = "binutils-cross"
PREFERRED_VERSION_binutils ?= "2.18"
PREFERRED_VERSION_binutils-cross ?= "2.18"
PREFERRED_VERSION_binutils-cross-sdk ?= "2.18"

# *libc
TARGET_OS = "linux-gnueabi"
LIBC = "glibc"
require conf/distro/include/${LIBC}.inc

PREFERRED_VERSION_glibc ?= "2.5"
PREFERRED_VERSION_glibc-intermediate ?= "2.5"
PREFERRED_VERSION_glibc-initial ?= "2.5"
PREFERRED_VERSION_uclibc ?= "0.9.29"

# Other Packages
# ==============

PREFERRED_PROVIDER_virtual/update-alternatives-native ?= "update-alternatives-dpkg-native"
PREFERRED_PROVIDER_virtual/update-alternatives ?= "update-alternatives-dpkg"
PREFERRED_PROVIDER_virtual/ecore ?= "ecore-x11"
PREFERRED_PROVIDER_virtual/evas ?= "evas-x11"
PREFERRED_PROVIDER_virtual/libx11 ?= "libx11"
PREFERRED_PROVIDER_virtual/libx11-native ?= "libx11-native"
PREFERRED_PROVIDER_virtual/libsdl ?= "libsdl-x11"
PREFERRED_PROVIDER_virtual/db ?= "db"
PREFERRED_PROVIDER_virtual/db-native ?= "db-native"
PREFERRED_PROVIDER_avahi = "avahi"
PREFERRED_PROVIDER_gconf = "gconf-dbus"

PREFERRED_VERSION_apt = "0.7.6"
PREFERRED_VERSION_gpsd ?= "2.33"
PREFERRED_VERSION_hal_nokia770 = "0.5.7"
PREFERRED_VERSION_networkmanager ?= "0.6.6"

# Mplayer
PREFERRED_VERSION_mplayer_nokia770 ?= "1.0maemo0"
PREFERRED_VERSION_mplayer_nokia800 ?= "1.0maemo0"

# Network
PREFERRED_VERSION_wpa-supplicant = "0.5.7"

# Mozilla
PREFERRED_PROVIDER_gtk+ = "gtk+"
PREFERRED_VERSION_gtk+ = "2.10.14"
```

## conf/distro/metano.conf
```bitbake
#@--------------------------------------------------------------------
#@TYPE: Distribution
#@NAME: Metano Linux <http://www.pynell.com>
#@DESCRIPTION: Metano Linux configuration file to distro version Metano PD ( Metano Packages Development )
#@MAINTAINER: Angelo 'Angelox_123' S. Mavridis Bartolome <angelo@pynell.com>
#@MAINTAINER: Hong 'penghb' Bo Peng <winice@sina.com>
#@MAINTAINER: Saurabh 'pr0d1gy' Singh  <satan.com@gmail.com>
#@--------------------------------------------------------------------
# This is the Metano PD Distro configuration file
# Use it for packages and images,development and
# system tasks

DISTRO_NAME ?= "Metano-Linux"
DISTRO_VERSION = "${SRCDATE}"
DISTRO_TYPE = "debug"


DISTRO_CHECK := "${@bb.data.getVar('DISTRO_VERSION',d,1) or bb.fatal('Remove this line or set a dummy DISTRO_VERSION')}"

#############################################################################
# FEATURE SELECTION OF SYSTEM
#############################################################################
# Use bluetooth 4.0
DISTRO_BLUETOOTH_MANAGER            = "bluez4"
PREFERRED_PROVIDER_bluez-utils-dbus = "bluez4"
PREFERRED_PROVIDER_bluez-libs       = "bluez-libs"
PREFERRED_PROVIDER_bluez-utils      = "bluez4"


DISTRO_FEATURES = "ipv4 ipv6 nfs smbfs wifi ppp alsa ext2 vfat pcmcia usbgadget usbhost pci"
DISTRO_FEATURES += "eabi"
DISTRO_FEATURES += "mplt"
DISTRO_FEATURES += ' ${@["", "thumb-interwork"][bb.data.getVar('THUMB_INTERWORK', d, 1) == "yes"]}'
IMAGE_LINGUAS = '${@base_less_or_equal("ROOT_FLASH_SIZE", "16", "", "en-us", d)}'

#############################################################################
# LIBRARY NAMES
#############################################################################

INHERIT += "debian"

#############################################################################
# PACKAGING SYSTEM
#############################################################################
# Packaging system

INHERIT += "package_ipk"
IMAGE_FSTYPES ?= "tar.gz"
PREFERRED_PKG_FORMAT ?= "ipk"

INHERIT += "src_distribute_local"
SRC_DIST_LOCAL ?= "symlink"

IPKG_VARIANT = "opkg"

#############################################################################
# IMAGES CONFIGURATION
#############################################################################
IMAGE_NAME = "Metano_Linux-PD.Edition-${DISTRO_VERSION}-${MACHINE}"

CACHE = "${TMPDIR}/cache/${LIBC}/${MACHINE}"
DEPLOY_DIR ?= "${TMPDIR}/deploy/${LIBC}"
DEPLOY_DIR_IMAGE = "${DEPLOY_DIR}/images/${MACHINE}"
SPLASH ?= '${@base_contains("MACHINE_FEATURES", "screen", "psplash", "",d)}'
PREFERRED_PROVIDER_virtual/psplash = "psplash"

EXTRA_IMAGECMD_ext2 = "-i 8192"

#############################################################################
# KERNEL CHANGES
#############################################################################
KERNEL = "kernel26"
MACHINE_KERNEL_VERSION = "2.6"

#############################################################################
# Ensure MACHINE_CLASS is in OVERRIDES
#############################################################################
MACHINE_CLASS ?= ""
MACHINE_OVERRIDES += "${MACHINE_CLASS}"

#############################################################################
# TOOLCHAIN SELECTION
#############################################################################
LIBC ?= "eglibc"
require conf/distro/include/sane-toolchain.inc
require conf/distro/include/arm-thumb.inc

#############################################################################
# PREFERRED VERSIONS
#############################################################################
require conf/distro/include/preferred-e-versions.inc
require conf/distro/include/preferred-opie-versions-1.2.4.inc

PREFERRED_PROVIDER_opkg ?= "opkg"
PREFERRED_PROVIDER_virtual/update-alternatives ?= "opkg"
XSERVER ?= "xserver-xorg xf86-input-evdev xf86-input-keyboard xf86-input-mouse xf86-video-fbdev" 

#############################################################################
# CONTENTS OF PACKAGE
#############################################################################
# Now you will can change the default things that'll be included on your image

DISTRO_EXTRA_APPS ?= ""
DISTRO_EXTRA_APPS += '${@base_conditional("DISTRO_TYPE", "release", "", "task-cli-tools-debug",d)}'


DISTRO_EXTRA_RDEPENDS += "\
  distro-feed-configs \
  util-linux-ng-mount util-linux-ng-umount \
  angstrom-libc-fixup-hack \
  ${DISTRO_EXTRA_APPS} \
"

DISTRO_EXTRA_RRECOMMENDS += " \
    kernel-module-vfat \
    kernel-module-ext2 \
    kernel-module-ext3 \
    kernel-module-af-packet \
    mplayer \
    alsa-lib \
    alsa-utils \
    nano \
    gpe-filemanager \
    gpe-mini-browser \
    ${XSERVER} \
    avahi-daemon \
    avahi-autoipd \
    openssh-sftp-server \
"
```
