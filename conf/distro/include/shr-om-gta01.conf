## conf/distro/micro-uclibc.conf
```bitbake
#############################################################################
#@TYPE: Distribution
#@NAME: Micro uclibc
#@DESCRIPTION: Micro Linux Distribution (uclibc based)
#@MAINTAINER: Martin Lund <mgl@doredevelopment.dk>
#@COMMENT: This distribution configuration defines a Micro Linux distribution
#@COMMENT: based on uclibc.
#############################################################################

#############################################################################
# DISTRO CONFIGURATION
#############################################################################

DISTRO_NAME = "micro-uclibc"
DISTRO_FEATURES = "xattr"

#############################################################################
# TOOLCHAIN
#############################################################################

LIBC = "uclibc"
# Based on the Micro Linux distribution
require conf/distro/micro.conf

# Use overrides for micro as well
OVERRIDES .= ":micro"

# Don't let glib-2.0 pull in gettext
USE_NLS_glib-2.0 = "no"
```

## conf/distro/micro.conf
```bitbake
#############################################################################
#@TYPE: Distribution
#@NAME: Micro
#@DESCRIPTION: Micro Linux Distribution (eglibc based)
#@MAINTAINER: Martin Lund <mgl@doredevelopment.dk>
#@COMMENT: This distribution configuration defines a truely tiny OE Linux  
#@COMMENT: distribution. The matching buildable image target (micro-image)
#@COMMENT: basically consists of: libc, busybox, udev, sysv init, and a few
#@COMMENT: init scripts for running up the system.
#############################################################################

#############################################################################
# DISTRO CONFIGURATION
#############################################################################
DISTRO_NAME = "micro"
DISTRO_VERSION = "${SRCDATE}"

#############################################################################
# DISTRO FEATURE SELECTION
#############################################################################
# No features selected
DISTRO_FEATURES = "eabi"

#############################################################################
# LIBRARY NAMES
#############################################################################
# Use Debian naming scheme for library (.so) files
INHERIT += "debian"

#############################################################################
# PACKAGING & FEEDS
#############################################################################
# Select packaging system
PREFERRED_PKG_FORMAT = "ipk"
IPKG_VARIANT = "opkg-nogpg"

require conf/distro/include/sane-feed.inc
require conf/distro/include/sane-feed-${PREFERRED_PKG_FORMAT}.inc

#############################################################################
# IMAGES
#############################################################################
# Name generated images
IMAGE_NAME = "${DISTRO_NAME}-${IMAGE_BASENAME}-${LIBC}-\
${PREFERRED_PKG_FORMAT}-${DISTRO_VERSION}-${MACHINE}"

CACHE ?= "${TMPDIR}/cache/${LIBC}/${MACHINE}"
DEPLOY_DIR ?= "${TMPDIR}/deploy/${LIBC}"
DEPLOY_DIR_IMAGE = "${DEPLOY_DIR}/images/${MACHINE}"

# Image output types
IMAGE_FSTYPES ?= "tar.gz jffs2"

#############################################################################
# LINUX KERNEL SELECTION
#############################################################################
KERNEL = "kernel26"
MACHINE_KERNEL_VERSION = "2.6"

#############################################################################
# TOOLCHAIN
#############################################################################
LIBC ?= "eglibc"
PREFERRED_BINUTILS = "2.19.51"
PREFERRED_VERSION_glibc             ?= "2.10.1"
PREFERRED_VERSION_glibc-initial     ?= "2.10.1"
PREFERRED_ARM_INSTRUCTION_SET ?= "thumb"
require conf/distro/include/sane-toolchain.inc

#############################################################################
# OVERRIDES adjusted from bitbake.conf to feature the MACHINE_CLASS
#############################################################################
OVERRIDES = "local:${MACHINE}:${MACHINE_CLASS}:${DISTRO}:${TARGET_OS}:\
${TARGET_ARCH}:build-${BUILD_OS}:fail-fast:pn-${PN}"

#############################################################################
# PREFERRED VERSIONS
#############################################################################
require conf/distro/include/sane-srcdates.inc
require conf/distro/include/sane-srcrevs.inc
require conf/distro/include/preferred-xorg-versions-X11R7.5.inc

#############################################################################
# NLS
#############################################################################
USE_NLS = "no"
USE_NLS_glib-2.0 = "yes"
USE_NLS_glib-2.0-native = "yes"
USE_NLS_gcc-cross = "no"

# Disable binary locale generation
ENABLE_BINARY_LOCALE_GENERATION = "0"

# Don't install useless symlinks to libraries
PACKAGE_SNAP_LIB_SYMLINKS = "1"

# Collapse /usr into /
prefix = ""
exec_prefix = ""
prefix_native = ""
exec_prefix_native = ""

# Don't install ldconfig and associated gubbins
USE_LDCONFIG = "0"

# Disable online package management
ONLINE_PACKAGE_MANAGEMENT = "none"

DISTRO_BLUETOOTH_MANAGER = "bluez4"
```
