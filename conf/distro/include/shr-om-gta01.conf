## conf/distro/jlime-2009.1.conf
```bitbake
#-----------------------------------------------------------------------------
#@TYPE: Distribution
#@NAME: Jlime 2009.1 <http://jlime.com>
#@DESCRIPTION: Jlime Mobility Embedded Linux Distribution for the
#              HP Jornada 620/660/680/690/720/728 handheld pc + Nec MP900c,
#	       Ben Nanonote.
#@MAINTAINER: Kristoffer Ericson <Kristoffer.Ericson@gmail.com>
#-----------------------------------------------------------------------------

#
# Header
#
DISTRO_NAME = "Jlime"
DISTRO_VERSION = "2009.1"
DISTRO_TYPE = "release"
export FEED_URLS_jlime = "http://repository.jlime.com/"

#<>------------------------------------------------------------------>
#<>What we want on the bootstrap image (extra) 
#<>                                            
#<>------------------------------------------------------------------<
DISTRO_EXTRA_RDEPENDS = "wireless-tools nano keymaps tslib-calibrate \
			console-tools tslib-tests parted dialog"

#<>------------------------------------------------------------------>
#<>Our Image files should look abit better.
#<>
#<>------------------------------------------------------------------<
IMAGE_NAME = "${IMAGE_BASENAME}-2009.1-${MACHINE}"
SPLASH = "psplash"

#
# Naming schemes + packages
#
INHERIT += "debian package_tar package_ipk src_distribute_local src_distribute"
IMAGE_FSTYPES = "tar.gz tar.bz2 jffs2"

#
# Kernel
#
KERNEL = "kernel26"
MACHINE_KERNEL_VERSION = "git"

#
# Binutils & Compiler
#
PREFERRED_PROVIDERS += " virtual/${TARGET_PREFIX}gcc-initial:gcc-cross-initial"
PREFERRED_PROVIDERS += " virtual/${TARGET_PREFIX}gcc-intermediate:gcc-cross-intermediate"
PREFERRED_PROVIDERS += " virtual/${TARGET_PREFIX}gcc:gcc-cross"
PREFERRED_PROVIDERS += " virtual/${TARGET_PREFIX}g++:gcc-cross"
PREFERRED_PROVIDERS += " virtual/${TARGET_PREFIX}binutils:binutils-cross"
PREFERRED_PROVIDER_linux-libc-headers = "linux-libc-headers"
PREFERRED_PROVIDER_virtual/libusb0 = "libusb"
PREFERRED_PROVIDER_virtual/db = "db"
PREFERRED_PROVIDER_virtual/db-native = "db-native"
PREFERRED_PROVIDER_virtual/gtk+ = "gtk+"
PREFERRED_PROVIDER_gconf = "gconf"
PREFERRED_PROVIDER_avahi = "avahi"
PREFERRED_PROVIDER_gtk+ = "gtk+"
PREFERRED_PROVIDER_virtual/libqte2 = "qte-mt-static"
PREFERRED_PROVIDER_bluez-libs = "bluez-libs"
PREFERRED_VERSION_gettext-native = "0.14.1"

PREFERRED_VERSION_gcc = "4.2.2"
PREFERRED_VERSION_gcc-cross = "4.2.2"
PREFERRED_VERSION_gcc-cross-initial = "4.2.2"
PREFERRED_VERSION_gcc-cross-intermediate = "4.2.2"
PREFERRED_VERSION_binutils = "2.18"
PREFERRED_VERSION_binutils-cross = "2.18"
PREFERRED_VERSION_coreutils-native = "6.0"
PREFERRED_VERSION_e2fsprogs-libs-native = "1.35"

PREFERRED_VERSION_cdparanoia  = "10.2"

#
# Target OS & FPU system
# 
TARGET_OS = "linux"
TARGET_FPU_sh = "soft"
TARGET_FPU_arm = "soft"
TARGET_FPU_armeb = "soft"
TARGET_FPU_mipsel = "soft"
TARGET_FPU_mips = "soft"

LIBC = "glibc"
require conf/distro/include/${LIBC}.inc

PREFERRED_VERSION_linux-libc-headers = "2.6.25"
PREFERRED_VERSION_glibc-initial = "2.6.1"
PREFERRED_VERSION_glibc = "2.6.1"

#
# Bootstrap & Init
#
PREFERRED_PROVIDER_task-bootstrap = "task-bootstrap"
require conf/distro/include/sane-srcdates.inc
require conf/distro/include/sane-srcrevs.inc

#
# Framebuffer & X
#
PREFERRED_PROVIDER_virtual/libx11 = "diet-x11"
PREFERRED_PROVIDER_tslib = "tslib"
PREFERRED_PROVIDER_virtual/libsdl = "libsdl-x11"
PREFERRED_PROVIDER_xserver = "xserver-kdrive"
require conf/distro/include/preferred-xorg-versions-X11R7.5.inc
```

## conf/distro/jlime-2010.1.conf
```bitbake
#-----------------------------------------------------------------------------
#@TYPE: Distribution
#@NAME: Jlime 2010.1 <http://www.jlime.com>
#@DESCRIPTION: Jlime Mobility Embedded Linux Distribution for the
#              HP Jornada 620/660/680/690/720/728 handheld pc + Nec MP900c,
#	       Ben Nanonote.
#	       Unofficial support for Netbook pro, Bsquare Maui.
#@MAINTAINER: Kristoffer Ericson <Kristoffer.Ericson@gmail.com>
#@MAINTAINER: Alex Ferguson <thoughtmonster@gmail.com>
#@MAINTAINER: Filip Zyzniewski <filip.zyzniewski@gmail.com>
#-----------------------------------------------------------------------------

#
# Header
#
DISTRO_NAME = "Jlime"
DISTRO_VERSION = "2010.1"
DISTRO_TYPE = "release"
export FEED_URLS_jlime = "http://repository.jlime.com/"

OVERRIDES .= ":jlime"

#
# What we want on the bootstrap image (extra) 
#
DISTRO_EXTRA_RDEPENDS = "nano keymaps console-tools"

#
# Our Image files should look abit better.
#
IMAGE_NAME = "${DISTRO_NAME}-${IMAGE_BASENAME}-${DISTRO_VERSION}-${MACHINE}"
SPLASH = "psplash"

#
# Naming schemes + packages
#
INHERIT += "debian package_tar package_ipk src_distribute_local"
SRC_DIST_LOCAL ?= "symlink"
IMAGE_FSTYPES = "tar.gz tar.bz2 jffs2"
PREFERRED_PROVIDER_virtual/update-alternatives = "opkg"

#
# Kernel
#
KERNEL = "kernel26"
MACHINE_KERNEL_VERSION = "git"

#
# Binutils & Compiler
#
PREFERRED_PROVIDERS += " virtual/${TARGET_PREFIX}gcc-initial:gcc-cross-initial"
PREFERRED_PROVIDERS += " virtual/${TARGET_PREFIX}gcc-intermediate:gcc-cross-intermediate"
PREFERRED_PROVIDERS += " virtual/${TARGET_PREFIX}gcc:gcc-cross"
PREFERRED_PROVIDERS += " virtual/${TARGET_PREFIX}g++:gcc-cross"
PREFERRED_PROVIDERS += " virtual/${TARGET_PREFIX}binutils:binutils-cross"
PREFERRED_PROVIDER_linux-libc-headers = "linux-libc-headers"

#
# Target OS & FPU system
# 
TARGET_OS = "linux-gnueabi"

TARGET_FPU_sh = "soft"
TARGET_FPU_arm = "soft"
TARGET_FPU_armeb = "soft"
TARGET_FPU_mipsel = "soft"
TARGET_FPU_mips = "soft"

DISTRO_FEATURES += "eabi wifi"

LIBC ?= "eglibc"
PREFERRED_PROVIDER_virtual/libc = "${LIBC}"
PREFERRED_VERSION_linux-libc-headers = "2.6.34"
require conf/distro/include/sane-toolchain.inc
require conf/distro/include/arm-thumb.inc

#
# Bootstrap & Init
#
PREFERRED_PROVIDER_task-bootstrap = "task-bootstrap"

#
# Framebuffer & X
#
PREFERRED_PROVIDER_virtual/libx11 = "libx11"
PREFERRED_PROVIDER_virtual/libx11-native = "libx11-native"
PREFERRED_PROVIDER_virtual/libsdl = "libsdl-x11"
PREFERRED_PROVIDER_virtual/libgl = "mesa-xlib"
PREFERRED_PROVIDER_tslib = "tslib"
XSERVER ?= " xserver-xorg xf86-input-evdev xf86-input-keyboard xf86-input-mouse xf86-video-fbdev " 

#
# General Userspace
#
PREFERRED_PROVIDER_virtual/psplash = "psplash"
PREFERRED_PROVIDER_virtual/libusb0 = "libusb"
PREFERRED_PROVIDER_virtual/db = "db"
PREFERRED_PROVIDER_virtual/db-native = "db-native"
PREFERRED_PROVIDER_virtual/gtk+ = "gtk+"
PREFERRED_PROVIDER_gconf = "gconf"
PREFERRED_PROVIDER_avahi = "avahi"
PREFERRED_PROVIDER_gtk+ = "gtk+"
PREFERRED_PROVIDER_virtual/libqte2 = "qte-mt-static"

ANGSTROM_BLACKLIST_pn-bluez-libs = "bluez-libs 3.x has been replaced by bluez4"
ANGSTROM_BLACKLIST_pn-bluez-utils = "bluez-utils 3.x has been replaced by bluez4"
DISTRO_BLUETOOTH_MANAGER = "blueprobe bluez4"

require conf/distro/include/preferred-opie-versions-1.2.4.inc
```

## conf/distro/jlime-donkey.conf
```bitbake
#@TYPE: Distribution
#@NAME: Jornada Linux Mobility Edition (JLime) <www.jlime.com>
#@DESCRIPTION: Distribution file for JLime (Linux for HP jornada 5xx,6xx,7xx,8xx series)
#@MAINTAINER: Kristoffer Ericson <Kristoffer@jlime.com>

DISTRO_NAME = "jlime"
DISTRO_VERSION = "donkey"

require conf/distro/include/sane-srcdates.inc
require conf/distro/include/sane-srcrevs.inc

export FEED_URLS_jlime = "donkey##http://donkey-${ARCH}.jlime.com"

#<>----------------------------------------------------------------->
#<> No uniroot
#<>-----------------------------------------------------------------<
PREFERRED_PROVIDER_task-bootstrap = "task-bootstrap"

#<>----------------------------------------------------------------->
#<> We will set CVS DATE when things are known to work.
#<>-----------------------------------------------------------------<
PREFERRED_PROVIDERS +=  "virtual/${TARGET_PREFIX}gcc-initial:gcc-cross-initial"
PREFERRED_PROVIDERS +=  "virtual/${TARGET_PREFIX}gcc-intermediate:gcc-cross-intermediate"
PREFERRED_PROVIDERS +=  "virtual/${TARGET_PREFIX}gcc:gcc-cross"
PREFERRED_PROVIDERS +=  "virtual/${TARGET_PREFIX}g++:gcc-cross"
LIBC = "glibc"
require conf/distro/include/${LIBC}.inc

#<>----------------------------------------------------------------->
#<> We want this so we can crosscompile the kernel using gcc 3.4.3
#<> Also, select version of modules (and kernel)
#<>-----------------------------------------------------------------<
PREFERRED_PROVIDERS +=  "virtual/${TARGET_PREFIX}gcc-3.4.4:gcc-cross-kernel"
PREFERRED_PROVIDER_virtual/kernel = "linux-jlime-${MACHINE}"


#<>----------------------------------------------------------------->
#<>We want kdrive as our default X-Server.
#<>-----------------------------------------------------------------<
PREFERRED_PROVIDER_xserver          = "xserver-kdrive"
PREFERRED_PROVIDER_virtual/xserver  = "xserver-kdrive"
PREFERRED_PROVIDER_virtual/libx11    = "libx11"
require conf/distro/include/preferred-xorg-versions-X11R7.3.inc


#<>----------------------------------------------------------------->
#<>Setting Preferred Binutils,gcc,glibc and linux-libc-headers
#<>-----------------------------------------------------------------<
PREFERRED_VERSION_binutils = "2.18"
PREFERRED_VERSION_binutils-cross = "2.18"
PREFERRED_VERSION_binutils-cross-sdk = "2.18"
PREFERRED_VERSION_gcc = "4.2.2"
PREFERRED_VERSION_gcc-cross = "4.2.2"
PREFERRED_VERSION_gcc-cross-initial = "4.2.2"
PREFERRED_VERSION_gcc-cross-intermediate = "4.2.2"
PREFERRED_VERSION_linux-libc-headers = "2.6.23"                                             		    
PREFERRED_VERSION_glibc = "2.6.1"
PREFERRED_VERSION_glibc-initial = "2.6.1"

#<>------------------------------------------------------------------>
#<>
#<>Setting Preferred xserver-kdrive. Also choose diet-x11 as default libx11.
#<>------------------------------------------------------------------<
#PREFERRED_VERSION_xserver-kdrive = "X11R7.1-1.1.0"
PREFERRED_PROVIDER_tslib          = "tslib"
PREFERRED_PROVIDER_virtual/libsdl = "libsdl-x11"

#<>------------------------------------------------------------------>
#<>
#<>System-critical software with known working versions.
#<>------------------------------------------------------------------<
PREFERRED_VERSION_linux-jlime-jornada6xx = "2.6.24"
PREFERRED_VERSION_udev = "118"
PREFERRED_VERSION_busybox = "1.9.1"

#<>------------------------------------------------------------------>
#<>Other Specific stuff.
#<>
#<>
#<>We want to be able to build this for all jornadas so
#<>to not mess up the folders we need to make them dynamic.
#<>It will use different folders depending on Arch (set in local.conf)
#<>------------------------------------------------------------------<
SRC_DIST_LOCAL = "copy"
INHERIT += "package_ipk package_tar src_distribute_local"
BBINCLUDELOGS = "yes"
IMAGE_FSTYPES = "tar.bz2"
TARGET_OS = "linux"


#<>------------------------------------------------------------------>
#<>What we want on the bootstrap image (extra) 
#<>                                            
#<>------------------------------------------------------------------<
DISTRO_EXTRA_RDEPENDS = "wireless-tools nano keymaps tslib-calibrate tslib-tests console-tools \
                         parted dialog"


#<>------------------------------------------------------------------>
#<>What Qte, libqte.. versions should we use.
#<>------------------------------------------------------------------<
QTE_VERSION = "2.3.10"
PALMTOP_USE_MULTITHREADED_QT = "yes"
OPIE_VERSION = "1.2.3"
require conf/distro/include/preferred-opie-versions-1.2.3.inc


#<>------------------------------------------------------------------>
#<> We want pcmciautils, not pcmcia-cs
#<>------------------------------------------------------------------<
PCMCIA_MANAGER = "pcmciautils"


#<>------------------------------------------------------------------>
#<> We are using gcc 4.1.1 so lets keep optimizations low
#<>------------------------------------------------------------------< 
FULL_OPTIMIZATION = "-O2"


#<>------------------------------------------------------------------>
#<>Our Image files should look abit better.
#<>
#<>------------------------------------------------------------------<
IMAGE_NAME = "${IMAGE_BASENAME}-Donkey-${MACHINE}"


#<>------------------------------------------------------------------>
#<>
#<>
#<> General non-essential programs with known working versions
#<>
#<>------------------------------------------------------------------<
PREFERRED_VERSION_tightvnc = "1.3.9"
PREFERRED_VERSION_xmonobut = "0.4"
PREFERRED_VERSION_konqueror-embedded = "20070212"
#PREFERRED_VERSION_encodings = "X11R7.0-1.0.0"
PREFERRED_VERSION_icewm = "1.2.34"
PREFERRED_VERSION_xchat = "1.8.11"
PREFERRED_VERSION_rxvt = "2.6.4"
```

## conf/distro/jlime-shrek.conf
```bitbake
#@TYPE: Distribution
#@NAME: Jornada Linux Mobility Edition (JLime) <www.jlime.com>
#@DESCRIPTION: Linux for HP jornada 5xx,6xx,7xx,8xx series
#@MAINTAINER: Kristoffer Ericson <Kristoffer@jlime.com>

DISTRO = "Jornada Linux Mobility Edition"
DISTRO_NAME = "JLime"
DISTRO_VERSION = "Shrek"
DISTRO_TYPE = "release"

export FEED_URLS_jlime = "shrek##http://www.jlime.com/downloads/releases/shrek/${TARGET_ARCH}/feed/"

SRCDATE = 20050518

PREFERRED_PROVIDERS  =  "virtual/${TARGET_PREFIX}gcc-initial:gcc-cross-initial"
PREFERRED_PROVIDERS += " virtual/${TARGET_PREFIX}gcc:gcc-cross"
PREFERRED_PROVIDERS += " virtual/${TARGET_PREFIX}g++:gcc-cross"
PREFERRED_PROVIDERS += " virtual/${TARGET_PREFIX}libc-for-gcc:glibc"
PREFERRED_PROVIDER_virtual/kernel = "jlime-kernel-${TARGET_ARCH}"
PREFERRED_PROVIDER_xserver        = "xserver-kdrive"

PREFERRED_VERSION_binutils = "2.15.94.0.1"
PREFERRED_VERSION_binutils-cross = "2.15.94.0.1"
PREFERRED_VERSION_binutils-cross-sdk = "2.15.94.0.1"
PREFERRED_VERSION_gcc = "3.4.3"
PREFERRED_VERSION_gcc-cross = "3.4.3"
PREFERRED_VERSION_gcc-cross-initial = "3.4.3"
PREFERRED_VERSION_linux-libc-headers = "2.6.7.0"                                             		    
PREFERRED_VERSION_glib-2.0-native = "2.6.2"
PREFERRED_VERSION_glib-2.0 = "2.6.2"
PREFERRED_VERSION_dpkg = "1.10.23"
PREFERRED_VERSION_qte = "2.3.10"
PREFERRED_VERSION_xserver-kdrive = "20050207"

INHERIT += "package_tar package_ipk"
BBINCLUDELOGS = "yes"
MODUTILS = "26"
IMAGE_FSTYPES = "tar.bz2"

BOOTSTRAP_EXTRA_RDEPENDS += "pcmcia-cs ncurses nano wireless-tools            \ 
kernel-module-3c574-cs    kernel-module-3c589-cs    kernel-module-8390        \
kernel-module-airo-cs     kernel-module-airo        console-tools             \
kernel-module-arlan                                                           \
kernel-module-atmel-cs    kernel-module-atmel       kernel-module-axnet-cs    \
kernel-module-hermes                                                          \
kernel-module-wavelan     kernel-module-wavelan-cs                            \
kernel-module-xirc2ps-cs  kernel-module-orinoco-cs  kernel-module-orinoco     \
kernel-module-nmclan-cs   kernel-module-pcnet-cs    e2tools e2fsprogs"

TARGET_OS = "linux"

OPIE_VERSION = "1.2.1"  
include conf/distro/preferred-opie-versions.inc  
```
