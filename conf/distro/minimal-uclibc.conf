## conf/distro/opendreambox-1.5.conf
```bitbake
# Maintainer: Felix Domke <tmbinc@elitedvb.net>

include conf/distro/opendreambox.conf
DISTRO = "opendreambox"
DISTRO_NAME = "OpenDreambox"
DISTRO_VERSION = "1.5.0"

FEED_URIS += "official##http://sources.dreamboxupdate.com/opendreambox/1.5/${MACHINE}/feed"

# freetype < 2.1.8 is a *must*, because of the old api
# we choose 2.0.9 as it somehow renders in a different way,
# resulting in better quality. 
PREFERRED_VERSION_freetype = "2.0.9"
SRCDATE = 20070625

PREFERRED_VERSION_python-native = "2.5.1"
PREFERRED_VERSION_swig-native = "1.3.31"
PREFERRED_VERSION_python = "2.5.1"
PREFERRED_VERSION_ipkg = "0.99.154"
PREFERRED_VERSION_busybox = "1.01"

# we need libsigc++-1.2 1.2.5
PREFERRED_VERSION_libsigc++-1.2 = "1.2.5"

PREFERRED_VERSION_autoconf-native = "2.59"
```

## conf/distro/opendreambox.conf
```bitbake
#@TYPE: Distribution
#@NAME: OpenDreambox
#@DESCRIPTION: Distribution configuration for OpenDreambox

INHERIT += "package_ipk debian"

SYSVINIT_ENABLED_GETTYS = ""
```

## conf/distro/openmn.conf
```bitbake
#@TYPE: Distribution
#@NAME: OpenMN
#@DESCRIPTION: Destribution for Devices produced by M&N Solutions GmbH, Germany, Rosbach

# Used in base-files for /etc/issue and /etc/issue.net
DISTRO_NAME = "OpenMN"
DISTRO_VERSION = "5.4"

TARGET_ARCH = "arm"
TARGET_FPU = "soft"
TARGET_OS = "linux"

INHERIT += "package_ipk"
INHERIT += "debian"
IPKG_EXTRA_ARCHS = "armv5te openmn"

FEED_URIS  = "mnci54##http://www.mn-solutions.de/feed/mnci54/base"

IMAGE_FSTYPE = "jffs2"
EXTRA_IMAGECMD_jffs2 = "--pad=0x1ec0000 --eraseblock=0x40000"
IMAGE_CMD_jffs2 = "mkfs.jffs2 --root=${IMAGE_ROOTFS} --faketime --output=${DEPLOY_DIR_IMAGE}/rootfs.${MACHINE} ${EXTRA_IMAGECMD}"
```

## conf/distro/openmnci.conf
```bitbake
INHERIT += "package_ipk"
INHERIT += "debian"

OEINCLUDELOGS = "yes"
KERNEL_CONSOLE = "ttyS0"
TARGET_OS = "linux"
TARGET_FPU = "soft"
#TARGET_ARCH = "arm-linuxeabi"
```

## conf/distro/openmoko.conf
```bitbake
WARNING:="${@bb.fatal('\n*\n*\n*    Sorry, The Openmoko distribution has been removed on Aug 10, 2010. \
\n*    It is recommended to use DISTRO = \"shr\" distro instead. \
\n*    \
\n*    If you really need Openmoko you can still find it in git.\n*\n*\n')}"
```

## conf/distro/openomap.conf
```bitbake
#@TYPE: Distribution
#@NAME: OpenOMAP
#@DESCRIPTION: OE Distribution for TI OMAP Development Boards

INHERIT += " package_ipk debian"
TARGET_OS = "linux"
TARGET_FPU ?= "soft"

# 2.4 vs 2.6 is a distro decision.
MODUTILS = "26"

PREFERRED_PROVIDER_task-bootstrap = "task-bootstrap"

PREFERRED_PROVIDER_hotplug = "udev"

PREFERRED_PROVIDERS += "virtual/${TARGET_PREFIX}gcc-initial:gcc-cross-initial"
PREFERRED_PROVIDERS += "virtual/${TARGET_PREFIX}gcc:gcc-cross"
PREFERRED_PROVIDERS += "virtual/${TARGET_PREFIX}g++:gcc-cross"

#EABI stuff
PREFERRED_PROVIDER_virtual/${TARGET_PREFIX}-libc-for-gcc = "glibc-intermediate"
PREFERRED_PROVIDER_virtual/arm-angstrom-linux-gnueabi-libc-for-gcc = "glibc-intermediate"
PREFERRED_PROVIDER_virtual/arm-linux-libc-for-gcc = "glibc-intermediate"


#use EABI toolchain
PREFERRED_VERSION_gcc ?= "4.1.1"
PREFERRED_VERSION_gcc-cross ?= "4.1.1"
PREFERRED_VERSION_gcc-cross-initial ?= "4.1.1"
PREFERRED_VERSION_binutils ?= "2.17"
PREFERRED_VERSION_binutils-cross ?= "2.17"
PREFERRED_VERSION_linux-libc-headers ?= "2.6.15.99"
PREFERRED_VERSION_glibc ?= "2.4"
PREFERRED_VERSION_glibc-intermediate ?= "2.4"

# We want images supporting the following features (for task-base)
DISTRO_FEATURES = "nfs pcmcia usbhost"
```

## conf/distro/openprotium.conf
```bitbake
#
# OpenProtium distribution - based upon openslug and generic confs
# 
DISTRO_NAME = "openprotium"
DISTRO_VERSION = "1.3"
DISTRO_TYPE ?= "alpha"
TARGET_OS = "linux"
#
# Basic configuration
#
IMAGE_DEV_MANAGER = "udev"
DISTRO_SSH_DAEMON = "dropbear"
IMAGE_INIT_MANAGER = "sysvinit"
IMAGE_LOGIN_MANAGER = "tinylogin"
MACHINE_TASK_PROVIDER = "task-openprotium"

#
# Naming schemes
#
INHERIT += "debian"

#
# Packaging and output format
#
INHERIT += "package_ipk"
IMAGE_FSTYPES = "jffs2 tar.gz"
OPENPROTIUM_URI = "http://www.openprotium.org"
FEED_ARCH_storcenter = ppc603e
FEED_ARCH_turbostation = ppc603e
FEED_URIS = "\
	no-arch##${OPENPROTIUM_URI}/releases/${DISTRO_VERSION}/all \
	base##${OPENPROTIUM_URI}/releases/${DISTRO_VERSION}/${FEED_ARCH} \
	${MACHINE}##${OPENPROTIUM_URI}/releases/${DISTRO_VERSION}/${MACHINE} \
	"

# For protium on the turbostation
IMAGE_BASENAME = "openprotium"
IMAGE_BASENAME_turbostation = "openprotium-ts"

# versions
PREFERRED_VERSION_binutils ?= "2.18"
PREFERRED_VERSION_binutils-cross ?= "2.18"

PREFERRED_VERSION_gcc ?= "4.1.1"
PREFERRED_VERSION_gcc-cross ?= "4.1.2"
PREFERRED_VERSION_gcc-cross-sdk ?= "4.1.2"
PREFERRED_VERSION_gcc-cross-initial ?= "4.1.2"
PREFERRED_VERSION_gcc-cross-intermediate ?= "4.1.2"

PREFERRED_VERSION_glibc		     = "2.6.1"
PREFERRED_VERSION_glibc-initial      = "2.6.1"

PREFERRED_VERSION_linux-libc-headers = "2.6.11.1"

#
# Providers...
#
# binutils and compilers
#
PREFERRED_PROVIDER_virtual/${TARGET_PREFIX}binutils = "binutils-cross"
PREFERRED_PROVIDER_virtual/${TARGET_PREFIX}gcc-initial = "gcc-cross-initial"
PREFERRED_PROVIDER_virtual/${TARGET_PREFIX}gcc-intermediate = "gcc-cross-intermediate"
PREFERRED_PROVIDER_virtual/${TARGET_PREFIX}gcc = "gcc-cross"
PREFERRED_PROVIDER_virtual/${TARGET_PREFIX}g++ = "gcc-cross"

LIBC = "glibc"
require conf/distro/include/${LIBC}.inc

#silence a warning message...
PREFERRED_PROVIDER_linux-libc-headers = "linux-libc-headers"

#
# Misc items.
#
PREFERRED_PROVIDER_virtual/db 		?= "db"
PREFERRED_PROVIDER_virtual/db-native 	?= "db-native"
PREFERRED_PROVIDER_gconf 		?= "gconf"
```

## conf/distro/opensimpad-0.9.0.conf
```bitbake
DISTRO = "opensimpad"
DISTRO_NAME = "OpenSIMpad"
DISTRO_VERSION = "0.9.0-rc2-${DATE}"

include conf/distro/openzaurus-3.5.4.conf
```

## conf/distro/opensimpad.conf
```bitbake
#@TYPE: Distribution
#@NAME: OpenSIMpad
#@DESCRIPTION: Distribution configuration for OpenSIMpad (http://www.opensimpad.org)

INHERIT += " package_ipk debian"
TARGET_OS ?= "linux"
TARGET_FPU ?= "soft"

PARALLEL_INSTALL_MODULES = "1"

DISTRO_CHECK := "${@bb.data.getVar("DISTRO_VERSION",d,1) or bb.fatal('Remove this line or set a dummy DISTRO_VERSION if you really want to build an unversioned distro')}"
```

## conf/distro/openslug-native.conf
```bitbake
include conf/distro/openslug.conf

# Corresponting packages should be in openslug-native.bb,
# currently missing: ipkg-utils libtool quilt pkgconfig
ASSUME_PROVIDED = "libtool-cross \
		   libtool-native \
		   automake-native \
		   autoconf-native \
		   quilt-native \
		   ipkg-native \
		   gnu-config-native \
		   pkgconfig-native \
		   virtual/armeb-linux-gcc \
		   virtual/libc \
		   update-rc.d \
		   "

# Our build host is armeb, not armv5eb that the kernel reports
BUILD_ARCH = armeb
```

## conf/distro/openslug-packages.conf
```bitbake
SLUGOS_EXTRA_BBFILES = "${OPENSLUG_EXTRA_BBFILES}"
include conf/distro/slugos-packages.conf
```

## conf/distro/openslug.conf
```bitbake
#@TYPE: Distribution
#@NAME: OpenSlug
#@DESCRIPTION: OpenSlug Linux Distribution for the NSLU2

DISTRO_NAME = "OpenSlug"
IMAGE_BASENAME = "openslug"
TARGET_ARCH = "armeb"
ARM_INSTRUCTION_SET = "arm"
TARGET_OS = "linux"

require conf/distro/slugos.conf
```

## conf/distro/openturbostation.conf
```bitbake
#
# Open TurboStation distribution - based on openprotium
# 
DISTRO_NAME = "openturbostation"
DISTRO_VERSION = ".dev-snapshot-${SRCDATE}"
DISTRO_TYPE = "alpha"

#
# Naming schemes
#
INHERIT += "debian"

#
# Packaging and output format
#
INHERIT += "package_ipk"
IMAGE_BASENAME = "openturbostation"
IMAGE_FSTYPES = "jffs2"
FEED_URIS = "openturbostation##http://ipkg.kynisk.com/opents/cross/1.0-dev/packages"
FEED_URIS = "openturbostation-kernel##http://ipkg.kynisk.com/opents/cross/1.0-dev/kernel"
# For protium on the turbostation

#
# binutils and compilers
#
PREFERRED_PROVIDERS += "virtual/${TARGET_PREFIX}gcc-initial:gcc-cross-initial"
PREFERRED_PROVIDERS += "virtual/${TARGET_PREFIX}gcc:gcc-cross"
PREFERRED_PROVIDERS += "virtual/${TARGET_PREFIX}g++:gcc-cross"
#conflict between this and the last below.
#PREFERRED_PROVIDERS += "virtual/${TARGET_PREFIX}libc-for-gcc:glibc"
# Select 2.6 versions of the depmod support
PREFERRED_PROVIDERS += "virtual/${TARGET_PREFIX}depmod:module-init-tools-cross"
PREFERRED_PROVIDERS += "virtual/${TARGET_PREFIX}libc-for-gcc:glibc-intermediate"

PREFERRED_VERSION_binutils = "2.16"
PREFERRED_VERSION_binutils-cross = "2.16"

PREFERRED_VERSION_gcc = "4.1.2"
PREFERRED_VERSION_gcc-cross = "4.1.2"
PREFERRED_VERSION_gcc-cross-initial = "4.1.2"

PREFERRED_VERSION_glibc = "2.5"
PREFERRED_VERSION_glibc-intermediate = "2.5"
PREFERRED_VERSION_glibc-initial = "2.3.2"

# 
# Target OS & FPU system
#
USE_NLS ?= "no"
TARGET_OS = "linux"
HOTPLUG = "udev"
PREFERRED_PROVIDER_virtual/libiconv = "glibc"
PREFERRED_PROVIDER_virtual/libintl = "glibc"

#
# Bootstrap & Init
#
#PREFERRED_PROVIDER_task-bootstrap = "task-bootstrap"
require conf/distro/include/sane-srcdates.inc
#
#
# Ensure consistency across all SlugOS builds for the provider of a
# relational database - use the latest version of the SleepyCat
# Berkeley database
PREFERRED_PROVIDER_virtual/db = "db"
PREFERRED_PROVIDER_virtual/db-native = "db-native"

CMDLINE_DEBUG = "noirqdebug"
```
