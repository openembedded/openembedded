## conf/distro/minimal-uclibc.conf
```bitbake
#-----------------------------------------------------------------------------
#@TYPE: Distribution
#@NAME: Minimal uClibc
#@DESCRIPTION: uClibc based Embedded Linux Distribution Configuration (minimal)
#
#@COMMENT: This distribution configuration serves as a starting point for
#@COMMENT: the integration of new target platforms, machines, or distributions.
#@COMMENT: It bases on conservative settings and should always be buildable.
#-----------------------------------------------------------------------------

#
# Header
#
DISTRO_NAME = "minimal-uclibc"

TARGET_FPU_arm = "soft"
TARGET_FPU_armeb = "soft"

LIBC = "uclibc"

require conf/distro/minimal.conf

# NOTE:
#
# We get the DISTRO_FEATURES defined in minimal.conf here but
# however there are some features like mips -mplt support which
# is not supported on uclibc yet so we need to disable that
# feature for uclibc based distributions, therefore we redefine
# the DISTRO_FEATURES for minimal-uclibc and notably leave mplt
# out. Make sure that if there is a new DISTRO_FEATURE thats added
# to minimal.conf will not get included in minimal-uclibc.conf
# it has to be added to the below selection if it should also be
# enabled for minimal-uclibc

# FEATURE SELECTION
#############################################################################
# We want images supporting the following features (for task-base)
DISTRO_FEATURES = "nfs smbfs wifi ppp alsa ext2 vfat pcmcia usbgadget usbhost pci"
# Following features are for ARM and E500 based machines
DISTRO_FEATURES += "eabi"
```

## conf/distro/minimal.conf
```bitbake
#############################################################################
#@TYPE: Distribution
#@NAME: Minimal
#@DESCRIPTION: Embedded Linux Distribution Configuration
#
#@COMMENT: This distribution configuration can serve as a starting point for
#@COMMENT: the integration of new target platforms, machines, or distributions.
#############################################################################

#############################################################################
# NAME and VERSION
#############################################################################
DISTRO_NAME ?= "minimal"
DISTRO_VERSION = "dev-snapshot-${SRCDATE}"
#DISTRO_TYPE = "release"
DISTRO_TYPE ?= "debug"

# Ensure some form of release config, so error out if someone thinks he knows better
DISTRO_CHECK := "${@bb.data.getVar('DISTRO_VERSION',d,1) or bb.fatal('Remove this line or set a dummy DISTRO_VERSION')}"

#############################################################################
# FEATURE SELECTION
#############################################################################
# Use bluetooth 4.0
DISTRO_BLUETOOTH_MANAGER            = "bluez4"
PREFERRED_PROVIDER_bluez-utils-dbus = "bluez4"
PREFERRED_PROVIDER_bluez-libs       = "bluez4"
PREFERRED_PROVIDER_bluez-utils      = "bluez4"

# We want images supporting the following features (for task-base)
DISTRO_FEATURES = "ipv4 ipv6 nfs smbfs wifi ppp alsa ext2 vfat pcmcia usbgadget usbhost pci"
# Following features are for ARM and E500 based machines
DISTRO_FEATURES += "eabi"

# The following feature enables the MIPS ABI PLT extensions
# This feature needs GCC 4.4 binutils 2.19 or glibc/eglibc 2.9
# or higher

DISTRO_FEATURES += "mplt"
DISTRO_FEATURES += ' ${@["", "thumb-interwork"][bb.data.getVar('THUMB_INTERWORK', d, 1) == "yes"]}'

#############################################################################
# LIBRARY NAMES
#############################################################################
# libfoo -> libfoo0-2 (etc)
INHERIT += "debian"

#############################################################################
# PACKAGING & FEEDS
#############################################################################
# Chose the packaging system
INHERIT += "package_ipk"
IMAGE_FSTYPES ?= "tar.gz jffs2"
PREFERRED_PKG_FORMAT ?= "ipk"

# Put links to sources in deploy/sources to make it easier for people to be GPL compliant
INHERIT += "src_distribute_local"
SRC_DIST_LOCAL ?= "symlink"

# If we're using an .ipk based rootfs, we want to have opkg installed so postinst script can run
IPKG_VARIANT = "opkg"

#############################################################################
# IMAGES
#############################################################################
# Name the generated images in a sane way
IMAGE_NAME = "${DISTRO_NAME}-${IMAGE_BASENAME}-${LIBC}-${PREFERRED_PKG_FORMAT}-${DISTRO_VERSION}-${MACHINE}"
CACHE = "${TMPDIR}/cache/${LIBC}/${MACHINE}"
DEPLOY_DIR ?= "${TMPDIR}/deploy/${LIBC}"
DEPLOY_DIR_IMAGE = "${DEPLOY_DIR}/images/${MACHINE}"
SPLASH ?= '${@base_contains("MACHINE_FEATURES", "screen", "psplash", "",d)}'
PREFERRED_PROVIDER_virtual/psplash = "psplash"

# increase inode/block ratio for ext2 filesystem
EXTRA_IMAGECMD_ext2 = "-i 8192"

#############################################################################
# KERNEL
#############################################################################
KERNEL = "kernel26"
MACHINE_KERNEL_VERSION = "2.6"

#############################################################################
# Ensure MACHINE_CLASS is in OVERRIDES
#############################################################################
MACHINE_CLASS ?= ""
MACHINE_OVERRIDES += "${MACHINE_CLASS}"

#############################################################################
# TOOLCHAIN
#############################################################################
LIBC ?= "eglibc"
require conf/distro/include/sane-toolchain.inc
require conf/distro/include/arm-thumb.inc

#############################################################################
# QA
#############################################################################

#run QA tests on builds and packages and log them  
INHERIT += "insane"
QA_LOG = "1"

#run QA tests on recipes
INHERIT += "recipe_sanity"

#make devshell available as task
INHERIT += "devshell"

#############################################################################
# PREFERRED VERSIONS
#############################################################################
require conf/distro/include/preferred-e-versions.inc
require conf/distro/include/preferred-opie-versions-1.2.5.inc

PREFERRED_PROVIDER_opkg ?= "opkg"
PREFERRED_PROVIDER_virtual/update-alternatives ?= "opkg"
PREFERRED_QT_VERSION ?= "4.7.1"
PREFERRED_VERSION_qt4-tools-native = "${PREFERRED_QT_VERSION}"
PREFERRED_VERSION_qt4-tools-sdk = "${PREFERRED_QT_VERSION}"
PREFERRED_VERSION_qt4-embedded = "${PREFERRED_QT_VERSION}"
PREFERRED_VERSION_qt4-embedded-gles = "${PREFERRED_QT_VERSION}"
PREFERRED_VERSION_qt4-x11-free = "${PREFERRED_QT_VERSION}"
PREFERRED_VERSION_qt4-x11-free-gles = "${PREFERRED_QT_VERSION}"
#############################################################################
# CONTENTS
#############################################################################

# Ship extra debug utils in the rootfs when doing a debug build
DISTRO_EXTRA_APPS ?= ""
DISTRO_EXTRA_APPS += '${@base_conditional("DISTRO_TYPE", "release", "", "task-cli-tools-debug",d)}'

# Additional content I (only valid if you include task-base)
# distro-feed-configs: configuration files for the online feeds
# util-linux-ng-mount util-linux-ng-umount: busybox mount is broken
# angstrom-libc-fixup-hack: fixes an obscure bug with libc.so symlink
DISTRO_EXTRA_RDEPENDS += "\
  distro-feed-configs \
  util-linux-ng-mount util-linux-ng-umount \
  angstrom-libc-fixup-hack \
  ${DISTRO_EXTRA_APPS} \
"

# Additional content II (can be masked with BAD_RECOMMENDATIONS)
DISTRO_EXTRA_RRECOMMENDS += " \
    kernel-module-vfat \
    kernel-module-ext2 \
    kernel-module-ext3 \
    kernel-module-af-packet \
    avahi-daemon \
    avahi-autoipd \
    openssh-sftp-server \
"
```

## conf/distro/mokoslug.conf
```bitbake
#@--------------------------------------------------------------------
#@TYPE: Distribution
#@NAME: MokoSlug <http://www.nslu2-linux.org>
#@DESCRIPTION: The Linux Server companion for OpenMoko phones
#@MAINTAINER: Rod Whitby <rod@whitby.id.au>
#@--------------------------------------------------------------------

# MokoSlug is based on Angstrom, and would hopefully just be done by features one day ...
require conf/distro/angstrom-2007.1.conf

DISTRO = "mokoslug"
DISTRO_NAME = "MokoSlug"
DISTRO_VERSION = "1.0-alpha"
DISTRO_REVISION = "1"
DISTRO_TYPE = "debug"

MACHINE_FEATURES_append_nslu2 = " bluetooth"

# No room for debug apps in 8MB.
DEBUG_APPS = ""

INHERIT += "nslu2-image"
```

## conf/distro/nslu2-btu.conf
```bitbake
#@TYPE: Distribution
#@NAME: NSLU2-BTU
#@DESCRIPTION: Linux Distribution for the NSLU2

# This is not the official DISTRO, so leave the DISTRO parameters unchanged
# from the defaults in nslu2-dist.conf.  Set the build configuration options
# to b,t,u
NSLU2_ARCH_TYPE = "b"
NSLU2_INSTRUCTION_SET = "t"
NSLU2_OS = "u"

include conf/distro/nslu2-dist.conf
```
