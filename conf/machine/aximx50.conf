## conf/machine/aximx50.conf
```bitbake
#@TYPE: Machine
#@NAME: Axim x50/x51
#@DESCRIPTION: Machine configuration for the Dell Axim x50/x51 with a pxa27x CPU

#
# Hardware-based properties
#
TARGET_ARCH = "arm"
PACKAGE_EXTRA_ARCHS = " iwmmxt "

# Use tune-xscale per default. Machine independent feeds should be built with tune-strongarm.
require conf/machine/include/tune-xscale.inc

# Uncomment this to use iwmmxt optimizations. Remove the above xscale stuff first
#require conf/machine/include/tune-iwmmxt.inc

ROOT_FLASH_SIZE = "256"
VOLATILE_STORAGE_SIZE = "64"
MACHINE_GUI_CLASS ?= "smallscreen"
MACHINE_DISPLAY_WIDTH_PIXELS ?= "240"
MACHINE_DISPLAY_HEIGHT_PIXELS ?= "320"
MACHINE_FEATURES = "kernel26 touchscreen apm alsa pcmcia bluetooth irda wifi usbgadget screen"

#
# Software/packages selection
#
PREFERRED_PROVIDER_virtual/kernel = "linux-handhelds-2.6"
PCMCIA_MANAGER = "pcmciautils"
MODUTILS = "26"	
PREFERRED_PROVIDER_xserver = "xserver-kdrive"

PREFERRED_VERSION_orinoco-modules = "0.15rc1"

MACHINE_EXTRA_RDEPENDS = "tiinit acx-firmware"
MACHINE_EXTRA_RRECOMMENDS = "\
				kernel-module-i2c-pxa"

#
# Modules autoload and other boot properties
#
module_autoload_evdev = "evdev"
module_autoload_mmc_block = "mmc_block"
module_autoload_pxa27x_udc = "pxa27x_udc"

#FIXME: this should be controlled by a userspace utility later.
module_autoload_g_ether = "g_ether"

SERIAL_CONSOLE = "115200 ttyS0"
```

## conf/machine/aximx50v.conf
```bitbake
#@TYPE: Machine
#@NAME: Axim x50v/x51v
#@DESCRIPTION: Machine configuration for the Dell Axim x50v/x51v with a pxa27x CPU

require conf/machine/aximx50.conf

MACHINE_GUI_CLASS = "bigscreen"
MACHINE_DISPLAY_WIDTH_PIXELS = "480"
MACHINE_DISPLAY_HEIGHT_PIXELS = "640"
```

## conf/machine/babbage.conf
```bitbake
#@TYPE: Machine
#@NAME: Freescale i.MX51 Babbage
#@DESCRIPTION: Machine configuration for the Babbage board
#@URL: http://www.freescale.com/webapp/sps/site/prod_summary.jsp?code=i.MX515
TARGET_ARCH = "arm"

PREFERRED_PROVIDER_virtual/xserver = "xserver-xorg"
XSERVER = "xserver-xorg \
           xf86-input-evdev \
           xf86-input-mouse \
           xf86-input-keyboard \
           xf86-input-tslib \
           xf86-video-fbdev"

# Only has DVI connector for external screen
GUI_MACHINE_CLASS = "bigscreen"

require conf/machine/include/imx51.inc

PREFERRED_PROVIDER_virtual/kernel = "linux"
PREFFERED_PROVIDER_virtual/bootloader = "u-boot"

UBOOT_MACHINE = "mx51_bbg_config"

IMAGE_FSTYPES += "tar.bz2 ubi"
EXTRA_IMAGECMD_jffs2 = "-lnp "

SERIAL_CONSOLE = "115200 ttymxc0"

MACHINE_FEATURES = "kernel26 screen apm usbhost vfat alsa touchscreen"

# The board expects the bootloader to be at offset 0x400 of SD-CARd in the bottom slot.
# The generated u-boot.bin is zero-padded from offset 0x000 to offset 0x400.
#
# You may flash it using a command like :
#	# dd if=/u-boot.bin of=/dev/sdX
#
# Alternatively, if you want to keep your partition table intact, you can use
# something like :
#	# dd if=/u-boot.bin of=/dev/sdX bs=512 seek=2 skip=2
#
# Note that both of these commands will destroy any filesystem present on the
# sectors u-boot will be written. Please Consider creating your partition
# table accordingly.
```

## conf/machine/bd-neon.conf
```bitbake
#@TYPE: Machine
#@NAME: Boundary Devices NEON
#@DESCRIPTION: Machine configuration for the Boundary Devices NEON board

#
# Hardware-based properties
#
TARGET_ARCH = "arm"

# Use tune-xscale per default. Machine independent feeds should be built with tune-strongarm.
require conf/machine/include/tune-xscale.inc

# Uncomment this to use iwmmxt optimizations. Remove the above xscale stuff first
#require conf/machine/include/tune-iwmmxt.inc

ROOT_FLASH_SIZE = "60"
VOLATILE_STORAGE_SIZE = "128"
GUI_MACHINE_CLASS = "bigscreen"
MACHINE_FEATURES = "kernel26 touchscreen apm alsa usbgadget screen uboot"

#
# Software/packages selection
#
PREFERRED_PROVIDER_virtual/kernel = "linux"
PERFERRED_VERSION_linux = "2.6.22"
KERNEL_IMAGETYPE = "uImage"
UBOOT_ENTRYPOINT = "a0008000"

MODUTILS = "26"	
XSERVER = "xserver-kdrive-fbdev"

PREFERRED_VERSION_u-boot = "1.1.2"

EXTRA_IMAGEDEPENDS =" mtd-utils"

MACHINE_EXTRA_RDEPENDS = " mtd-utils"
MACHINE_EXTRA_RRECOMMENDS = " kernel-modules kernel-module-nls-cp437 \
				kernel-module-nls-iso8859-1 \
				kernel-module-nls-utf8 \
				kernel-module-af-key \
				kernel-module-i2c-pxa"

IMAGE_FSTYPES ?= "jffs2"
EXTRA_IMAGECMD_jffs2 = "--little-endian --eraseblock=0x20000 -n"
EXTRA_IMAGECMD_jffs2 = "--little-endian --eraseblock=0x40000 --pad=32243712; sumtool -i ${DEPLOY_DIR_IMAGE}/${IMAGE_NAME}.rootfs.jffs2 \
			  -o ${DEPLOY_DIR_IMAGE}/${IMAGE_NAME}.rootfs-summary.jffs2 \
			  -e 128KiB -p"

#
# Modules autoload and other boot properties
#
module_autoload_evdev = "evdev"
module_autoload_mmc_block = "mmc_block"
module_autoload_snd-pcm-oss = "snd-pcm-oss"
module_autoload_snd-mixer-oss = "snd-mixer-oss"

#module_autoload_g_ether = "g_ether"

SERIAL_CONSOLE = "115200 ttyS0"
```

## conf/machine/beagle.conf
```bitbake
#@TYPE: Machine
#@NAME: MasterIA PA100
#@DESCRIPTION: Machine configuration for the SA1100 based MasterIA PA-100 device

TARGET_ARCH = "arm"
IPKG_ARCHS = "all arm ${MACHINE}"
PREFERRED_PROVIDER_xserver = "xserver-kdrive"
PREFERRED_PROVIDER_virtual/kernel = "montavista-sa"
BOOTSTRAP_EXTRA_DEPENDS = "virtual/kernel modutils hostap-modules orinoco-modules "
BOOTSTRAP_EXTRA_RDEPENDS = " kernel-module-net-fd \
kernel-module-sa1100-bi kernel-module-usbdcore kernel-module-usbdmonitor \
kernel-module-pcnet-cs kernel-module-8390 kernel-module-unix  \
kernel-module-sa1100-ir kernel-module-irlan kernel-module-irnet \
kernel-module-usb-eth kernel-module-sa1100usb-core \
kernel-module-ppp-generic kernel-module-ppp-async kernel-module-mtdchar \
kernel-module-fat kernel-module-vfat \
kernel-module-ircomm kernel-module-ircomm-tty \
kernel-module-serial kernel-module-slhc "
BOOTSTRAP_EXTRA_RRECOMMENDS = "hostap-modules-cs "


EXTRA_IMAGECMD_jffs2 = "--pad=0xec0000 --little-endian --eraseblock=0x40000"
EXTRA_IMAGEDEPENDS = "cetools-native"

IMAGE_CMD_jffs2 = "mkfs.jffs2 --root=${IMAGE_ROOTFS} --faketime \
                   --output=${T}/${IMAGE_NAME}.rootfs.jffs2 \
                   ${EXTRA_IMAGECMD}; bin2rom ${T}/${IMAGE_NAME}.rootfs.jffs2 \
                   ${DEPLOY_DIR_IMAGE}/${IMAGE_NAME}.rootfs.img \
                   ffffffff ffffffff d0140000"

include conf/machine/tune-strongarm.conf


SERIAL_CONSOLE = "115200 ttySA0"



# Configuration bits for "generic handheld" from handhelds-common.conf
HANDHELD_MODULES_COPY = "ipv6 \
ipsec \
nvrd \
mip6-mn \
tun \
ide-cs ide-disk \
loop \
vfat ext2 \
sunrpc nfs \
btuart-cs dtl1-cs bt3c-cs rfcomm bnep l2cap sco hci_uart \
pcnet-cs serial-cs \
af_packet \
ppp-async ppp-deflate ppp-mppe \
ip-gre ip-tables ipip \
irda irlan irnet irport irtty \
input uinput \
"


BOOTSTRAP_EXTRA_DEPENDS     += "pcmcia-cs apmd ppp wireless-tools irda-utils"
BOOTSTRAP_EXTRA_RDEPENDS    += "pcmcia-cs apm irda-utils"
BOOTSTRAP_EXTRA_RRECOMMENDS += "ppp wireless-tools ${@linux_module_packages('${HANDHELD_MODULES_COPY}', d)}"

INHERIT += "linux_modules"
```

## conf/machine/beagleboard.conf
```bitbake
#@TYPE: Machine
#@NAME: Beagleboard machine
#@DESCRIPTION: Machine configuration for the http://beagleboard.org/ board 
TARGET_ARCH = "arm"

PREFERRED_PROVIDER_virtual/xserver = "xserver-xorg"
XSERVER = "xserver-xorg \
           xf86-input-evdev \
           xf86-input-mouse \
           xf86-video-omapfb \
           xf86-input-keyboard"

# Only has DVI connector for external screen
GUI_MACHINE_CLASS = "bigscreen"

#Ship all kernel modules till the board support has matured enough
MACHINE_EXTRA_RRECOMMENDS = " kernel-modules"

#include conf/machine/include/tune-arm1136jf-s.inc
# requires gcc 4.3.0:
include conf/machine/include/tune-cortexa8.inc


IMAGE_FSTYPES += "tar.bz2 jffs2"
EXTRA_IMAGECMD_jffs2 = "-lnp "

# Guesswork
SERIAL_CONSOLE = "115200 ttyS2"

# No kernel recipe yet
PREFERRED_PROVIDER_virtual/kernel = "linux-omap2"

KERNEL_IMAGETYPE = "uImage"

UBOOT_ENTRYPOINT = "0x80008000"
UBOOT_LOADADDRESS = "0x80008000"
UBOOT_MACHINE = "omap3_beagle_config"


PREFERRED_VERSION_u-boot = "git"
EXTRA_IMAGEDEPENDS += "u-boot x-load"

# and sdio
MACHINE_FEATURES = "kernel26 screen apm usbgadget usbhost vfat alsa"
```

## conf/machine/ben-nanonote.conf
```bitbake
#@TYPE: Machine
#@NAME: Ben Nanonote
#@DESCRIPTION: Machine configuration for the Qi-Hardware's Ben Nanonote

TARGET_ARCH = "mipsel"
require conf/machine/include/tune-mips32.inc

PREFERRED_PROVIDER_virtual/kernel = "linux-jlime-ben-nanonote"

# With 2.6.37 there is not yet uImage target (pending patches)
#KERNEL_IMAGETYPE = "uImage"
KERNEL_IMAGETYPE = "vmlinux.bin"

IMAGE_FSTYPES ?= "jffs2"

PREFERRED_PROVIDER_virtual/xserver = "xserver-kdrive"
PREFERRED_VERSION_xserver-kdrive = "1.3.0.0"

XSERVER = "xserver-kdrive-fbdev"

#ScreenInfo
MACHINE_GUI_CLASS = "smallscreen"
MACHINE_DISPLAY_WIDTH_PIXELS = "320"
MACHINE_DISPLAY_HEIGHT_PIXELS = "240"
LOGO_SIZE = "qvga"

##################################
# build kexecboot kernel while
# making sure rootfs is compatible
##################################

# require conf/machine/include/initramfs-kexecboot.inc
```

## conf/machine/blueangel.conf
```bitbake
#@TYPE: Machine
#@NAME: HTC Blueangel
#@DESCRIPTION: Machine configuration for the HTC Blueangel device

KERNEL ?= "kernel26"

OVERRIDES =. "${KERNEL}:"

TARGET_ARCH = "arm"
IPKG_EXTRA_ARCHS = "armv4 armv4t armv5e armv5te ipaqpxa"
PREFERRED_PROVIDER_xserver = "xserver-kdrive"
PREFERRED_PROVIDER_virtual/kernel_kernel26 = "xanadux-ba-2.6"
PREFERRED_PROVIDER_virtual/kernel = "xanadux-ba-2.6"

BOOTSTRAP_EXTRA_RDEPENDS = "kernel ipaq-boot-params ${@linux_module_packages('${BA_MODULES}', d)}"
BOOTSTRAP_EXTRA_RDEPENDS_append_kernel26 = " udev module-init-tools"

BA_MODULES_kernel26 = " evdev tsdev himalaya_tsc2200 himalaya_ts3 asic3_mmc mmc_core g_ether blueangel_battery \
                        pcmcia-core hci_uart blueangel_pcmcia snd-mixer-oss blueangel_audio blueangel_rom blueangel_kp"
# pxa2xx_udc is built in to the kernel

module_autoload_evdev             = "evdev"
module_autoload_himalaya_tsc2200  = "himalaya_tsc2200"
module_autoload_himalaya_ts3      = "himalaya_ts3"
module_autoload_asic3_mmc         = "asic3_mmc"
module_autoload_g_ether           = "g_ether"
module_autoload_blueangel_kp      = "blueangel_kp"
module_autoload_pxa2xx_udc        = "pxa2xx_udc"
module_autoload_blueangel_audio   = "blueangel_audio"
module_autoload_bluenagel_leds    = "bleangel_leds"
module_autoload_hci_uart          = "hci_uart"
module_autoload_snd-mixer-oss     = "snd-mixer-oss"
module_autoload_snd-pcm-oss       = "snd-pcm-oss"

SERIAL_CONSOLE = "115200 tts/2 vt100"

USE_VT = "0"

include conf/machine/include/handheld-common.conf

GUI_MACHINE_CLASS = "smallscreen"
ROOT_FLASH_SIZE = "32"

# optimize images, but build feeds without using tune-xscale so as to retain backwards compatibility
include conf/machine/include/tune-xscale.conf
```

## conf/machine/bluepro.conf
```bitbake
#@TYPE: Machine
#@NAME: TQ Components' BluePro
#@DESCRIPTION: Blue IPC Series

TARGET_ARCH = "powerpc"
PACKAGE_EXTRA_ARCHS = "ppc"

MACHINE_FEATURES                = "kernel26 usbhost ext2"
MACHINE_TASK_PROVIDER           = "task-base"
MACHINE_EXTRA_RRECOMMENDS       = "u-boot-utils iproute2 canutils"

USE_DEVFS = "0"

PREFERRED_PROVIDER_virtual/kernel = "linux"
#PREFERRED_VERSION_linux = "2.6.32"
PREFERRED_VERSION_linux-libc-headers = "2.6.32"

# don't try to access tty1 (used for application code)
USE_VT = "0"

SERIAL_CONSOLE = "115200 ttyPSC0"
KERNEL_DEVICETREE_tb5200l = "arch/${ARCH}/boot/dts/tqm5200.dts"
EXTRA_IMAGECMD_jffs2 = "--big-endian -e 0x20000"

# BluePro carries kernel in separate flash partition
ROOTFS_POSTPROCESS_COMMAND += "rm -f ${IMAGE_ROOTFS}/boot/*Image*;"

require conf/machine/include/tune-ppc603e.inc
```

## conf/machine/boc01.conf
```bitbake
#@TYPE: Machine
#@Name: Bolloré telecom CPE v01
#@DESCRIPTION: Machine configuration for the Bolloré telecom CPE v01

TARGET_ARCH = "powerpc"

PREFERRED_PROVIDER_virtual/kernel ?= "linux"

MACHINE_FEATURES = "kernel26 usbhost pci ext2 uboot"

KERNEL_IMAGETYPE = "uImage"

PREFERRED_VERSION_u-boot = "1.3.2"
UBOOT_MACHINE = "MPC8313ERDB_33_config"
UBOOT_ENTRYPOINT = "0"
UBOOT_LOADADDRESS = "0"

#rootfs on NAND flash
EXTRA_IMAGECMD_jffs2 = "--pad --big-endian --eraseblock=0x20000 --no-cleanmarkers"

#don't try to access tty1
USE_VT = "0"

SERIAL_CONSOLE = "115200 ttyS0"

#tune for the e300c3 core
require conf/machine/include/tune-ppce300c3.inc
```

## conf/machine/borzoi.conf
```bitbake
WARNING:="${@bb.fatal('\n*\n*\n*    Sorry, There is no dedicated configuration for the Sharp SL-C3100,\n*    because \
its very similar to the SL-C3000. Use MACHINE = \"spitz\".\n*\n*\n')}"
```

## conf/machine/boxer.conf
```bitbake
WARNING:="${@bb.fatal('\n*\n*\n*    Sorry, There is no dedicated configuration for the Sharp SL-C860,\n*    because \
it really is just a Sharp SL-C760 with a different case color. Use MACHINE = \"c7x0\".\n*\n*\n')}"
```

## conf/machine/bug.conf
```bitbake
#@TYPE: Machine
#@NAME: Bug Labs BUG Computer
#@DESCRIPTION: Machine configuration for the BUG base unit.
TARGET_ARCH = "arm"

MACHINE_EXTRA_RRECOMMENDS = "marvell-gspi-fw marvell-sdio-fw kernel-modules"
PREFERRED_PROVIDER_virtual/kernel = "linux-bug"

MACHINE_FEATURES = "kernel26 screen touchscreen hotplug alsa wifi usbhost usbgadget"
SERIAL_CONSOLE = "-L 115200 ttymxc4"

CPU_FEATURES += "vfp"

require conf/machine/include/tune-arm1136jf-s.inc

KERNEL_IMAGETYPE = "uImage"

MACHINE_DISPLAY_WIDTH_PIXELS = "320"
MACHINE_DISPLAY_HEIGHT_PIXELS = "240"

PREFERRED_PROVIDER_virtual/xserver = "xserver-xorg"
XSERVER = "xserver-xorg \
           xf86-input-evdev \
           xf86-input-tslib \
           xf86-input-mouse \
           xf86-video-fbdev \
           xf86-input-keyboard"
```

## conf/machine/bug20.conf
```bitbake
#@TYPE: Machine
#@NAME: BUG 2.0
#@DESCRIPTION: Machine configuration for the BUG 2.0 board (OMAP3530 based)
TARGET_ARCH = "arm"

PREFERRED_PROVIDER_virtual/xserver = "xserver-xorg"
XSERVER = "xserver-xorg \
           xserver-xorg-extension-dri \
           xserver-xorg-extension-glx \
           xf86-input-evdev \
           xf86-input-tslib \
           xf86-input-mouse \
           xf86-video-omapfb \
           xf86-input-keyboard"

MACHINE_EXTRA_RRECOMMENDS = "marvell-gspi-fw marvell-sdio-fw kernel-modules"

# Only has DVI connector for external screen
GUI_MACHINE_CLASS = "bigscreen"

require conf/machine/include/omap3.inc

PREFERRED_PROVIDER_virtual/kernel = "linux-omap-hah"

IMAGE_FSTYPES += "tar.bz2 ubi"
EXTRA_IMAGECMD_jffs2 = "-lnp "

SERIAL_CONSOLE = "115200 ttyS2"

UBOOT_MACHINE = "omap3_bug_config"

# do ubiattach /dev/ubi_ctrl -m 4
# From dmesg:
# UBI: smallest flash I/O unit:    2048
# UBI: logical eraseblock size:    129024 bytes
# from ubiattach stdout:
# UBI device number 0, total 1996 LEBs
MKUBIFS_ARGS = "-m 2048 -e 129024 -c 1996"

# do ubiattach /dev/ubi_ctrl -m 4
# from dmesg:
# UBI: smallest flash I/O unit:    2048
# UBI: physical eraseblock size:   131072 bytes (128 KiB)
# UBI: sub-page size:              512
UBINIZE_ARGS = "-m 2048 -p 128KiB -s 512"

PREFERRED_VERSION_u-boot = "git"

# and sdio
MACHINE_FEATURES = "kernel26 screen apm usbgadget usbhost vfat alsa wifi bluetooth"

# We don't provide a bug20 x-load config yet
XLOAD_MACHINE = "omap3530beagle_config"
```

## conf/machine/c6a814x-evm.conf
```bitbake
#@TYPE: Machine
#@NAME: c6a814x evm
#@DESCRIPTION: Machine configuration for the c6a814x evm

require conf/machine/include/ti814x.inc
```

## conf/machine/c6a816x-evm.conf
```bitbake
#@TYPE: Machine
#@NAME: c6a816x evm
#@DESCRIPTION: Machine configuration for the c6a816x evm

require conf/machine/include/ti816x.inc
```
