## conf/machine/c7x0.conf
```bitbake
#@TYPE: Machine
#@NAME: Sharp Zaurus SL-C7x0
#@DESCRIPTION: Machine configuration for the Sharp Zaurus SL-C700, Sharp Zaurus SL-C750, Sharp Zaurus SL-C760, Sharp Zaurus SL-C860 devices

require conf/machine/include/zaurus-2.6.inc
require conf/machine/include/zaurus-clamshell.inc

# NAND factory-default
# SL-C700 (corgi) mtdparts=sharpsl-nand:7168k@0k(smf),25600k@7168k(root),-(home)
# SL-C750 (Shepherd) mtdparts=sharpsl-nand:7168k@0k(smf),25600k@7168k(root),-(home)
# SL-C760 (Husky) mtdparts=sharpsl-nand:7168k@0k(smf),54272k@7168k(root),-(home)
# SL-C860 (Boxer) mtdparts=sharpsl-nand:7168k@0k(smf),54272k@7168k(root),-(home)

# There isn't an unique size valid for all models,
# please set the right value in your local.conf
ROOT_FLASH_SIZE = "25"

MACHINE_GUI_CLASS = "bigscreen"
MACHINE_DISPLAY_WIDTH_PIXELS = "640"
MACHINE_DISPLAY_HEIGHT_PIXELS = "480"
MACHINE_DISPLAY_ORIENTATION = "0"
MACHINE_DISPLAY_PPI = "216"

UBOOT_MACHINE = "corgi_config"
UBOOT_ENTRYPOINT = "0xA0008000"
UBOOT_LOADADDRESS = "${UBOOT_ENTRYPOINT}"
```

## conf/machine/calamari.conf
```bitbake
#@TYPE: Machine
#@Name: Freescale MPC8536DS Calamari
#@DESCRIPTION: Machine configuration for the Freescale MPC8536DS Calamari Development System

# Development board with 1.5 GHz dual-issue PowerPC SoC with MMU/FPU and PCI,
# 3x PCI Express up to x8, 2x SATA.

TARGET_ARCH = "powerpc"

PREFERRED_PROVIDER_virtual/kernel ?= "linux"

MACHINE_FEATURES = "kernel26 usbhost pci ext2 uboot"

KERNEL_IMAGETYPE = "uImage"

PREFERRED_VERSION_u-boot ?= "git"
UBOOT_MACHINE = "MPC8536DS_config"
UBOOT_ENTRYPOINT = "0"
UBOOT_LOADADDRESS = "0"

#rootfs on NAND flash
EXTRA_IMAGECMD_jffs2 = "--pad --big-endian --eraseblock=0x4000 --no-cleanmarkers"

#don't try to access tty1
USE_VT = "0"

SERIAL_CONSOLE = "115200 ttyS0"

#tune for the e500v2 core
require conf/machine/include/tune-ppce500v2.inc
```

## conf/machine/canyonlands.conf
```bitbake
# Copyright (C) 2008, Leon Woestenberg, Sidebranch, All Rights Reserved
# Released under the MIT license (see packages/COPYING)
#@TYPE: Machine
#@Name: AMCC Canyonlands Development Platform
#@DESCRIPTION: Machine configuration for the AMCC Canyonlands development platform http://www.amcc.com/Embedded/Downloads/460EX/


TARGET_ARCH = "powerpc"
PACKAGE_EXTRA_ARCHS = "ppc440e"

PREFERRED_PROVIDER_virtual/kernel = "linux"
KERNEL_IMAGETYPE = "uImage"

MACHINE_FEATURES = "kernel26 usbhost"

PREFERRED_VERSION_u-boot = "1.3.2"
UBOOT_MACHINE = "canyonlands_config"
UBOOT_ENTRYPOINT = "0"
UBOOT_LOADADDRESS = "0"



#don't try to access tty1
USE_VT = "0"
SERIAL_CONSOLE = "115200 ttyS0"

EXTRA_IMAGECMD = "--big-endian"
ERASEBLOCK_SIZE = "0x10000"
IMAGE_FSTYPES = "jffs2"

#tune for the AMCC460 cpu
#(it has a 440 core with FPU)
require conf/machine/include/tune-ppc440e.inc
```

## conf/machine/chumby-falconwing.conf
```bitbake
#@TYPE: Machine
#@Name: chumby Falconwing i.MX233-based boards
#@DESCRIPTION: Machine configuration for chumby Falconwing platform

TARGET_ARCH = "arm"

MACHINE_GUI_CLASS = "smallscreen"
MACHINE_DISPLAY_WIDTH_PIXELS = "320"
MACHINE_DISPLAY_HEIGHT_PIXELS = "240"

PREFERRED_PROVIDER_virtual/kernel = "linux-imx"
PREFERRED_PROVIDER_virtual/bootloader = "bootstream-chumby-falconwing"

require conf/machine/include/tune-arm926ejs.inc

# used by sysvinit_2
SERIAL_CONSOLE = "115200 ttyAM0"

ROOT_FLASH_SIZE = "128"

MACHINE_FEATURES = "kernel26 usbhost touchscreen ext2 ext3 vfat keyboard alsa"
IMAGE_FSTYPES = "ext3.gz tar.gz"
```

## conf/machine/chumby.conf
```bitbake
#@TYPE: Machine
#@Name: Chumby
#@DESCRIPTION: Machine configuration for the Chumby

TARGET_ARCH = "arm"

MACHINE_FEATURES = "kernel26 apm alsa bluetooth ext2 vfat touchscreen usbhost usbgadget wifi"

GUI_MACHINE_CLASS = "smallscreen"

PREFERRED_PROVIDER_virtual/kernel = "${MACHINE}-kernel"

MACHINE_EXTRA_RRECOMMENDS = "\
  kernel-modules \
  rt73-k2wrlz \
"

require conf/machine/include/tune-arm926ejs.inc

# used by sysvinit_2
SERIAL_CONSOLE = "38400 ttyS0"

# used by opie-collections.inc
ROOT_FLASH_SIZE = "22"

# extra jffs2 tweaks
EXTRA_IMAGECMD_jffs2 = "--little-endian --eraseblock=0x4000 --pad -n"

IMAGE_FSTYPES += "cramfs"
```

## conf/machine/cm-t35.conf
```bitbake
#@TYPE: Machine
#@NAME: CM-T35 machine
#@DESCRIPTION: Machine configuration for the CompuLab CM-T35 board (http://www.compulab.co.il/t3530/html/t3530-cm-datasheet.htm)

TARGET_ARCH = "arm"

PREFERRED_PROVIDER_virtual/xserver = "xserver-xorg"
XSERVER = "xserver-xorg \
           xf86-input-evdev \
           xf86-input-mouse \
	   xf86-input-evtouch \
	   xf86-input-tslib \
           xf86-video-omapfb \
           xf86-input-keyboard"

GUI_MACHINE_CLASS = "bigscreen"

require conf/machine/include/omap3.inc

IMAGE_FSTYPES += "tar.bz2 ubi"
EXTRA_IMAGECMD_jffs2 = "-lnp "

# Guesswork
SERIAL_CONSOLE = "115200 ttyS2"

UBOOT_MACHINE = "cm_t35_config"
PREFERRED_VERSION_u-boot = "git"

# do ubiattach /dev/ubi_ctrl -m 4
# From dmesg:
# UBI: smallest flash I/O unit:    2048
# UBI: logical eraseblock size:    126976 bytes
# from ubiattach stdout:
# UBI device number 0, total 4039 LEBs
MKUBIFS_ARGS = "-m 2048 -e 126976 -c 4039"

# do ubiattach /dev/ubi_ctrl -m 4
# from dmesg:
# UBI: smallest flash I/O unit:    2048
# UBI: physical eraseblock size:   131072 bytes (128 KiB)
# UBI: sub-page size:              512
UBINIZE_ARGS = "-O 2048 -m 2048 -p 128KiB"

MACHINE_EXTRA_RRECOMMENDS = "marvell-sdio-fw"
MACHINE_FEATURES = "kernel26 screen apm usbgadget usbhost vfat alsa wifi ext2"
```

## conf/machine/cm-x300.conf
```bitbake
#@TYPE: Machine
#@NAME: Compulab CM-X300
#@DESCRIPTION: Machine configuration for the Compulab CM-X300 (http://www.compulab.co.il/x300/html/x300-cm-datasheet.htm)

TARGET_ARCH = "arm"

PREFERRED_PROVIDER_virtual/kernel = "linux"

KERNEL_IMAGETYPE = "uImage"
UBOOT_ENTRYPOINT = "A0008000"

require conf/machine/include/tune-xscale.inc
PACKAGE_EXTRA_ARCHS = "armv5te iwmmxt"

CMX300_CONSOLE_SERIAL_PORT ?= "ttyS2"
SERIAL_CONSOLE ?= "38400 ${CMX300_CONSOLE_SERIAL_PORT}"

CMDLINE_cm-x300 = "ubi.mtd=5 root=ubi0:cm-x300-rootfs rootfstype=ubifs console=${CMX300_CONSOLE_SERIAL_PORT},38400"

IMAGE_FSTYPES += "ubi"

# do ubiattach /dev/ubi_ctrl -m 4
# From dmesg:
# UBI: smallest flash I/O unit:    2048
# UBI: logical eraseblock size:    126976 bytes
# from ubiattach stdout:
# UBI device number 0, total 4095 LEBs
MKUBIFS_ARGS = "-m 2048 -e 126976 -c 4095"

# do ubiattach /dev/ubi_ctrl -m 4
# from dmesg:
# UBI: smallest flash I/O unit:    2048
# UBI: physical eraseblock size:   131072 bytes (128 KiB)
UBINIZE_ARGS = "-m 2048 -p 128KiB "

MACHINE_EXTRA_RRECOMMENDS = "marvell-sdio-fw"
MACHINE_FEATURES = "kernel26 touchscreen alsa bluetooth wifi usbhost usbgadget screen serial vfat iwmmxt"
```

## conf/machine/colinux.conf
```bitbake
#@TYPE: Machine
#@NAME: Cooperative Linux
#@DESCRIPTION: Machine configuration for Cooperative Linux running on an x86 compatible PC

TARGET_ARCH = "i686"
IPKG_ARCHS = "all i686 i386 x86 ${MACHINE}"
PREFERRED_PROVIDER_virtual/kernel = "linux-colinux"
BOOTSTRAP_EXTRA_RDEPENDS = "kernel kernel-modules"
```
