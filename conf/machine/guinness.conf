## conf/machine/guinness.conf
```bitbake
#@TYPE: Machine
#@NAME: Guinness
#@DESCRIPTION: Machine configuration for Linux running on a tyan 2462 mainboard (codenamed guinness)

# i386 doesn't work with NTPL, see http://ecos.sourceware.org/ml/libc-ports/2006-03/msg00030.html
TARGET_ARCH = "i686"

IPKG_EXTRA_ARCHS = "x86 i386 i486 i586"
PREFERRED_PROVIDER_virtual/kernel = "linux-x86"

# todo: convert to task-base
BOOTSTRAP_EXTRA_RDEPENDS = "kernel pciutils udev kernel-modules"

udevdir = "/dev"

OLDEST_KERNEL = "2.6.17"
GLIBC_ADDONS = "nptl"
GLIBC_EXTRA_OECONF = "--with-tls"

MACHINE_FEATURES = "kernel26 usbhost ext2"

require conf/machine/include/tune-athlonmp.conf
```

## conf/machine/gumstix-connex.conf
```bitbake
require conf/machine/include/gumstix.inc

RDEPENDS_kernel-base = ""

MACHINE_FEATURES += " usbgadget "

GUMSTIX_400MHZ = "y"
```

## conf/machine/gumstix-custom-verdex.conf
```bitbake
#
# Use this file as a starting point for your custom gumstix configuration
# Edit it to reflect your hardware setup and then save it a parallel location in user.collection

MACHINE_FEATURES += "verdex"
MACHINE_FEATURES += "iwmmxt"
require conf/machine/include/gumstix.inc

#
# Your flash size = Total flash (in MB) - 1 (for linux kernel partition)
ROOT_FLASH_SIZE = "15"
#ROOT_FLASH_SIZE = "31"

#
# Enable use of virtual terminal for LCD on tty1 if USE_VT = "1"
#USE_VT = "0"
USE_VT = "1"
SYSVINIT_ENABLED_GETTYS = "1"

#
# Uncomment features that your board set supports

MACHINE_FEATURES += "usbhost"
#MACHINE_FEATURES += "usbgadget"

MACHINE_FEATURES  += "i2c"
#MACHINE_FEATURES  += "spi"

MACHINE_FEATURES  += "serial"
MACHINE_FEATURES  += "bluetooth"
MACHINE_FEATURES  += "sound"

# if you enable robostix you will need to disable both "lcd" and "touchscreen" features
#MACHINE_FEATURES  += "robostix"

MACHINE_FEATURES  += "lcd"
#MACHINE_FEATURES  += "rgb16"
MACHINE_FEATURES  += "rgb18"

MACHINE_FEATURES  += "touchscreen"
MACHINE_FEATURES  += "keyboard"

MACHINE_FEATURES  += "pcmcia"
MACHINE_FEATURES  += "mmc"

MACHINE_FEATURES  += "wifi"
MACHINE_FEATURES  += "ethernet"

MACHINE_FEATURES  += "ext2"
MACHINE_FEATURES  += "fat"

# enable one of the following if you want to target build for uimage/rootfs on mmc/microSD or CF
#MACHINE_FEATURES  += "mmcroot"
#MACHINE_FEATURES  += "cfroot"

#
# note:  selection of MACHINE_FEATURES above will automatically include necessary kernel modules
# for those features via task-base-gumstix.  Include below any extra kernel modules that you want installed

#MACHINE_ESSENTIAL_EXTRA_RRECOMMENDS += "kernel-module-xxxxxxx"

#
# Uncomment or add kernel modules that should be autoloaded

module_autoload_proc_gpio      = 'proc_gpio'

module_autoload_pcmcia         = ${@base_contains('MACHINE_FEATURES', 'pcmcia',     'pcmcia', '',d)}
module_autoload_pxa2xx_cs      = ${@base_contains('MACHINE_FEATURES', 'pcmcia',     'pxa2xx_cs', '',d)}

module_autoload_pxamci         = ${@base_contains('MACHINE_FEATURES', 'mmc',        'pxamci', '',d)}
module_autoload_mmc_block      = ${@base_contains('MACHINE_FEATURES', 'mmc',        'mmc_block', '',d)}

module_autoload_ethernet       = ${@base_contains('MACHINE_FEATURES', 'ethernet',   'ethernet', '',d)}

module_autoload_ohci-hcd       = ${@base_contains('MACHINE_FEATURES', 'usbhost',    'ohci-hcd', '',d)}

module_autoload_gumstix_gadget = ${@base_contains('MACHINE_FEATURES', 'usbgadget',  'gumstix_gadget', '',d)}
#module_autoload_g_file_storage = ${@base_contains('MACHINE_FEATURES', 'usbgadget',  'g_file_storage', '',d)}
module_autoload_g_ether        = ${@base_contains('MACHINE_FEATURES', 'usbgadget',  'g_ether', '',d)}
#module_autoload_g_serial       = ${@base_contains('MACHINE_FEATURES', 'usbgadget',  'g_serial', '',d)}

module_autoload_tsc2003        = ${@base_contains('MACHINE_FEATURES', 'touchscreen','tsc2003', '',d)}
module_autoload_ucb1400-ts     = ${@base_contains('MACHINE_FEATURES', 'touchscreen','ucb1400-ts', '',d)}
module_autoload_evdev          = ${@base_contains('MACHINE_FEATURES', 'touchscreen','evdev', '',d)}
```

## conf/machine/gumstix-verdex.conf
```bitbake
require conf/machine/include/gumstix.inc

RDEPENDS_kernel-base = ""

PACKAGE_EXTRA_ARCHS += " iwmmxt "

MACHINE_FEATURES += " usbhost "
```

## conf/machine/gumstix.conf
```bitbake
#@TYPE: Machine
#@Name: Gumstix pxa2xx boards
#@DESCRIPTION:  Gumstix pxa2xx boards

TARGET_ARCH = "arm"
PACKAGE_EXTRA_ARCHS = "armv4 armv4t armv5e armv5te "

PREFERRED_PROVIDER_virtual/kernel = "linux-gumstix"

OLDEST_KERNEL = "2.6.15"

#Assume people have some gumstix extension boards 
MACHINE_FEATURES = "kernel26 alsa ext2 usbhost usbgadget bluetooth"

EXTRA_IMAGECMD_jffs2 = "--little-endian --eraseblock=0x20000 --squash"

GUMSTIX_400MHZ = "y"

# used by sysvinit_2
SERIAL_CONSOLE = "115200 ttyS0 vt100"

#don't try to access tty1
USE_VT = "0"

require conf/machine/include/tune-xscale.conf
```

## conf/machine/h1910.conf
```bitbake
#@TYPE: Machine
#@NAME: HP iPAQ H1910/H1915
#@DESCRIPTION: Machine configuration for the HP iPAQ H1910/H1915

#
# Hardware-based properties
#
TARGET_ARCH = "arm"

require conf/machine/include/tune-xscale.inc

VOLATILE_STORAGE_SIZE = "64"
ROOT_FLASH_SIZE = "16"
MACHINE_GUI_CLASS = "smallscreen"
MACHINE_DISPLAY_WIDTH_PIXELS = "240"
MACHINE_DISPLAY_HEIGHT_PIXELS = "320"
MACHINE_FEATURES = "kernel26 touchscreen apm alsa irda usbgadget screen vfat"

#
# Software/packages selection
#
PREFERRED_PROVIDER_virtual/kernel = "linux-handhelds-2.6"
PCMCIA_MANAGER = "pcmciautils"
PREFERRED_PROVIDER_xserver = "xserver-kdrive"

EXTRA_IMAGECMD_h1910_jffs2 = "-e 0x4000 -p -n"

#
# Modules autoload and other boot properties
#
SERIAL_CONSOLE = "115200 ttyS0 vt100"
```

## conf/machine/h1940.conf
```bitbake
#@TYPE: Machine
#@NAME: h1940
#@DESCRIPTION: Machine configuration for the HP iPAQ h1930 and h1940

TARGET_ARCH = "arm"

# Set preferred providers
PREFERRED_PROVIDER_xserver = "xserver-kdrive"
PREFERRED_PROVIDER_virtual/kernel = "linux-h1940"

# Set features for task-base
MACHINE_GUI_CLASS = "smallscreen"
MACHINE_DISPLAY_WIDTH_PIXELS = "240"
MACHINE_DISPLAY_HEIGHT_PIXELS = "320"
MACHINE_FEATURES = "kernel26 touchscreen apm bluetooth irda usbgadget screen vfat"


# Some extra configuration
VOLATILE_STORAGE_SIZE = "64"
ROOT_FLASH_SIZE = "32"
SERIAL_CONSOLE = "115200 ttySAC2 vt100"
USE_VT = "0"

# tune for armv4t
require conf/machine/include/tune-arm920t.inc
```

## conf/machine/h2200.conf
```bitbake
#@TYPE: Machine
#@NAME: HP iPAQ h22xx
#@DESCRIPTION: Machine configuration for the HP iPAQ h22xx

#
# Hardware-based properties
#
TARGET_ARCH = "arm"

#Compile with armv5te optimizations, incompatible with armv4(t) cpus
require conf/machine/include/tune-xscale.inc

#Set some hints for metadata  
VOLATILE_STORAGE_SIZE = "64"
ROOT_FLASH_SIZE = "32"
MACHINE_GUI_CLASS = "smallscreen"
MACHINE_DISPLAY_WIDTH_PIXELS = "240"
MACHINE_DISPLAY_HEIGHT_PIXELS = "320"
MACHINE_FEATURES = "kernel26 touchscreen apm alsa pcmcia bluetooth irda usbgadget screen vfat"

#
# Software/packages selection
#
PCMCIA_MANAGER = "pcmciautils"
PREFERRED_PROVIDER_xserver = "xserver-kdrive"
PREFERRED_PROVIDER_virtual/kernel = "linux-handhelds-2.6"

MACHINE_ESSENTIAL_EXTRA_RDEPENDS = " h2200-bootloader "
MACHINE_EXTRA_RDEPENDS = " udev-hostap-cs-vcc-workaround "
MACHINE_EXTRA_RRECOMMENDS = "\
    kernel-module-snd-h2200-audio \
    kernel-module-i2c-pxa \
    "

EXTRA_IMAGECMD_jffs2 = "--pad --eraseblock=0x4000"

#
# Modules autoload and other boot properties
#
module_autoload_snd-pcm-oss 	= "snd-pcm-oss"
module_autoload_snd-mixer-oss = "snd-mixer-oss"
module_autoload_snd-h2200-audio = "snd-h2200-audio"
module_autoload_g_ether = "g_ether"

SERIAL_CONSOLE = "115200 ttyS0 vt100"
USE_VT = "0"

require conf/machine/include/LAB-settings.inc
```

## conf/machine/h3600.conf
```bitbake
#@TYPE: Machine
#@NAME: Compaq iPAQ 36xx,Compaq iPAQ 37xx,Compaq iPAQ 38xx
#@DESCRIPTION: Machine configuration for the Compaq iPAQ 36xx, Compaq iPAQ 37xx and Compaq iPAQ 38xx devices

#
# Hardware-based properties
#
TARGET_ARCH = "arm"
PACKAGE_EXTRA_ARCHS = "armv4 "

require conf/machine/include/tune-strongarm.inc

# h3700, h3800 have 32, but let that be the bonus
ROOT_FLASH_SIZE = "16"
# h3630 have 32Mb only
VOLATILE_STORAGE_SIZE = "64"
MACHINE_GUI_CLASS = "smallscreen"
MACHINE_DISPLAY_WIDTH_PIXELS = "240"
MACHINE_DISPLAY_HEIGHT_PIXELS = "320"
MACHINE_FEATURES = "kernel26 touchscreen apm alsa irda usbgadget screen vfat"

#
# Software/packages selection
#
PREFERRED_PROVIDER_virtual/kernel = "linux-handhelds-2.6"
PCMCIA_MANAGER = "pcmciautils"
PREFERRED_PROVIDER_xserver = "xserver-kdrive"

MACHINE_EXTRA_RDEPENDS = "ipaq-boot-params"
MACHINE_EXTRA_RRECOMMENDS = "\
                             kernel-module-micro"

EXTRA_IMAGECMD_jffs2 = "-e 0x40000 -p ; echo '${IMAGE_NAME}  ${IMAGE_NAME}.rootfs.jffs2 - root' >> ${DEPLOY_DIR_IMAGE}/reflash.ctl"

#
# Modules autoload and other boot properties
#
SERIAL_CONSOLE = "115200 ttySA0 vt100"
USE_VT = "0"
```

## conf/machine/h3800.conf
```bitbake
#@TYPE: Machine
#@NAME: Compaq iPAQ 38xx
#@DESCRIPTION: Machine configuration for the Compaq iPAQ 38xx devices

#this machine will be primarily focussed on the 2.6 port
MACHINE_FEATURES = "kernel26 touchscreen apm alsa pcmcia bluetooth irda usbgadget screen vfat"

require conf/machine/h3600.conf
```

## conf/machine/h3900.conf
```bitbake
#@TYPE: Machine
#@NAME: HP iPAQ h39xx
#@DESCRIPTION: Machine configuration for the HP iPAQ h39xx

#
# Hardware-based properties
#
TARGET_ARCH = "arm"

require conf/machine/include/tune-xscale.inc

ROOT_FLASH_SIZE = "32"
VOLATILE_STORAGE_SIZE = "64"
MACHINE_GUI_CLASS = "smallscreen"
MACHINE_DISPLAY_WIDTH_PIXELS = "240"
MACHINE_DISPLAY_HEIGHT_PIXELS = "320"
MACHINE_FEATURES = "kernel26 touchscreen apm alsa irda bluetooth usbgadget screen vfat"

#
# Software/packages selection
#
PREFERRED_PROVIDER_virtual/kernel = "linux-handhelds-2.6"
PCMCIA_MANAGER = "pcmciautils"
PREFERRED_PROVIDER_xserver = "xserver-kdrive"

MACHINE_EXTRA_RDEPENDS = "kernel ipaq-boot-params"

#
# Modules autoload and other boot properties
#
module_autoload_snd-pcm-oss = "snd-pcm-oss"
module_autoload_g_ether = "g_ether"

SERIAL_CONSOLE = "115200 ttyS0 vt100"
USE_VT = "0"

require conf/machine/include/LAB-settings.inc
```

## conf/machine/h4000.conf
```bitbake
#@TYPE: Machine
#@NAME: HP iPAQ h4xxx
#@DESCRIPTION: Machine configuration for the HP iPAQ h4xxx

#
# Hardware-based properties
#
TARGET_ARCH = "arm"

require conf/machine/include/tune-xscale.inc

ROOT_FLASH_SIZE = "32"
VOLATILE_STORAGE_SIZE = "64"
MACHINE_GUI_CLASS = "smallscreen"
MACHINE_DISPLAY_WIDTH_PIXELS = "240"
MACHINE_DISPLAY_HEIGHT_PIXELS = "320"
MACHINE_FEATURES = "kernel26 touchscreen apm alsa irda bluetooth wifi usbgadget screen vfat"

#
# Software/packages selection
#
PREFERRED_PROVIDER_virtual/kernel = "linux-handhelds-2.6"
PCMCIA_MANAGER = "pcmciautils"
PREFERRED_PROVIDER_xserver = "xserver-kdrive"

MACHINE_EXTRA_RDEPENDS = "tiinit acx-firmware ${PCMCIA_MANAGER}"
MACHINE_EXTRA_RRECOMMENDS = "kernel-module-snd-h4000-audio \
                             kernel-module-i2c-pxa \
			     kernel-module-h4000-bt \
                             kernel-module-h4000-pcmcia \
                             kernel-module-acx \
                            "

#
# Modules autoload and other boot properties
#
module_autoload_snd-pcm-oss = "snd-pcm-oss"
module_autoload_snd-mixer-oss = "snd-mixer-oss"
module_autoload_snd-h4000-audio = "snd-h4000-audio"
module_autoload_g_ether = "g_ether"
module_conf_acx = "blacklist acx"

SERIAL_CONSOLE = "115200 ttyS0 vt100"
USE_VT = "0"

require conf/machine/include/LAB-settings.inc
```

## conf/machine/h5000.conf
```bitbake
#@TYPE: Machine
#@NAME: Compaq iPAQ 51xx, Compaq iPAQ 54xx, Compaq iPAQ 55xx
#@DESCRIPTION: Machine configuration for the Compaq iPAQ 51xx, Compaq iPAQ 54xx, and Compaq iPAQ 55xx devices

#
# Hardware-based properties
#
TARGET_ARCH = "arm"

require conf/machine/include/tune-xscale.inc

ROOT_FLASH_SIZE = "32"
VOLATILE_STORAGE_SIZE = "64"
MACHINE_GUI_CLASS = "smallscreen"
MACHINE_DISPLAY_WIDTH_PIXELS = "240"
MACHINE_DISPLAY_HEIGHT_PIXELS = "320"
MACHINE_FEATURES = "kernel26 touchscreen apm alsa pcmcia bluetooth irda wifi usbgadget usbhost screen vfat"

#
# Software/packages selection
#
PREFERRED_PROVIDER_virtual/kernel = "linux-handhelds-2.6"
PREFERRED_PROVIDER_xserver = "xserver-kdrive"
EXTRA_IMAGECMD_jffs2 = "-e 0x40000 -p ; echo '${IMAGE_NAME}  ${IMAGE_NAME}.rootfs.jffs2 - root' >> ${DEPLOY_DIR_IMAGE}/reflash.ctl"

# Ship complete set of modules ('kernel-modules') for easier debug purposes 
MACHINE_EXTRA_RDEPENDS = "kernel ipaq-boot-params"
MACHINE_EXTRA_RRECOMMENDS = " kernel-modules \
                              kernel-module-h5400-lcd \
			      kernel-module-h5400-battery \
			      kernel-module-h5400-bt \
			      kernel-module-snd-soc-h5000 \
			      kernel-module-i2c-pxa \
			      at76c503a-modules"

#
# Modules autoload and other boot properties
#
module_autoload_snd-pcm-oss = "snd-pcm-oss"
module_autoload_snd-mixer-oss = "snd-mixer-oss"
module_autoload_snd-soc-h5000 = "snd-soc-h5000"
module_autoload_g_ether = "g_ether"

SERIAL_CONSOLE = "115200 ttyS0 vt100"
USE_VT = "0"
```

## conf/machine/h5xxx.conf
```bitbake
#@TYPE: Machine
#@NAME: Compaq iPAQ 51xx, Compaq iPAQ 54xx, Compaq iPAQ 55xx
#@DESCRIPTION: Machine configuration for the Compaq iPAQ 51xx, Compaq iPAQ 54xx, and Compaq iPAQ 55xx devices

#
# Hardware-based properties
#
TARGET_ARCH = "arm"
IPKG_EXTRA_ARCHS = "armv4 armv4t armv5e armv5te ipaqpxa"

require conf/machine/include/tune-xscale.conf

ROOT_FLASH_SIZE = "32"
VOLATILE_STORAGE_SIZE = "64"
GUI_MACHINE_CLASS = "smallscreen"
MACHINE_FEATURES = "kernel26 touchscreen apm alsa pcmcia bluetooth irda wifi usbgadget usbhost"

#
# Software/packages selection
#
PREFERRED_PROVIDER_virtual/kernel = "handhelds-pxa-2.6"
PREFERRED_PROVIDER_xserver = "xserver-kdrive"
EXTRA_IMAGECMD_h5xxx_jffs2 = "-e 0x40000 -p"

MACHINE_EXTRA_RDEPENDS = "kernel ipaq-boot-params"
MACHINE_EXTRA_RRECOMMENDS = " kernel-module-h5400_lcd \
			      kernel-module-h5400_battery"

#
# Modules autoload and other boot properties
#
SERIAL_CONSOLE = "115200 tts/0 vt100"
USE_VT = "0"
```

## conf/machine/h6300.conf
```bitbake
#@TYPE: Machine
#@NAME: OMAP1510 cpu on iPAQ h6315, h6340 and h6365
#@DESCRIPTION: Machine configuration for the OMAP1510 based HP iPAQ h6300 series devices.

#
# Hardware-based properties
#
TARGET_ARCH = "arm"
BASE_PACKAGE_ARCH = "arm"

#Use OMAP 1510 cpu specifig arm9tdmi options for gcc
require conf/machine/include/tune-arm9tdmi.inc

MACHINE_GUI_CLASS = "smallscreen"
MACHINE_DISPLAY_WIDTH_PIXELS = "240"
MACHINE_DISPLAY_HEIGHT_PIXELS = "320"
MACHINE_FEATURES = "kernel26 touchscreen apm alsa irda bluetooth wifi usbgadget screen vfat"

#
# Software/packages selection
#
PREFERRED_PROVIDER_virtual/kernel = "linux-h6300-omap1"
PREFERRED_PROVIDER_xserver = "xserver-kdrive"

MACHINE_EXTRA_RRECOMMENDS = "kernel-module-omapts \
                             kernel-module-omap-keypad \
                             kernel-module-h6300-bt"

EXTRA_IMAGECMD_jffs2 = "--pad --little-endian --eraseblock=0x40000"

#
# Modules autoload and other boot properties
#
module_autoload_omapts = "omapts"
module_autoload_omap-keypad = "omap-keypad"
module_autoload_hci_uart = "hci_uart"
module_autoload_h6300_bt = "h6300_bt"
module_autoload_l2cap = "l2cap"
#common alsa sound modules
module_autoload_snd-omap-alsa-tsc2101 = "snd-omap-alsa-tsc2101"
module_autoload_snd-pcm-oss = "snd-pcm-oss"
module_autoload_snd-mixer-oss = "snd-mixer-oss"

SERIAL_CONSOLE = "115200 ttyS0"
```
