## conf/machine/haleakala.conf
```bitbake
#@TYPE: Machine
#@Name: AMCC Haleakala (405EXr)
#@DESCRIPTION: Machine configuration for the AMCC Haleakala (405EXr)

TARGET_ARCH = "powerpc"
PACKAGE_EXTRA_ARCHS = "ppc405"

PREFERRED_PROVIDER_virtual/kernel = "linux"

MACHINE_FEATURES = "kernel26"

KERNEL_IMAGETYPE = "uImage"

PREFERRED_VERSION_u-boot = "1.3.2"
UBOOT_MACHINE = "kilauea_config"

SERIAL_CONSOLE = "115200 ttyS0"

#tune for the 405 cpu
require conf/machine/include/tune-ppc405.inc
```

## conf/machine/handheld-common.conf
```bitbake
HANDHELD_MODULES = "ipv6 \
ipsec \
nvrd \
mip6-mn \
tun \
ide-cs ide-disk ide-probe-mod \
loop \
vfat ext2 \
sunrpc nfs \
btuart-cs dtl1-cs bt3c-cs rfcomm bnep l2cap sco hci_uart \
pcnet-cs serial-cs airo-cs \
af_packet \
ppp-async ppp-deflate ppp-mppe \
ip-gre ip-tables ipip \
irda irlan irnet irport irtty ircomm-tty \
input uinput \
"

PREFERRED_PROVIDER_virtual/pcmcia-manager ?= "pcmcia-cs"

# Configuration bits for "generic handheld"
BOOTSTRAP_EXTRA_DEPENDS += "virtual/pcmcia-manager apmd ppp wireless-tools irda-utils openswan wpa-supplicant-nossl lrzsz ppp-dialin network-suspend-scripts"
BOOTSTRAP_EXTRA_RDEPENDS +=  "virtual/pcmcia-manager apm apmd network-suspend-scripts"
BOOTSTRAP_EXTRA_RRECOMMENDS += "ppp wireless-tools irda-utils openswan wpa-supplicant-nossl lrzsz ppp-dialin ${@linux_module_packages('${HANDHELD_MODULES}', d)}"

INHERIT += "linux_modules"
```

## conf/machine/hawkboard.conf
```bitbake
#@TYPE: Machine
#@NAME: OMAP-L138 based board
#@DESCRIPTION: Machine configuration for the TI Hawkboard

require conf/machine/include/davinci.inc
require conf/machine/include/omapl138.inc

UBOOT_MACHINE = "da850_omapl138_evm_config"
UBOOT_ENTRYPOINT = "0xc0008000"
UBOOT_LOADADDRESS = "0xc0008000"

MACHINE_FEATURES = "kernel26 serial ethernet ide screen"

# do ubiattach /dev/ubi_ctrl -m 4
# From dmesg:
# UBI: smallest flash I/O unit:    2048
# UBI: logical eraseblock size:    129024 bytes
# from ubiattach stdout:
# UBI device number 0, total 960 LEBs
MKUBIFS_ARGS = "-m 2048 -e 129024 -c 960"

# do ubiattach /dev/ubi_ctrl -m 4
# from dmesg:
# UBI: smallest flash I/O unit:    2048
# UBI: physical eraseblock size:   131072 bytes (128 KiB)
# UBI: sub-page size:              512
UBINIZE_ARGS = "-m 2048 -p 128KiB -s 512"

SERIAL_CONSOLE = "115200 ttyS2"
```

## conf/machine/hentges-2.0_common.conf
```bitbake
#! /bin/sh
#
# Copyright Matthias Hentges <devel@hentges.net> (c) 2007
# License: MIT (see http://www.opensource.org/licenses/mit-license.php 
#               for a copy of the license)
#
# Filename: hentges-2.0_common.conf
# Date: 20070521 (YMD)

DESCRIPTION = "Hentges common dependency description"
MAINTAINER = "Matthias 'CoreDump' Hentges <oe@hentges.net>"
LICENSE = "MIT"

######################################################################################

HENTGES_BASE_DEPENDS = "task-base-wifi"
HENTGES_BASE_RDEPENDS = "task-base-wifi"

######################################################################################

# Handled via task-base:

DISTRO_SSH_DAEMON ?= "dropbear"

######################################################################################

# Handled via task-base:

DISTRO_EXTRA_RDEPENDS = "\
    update-modules \
    ${@base_contains("MACHINE_FEATURES", "screen", "psplash", "",d)} \   
    angstrom-version \
    ipkg ipkg-collateral \
    util-linux-mount util-linux-umount \
    ${EXTRA_STUFF} \
    ${DEBUG_APPS} \
    "
    
HENTGES_X11_DEPENDS += "angstrom-x11-base-depends \
			angstrom-gpe-task-base"
```

## conf/machine/hentges-2.0_spitz.conf
```bitbake
#! /bin/sh
#
# Copyright Matthias Hentges <devel@hentges.net> (c) 2007
# License: MIT (see http://www.opensource.org/licenses/mit-license.php 
#               for a copy of the license)
#
# Filename: hentges-2.0_spitz.conf
# Date: 20070521 (YMD)

DESCRIPTION = "Hentges dependency description for Spitz aka SL-C3x00"
MAINTAINER = "Matthias 'CoreDump' Hentges <oe@hentges.net>"
HOMEPAGE = "<homepage>"
LICENSE = "MIT"

######################################################################################

DISTRO_SSH_DAEMON_spitz = "openssh"

XSERVER = "xserver-kdrive-fbdev"

######################################################################################

HENTGES_BASE_RDEPENDS += "tar bash"

######################################################################################

# In the future I plan to replace the angstrom-*task* stuff with custom
# hentges tasks, replacing the angstrom defaults where needed

HENTGES_X11_RDEPENDS += "${XSERVER} \
			angstrom-gpe-task-pim \
			angstrom-ohand-task-pim \
			angstrom-gpe-task-settings \
			angstrom-gpe-task-apps \
			angstrom-gpe-task-games \
			angstrom-task-office \
			angstrom-task-printing \
			angstrom-task-sectest \
			firefox gftp"
```

## conf/machine/hipox.conf
```bitbake
#@TYPE: Machine
#@NAME: OXE810 based HydraIP device
#@DESCRIPTION: Machine configuration for DResearch OXE810 based HydraIP device

TARGET_ARCH = "arm"

MACHINE_FEATURES = "kernel26 ext2 pci usbhost ethernet serial raid uboot"

SERIAL_CONSOLE = "115200 ttyS1"

PREFERRED_PROVIDER_virtual/kernel = "linux"

KERNEL_IMAGETYPE = "uImage"

PREFERRED_VERSION_u-boot = "2009.03"
UBOOT_LOADADDRESS = "0x48008000"
UBOOT_ENTRYPOINT = "0x48008000"
UBOOT_ARCH = "arm"

require conf/machine/include/tune-arm926ejs.inc
```

## conf/machine/htcapache.conf
```bitbake
#@TYPE: Machine
#@NAME: HTC Apache
#@DESCRIPTION: Machine configuration for the HTC Apache

#
# Hardware-based properties
#
TARGET_ARCH = "arm"

require conf/machine/include/tune-xscale.inc

ROOT_FLASH_SIZE = "32"
VOLATILE_STORAGE_SIZE = "64"
MACHINE_GUI_CLASS = "smallscreen"
MACHINE_DISPLAY_WIDTH_PIXELS = "240"
MACHINE_DISPLAY_HEIGHT_PIXELS = "320"
MACHINE_FEATURES = "kernel26 touchscreen apm alsa pcmcia irda bluetooth usbgadget screen vfat phone"

#
# Software/packages selection
#
PREFERRED_PROVIDER_virtual/kernel = "linux-handhelds-2.6"
PCMCIA_MANAGER = "pcmciautils"
PREFERRED_PROVIDER_xserver = "xserver-kdrive"


#
# Modules autoload and other boot properties
#
module_autoload_g_ether = "g_ether"

SERIAL_CONSOLE = "115200 ttyS0 vt100"
USE_VT = "0"

require conf/machine/include/LAB-settings.inc
```

## conf/machine/htcblackstone.conf
```bitbake
#@TYPE: Machine
#@NAME: HTC Blackstone
#@DESCRIPTION: Machine configuration for HTC Blackstone smartphone (aka HTC Touch HD)

require conf/machine/include/htc-msm7.inc

MACHINE_DISPLAY_WIDTH_PIXELS = "480"
MACHINE_DISPLAY_HEIGHT_PIXELS = "800"

MACHINE_FEATURES = "kernel26 touchscreen screen phone gps usb keyboard"
```

## conf/machine/htcblueangel.conf
```bitbake
#@TYPE: Machine
#@NAME: HTC Blueangel
#@DESCRIPTION: Machine configuration for the HTC Blueangel device

#
# Hardware-based properties
#
TARGET_ARCH = "arm"

require conf/machine/include/tune-xscale.inc

ROOT_FLASH_SIZE = "32"
VOLATILE_STORAGE_SIZE = "128"
MACHINE_GUI_CLASS = "smallscreen"
MACHINE_DISPLAY_WIDTH_PIXELS = "240"
MACHINE_DISPLAY_HEIGHT_PIXELS = "320"
MACHINE_FEATURES = "kernel26 touchscreen apm alsa irda bluetooth wifi usbgadget screen vfat phone"

#
# Software/packages selection
#
PREFERRED_PROVIDER_virtual/kernel = "linux-handhelds-2.6"
PCMCIA_MANAGER = "pcmciautils"
PREFERRED_PROVIDER_xserver = "xserver-kdrive"

MACHINE_EXTRA_RDEPENDS = "acx-firmware ${PCMCIA_MANAGER}"
MACHINE_EXTRA_RRECOMMENDS = "kernel-module-blueangel_pcmcia \
			     kernel-module-blueangel_audio \
			     kernel-module-blueangel_rom \
			     kernel-module-blueangel_kp \
			     kernel-module-blueangel_battery \
			     kernel-module-blueangel_leds \
			     kernel-module-himalaya_tsc2200 \
			     kernel-module-himalaya_ts3 \
			     kernel-module-asic3-mmc"
#
# Modules autoload and other boot properties
#
module_autoload_snd-pcm-oss = "snd-pcm-oss"
module_autoload_g_ether = "g_ether"
module_autoload_evdev             = "evdev"
module_autoload_himalaya_tsc2200  = "himalaya_tsc2200"
module_autoload_himalaya_ts3      = "himalaya_ts3"
module_autoload_asic3_mmc         = "asic3_mmc"
module_autoload_g_ether           = "g_ether"
module_autoload_blueangel_kp      = "blueangel_kp"
module_autoload_pxa2xx_udc        = "pxa2xx_udc"
module_autoload_blueangel_audio   = "blueangel_audio"
module_autoload_bluenagel_leds    = "bleangel_leds"
module_autoload_hci_uart          = "hci_uart"
module_autoload_snd-mixer-oss     = "snd-mixer-oss"
module_conf_acx = "blacklist acx"

SERIAL_CONSOLE = "115200 ttyS0 vt100"
USE_VT = "0"

require conf/machine/include/LAB-settings.inc
```

## conf/machine/htcdiamond.conf
```bitbake
#@TYPE: Machine
#@NAME: HTC Diamond
#@DESCRIPTION: Machine configuration for the HTC Diamond smartphone

require conf/machine/include/htc-msm7.inc

MACHINE_DISPLAY_WIDTH_PIXELS = "480"
MACHINE_DISPLAY_HEIGHT_PIXELS = "640"

MACHINE_FEATURES = "kernel26 touchscreen screen phone gps usb"
```
