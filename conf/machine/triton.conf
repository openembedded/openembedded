## conf/machine/triton.conf
```bitbake
#@TYPE: Machine
#@NAME: KARO Electronics TRITON Processor module
#@DESCRIPTION: Machine configuration for the XScale based triton boards from KaRo Electronics 

TARGET_ARCH = "arm"
PACKAGE_EXTRA_ARCHS = "armv4t armv5te"
PREFERRED_PROVIDER_virtual/kernel = "triton-kernel"

BOOTSTRAP_EXTRA_RDEPENDS = "virtual/kernel"

EXTRA_IMAGECMD_jffs2 = "--pad=0x1dc0000 --little-endian --eraseblock=0x40000 -n"
EXTRA_IMAGEDEPENDS = ""
SERIAL_CONSOLE = "38400 ttyS0"
KERNEL_CONSOLE = "ttys0,38400"
USE_VT = "0"

require conf/machine/include/tune-xscale.inc
```

## conf/machine/ts101.conf
```bitbake
#@TYPE: Machine configuration
#@Name: QNAP Turbostation TS-101
#@DESCRIPTION: Generic Machine configuration for QNAP TS-101

require conf/machine/include/tsppc.inc
```

## conf/machine/ts109.conf
```bitbake
#@NAME: ARM based QNAP TS-109

INHERIT += "ts109-image"
MACHINE_EXTRA_RDEPENDS                          = "u-boot-utils piccontrol"
# piccontrol was broken on uclibc

require conf/machine/include/orion.inc
```

## conf/machine/ts209.conf
```bitbake
#@NAME: ARM based QNAP TS-209

INHERIT += "ts209-image"
MACHINE_EXTRA_RDEPENDS          		= "u-boot-utils piccontrol"

require conf/machine/include/orion.inc
```

## conf/machine/ts72xx.conf
```bitbake
#@TYPE: Machine
#@Name: Technologic Systems TS-72xx SBC
#@DESCRIPTION: Machine configuration for Technologic Systems TS-72xx SBC

TARGET_ARCH = "arm"

PREFERRED_PROVIDER_virtual/kernel = "linux"
KERNEL_IMAGETYPE = "zImage"
IMAGE_FSTYPES ?= "tar.bz2 ubi"

MACHINE_FEATURES = "kernel26 ext2 usbhost usbgadget vfat"

SERIAL_CONSOLE = "115200 ttyAM0"
USE_VT = "0"

module_autoload_ohci-hcd = "ohci-hcd"
module_autoload_rtc-ep93xx = "rtc-ep93xx"
module_autoload_rtc-m48t86 = "rtc-m48t86"
module_autoload_ts72xx_sbcinfo = "ts72xx_sbcinfo"

# do ubiattach /dev/ubi_ctrl -m 1
# From dmesg:
# UBI: physical eraseblock size:   16384 bytes (16 KiB)
# UBI: logical eraseblock size:    15872 bytes
# UBI: smallest flash I/O unit:    512
# UBI: sub-page size:              256
# UBI: VID header offset:          256 (aligned 256)
# UBI: data offset:                512
# From ubiattach stdout:
# UBI device number 0, total 1856 LEBs
MKUBIFS_ARGS = "-m 512 -e 15872 -c 1856"
UBINIZE_ARGS = "-m 512 -p 16KiB -s 256 -O 256"

require conf/machine/include/tune-arm920t.inc
```

## conf/machine/tsx09.conf
```bitbake
#@NAME: ARM based QNAP TS-109 and TS-209

MACHINE_EXTRA_RDEPENDS                          = "u-boot-utils piccontrol"

require conf/machine/include/orion.inc
```

## conf/machine/turbostation.conf
```bitbake
TARGET_ARCH = "powerpc"
TARGET_OS = "linux"
TARGET_FPU = "hard"
PACKAGE_EXTRA_ARCHS = "ppc ppc603e"

INHERIT += "turbostation-image"

# terminal specs - console, but no other ports
SERIAL_CONSOLE="115200 console"
USE_VT="0"
MACHINE_EXTRA_RDEPENDS = "u-boot"
PREFERRED_VERSION_u-boot = "1.2.0"

MODUTILS=26
MACHINE_FEATURES = "kernel26 usbhost pci ext2 uboot"
UBOOT_MACHINE = "qnap_config"
PREFERRED_VERSION_u-boot = "1.2.0"

PREFERRED_PROVIDER_virtual/kernel = "linux-turbostation"

# We want udev support in the image
udevdir = "/dev"

IMAGE_FSTYPES = "jffs2"
EXTRA_IMAGECMD_jffs2 = "--big-endian --eraseblock=0x20000"
IMAGE_DEVICE_TABLES = "files/device_table-slugos.txt"

require conf/machine/include/tune-ppc603e.inc
```

## conf/machine/tx25.conf
```bitbake
#@TYPE: Machine
#@Name: KARO TX25 
#@DESCRIPTION: Machine configuration for Freescale i.MX25 based Karo TX25 + baseboard

TARGET_ARCH = "arm"

MACHINE_FEATURES = "kernel26 apm alsa ext2 pcmcia usbhost usbgadget screen camera"

GUI_MACHINE_CLASS = "bigscreen"

PREFERRED_PROVIDER_virtual/kernel = "linux"
PREFERRED_VERSION_linux = "2.6.29+2.6.30-rc4"
PREFERRED_PROVIDER_virtual/xserver = "xserver-kdrive"
XSERVER = "xserver-kdrive-fbdev"

require conf/machine/include/tune-arm926ejs.inc

# used by sysvinit_2
SERIAL_CONSOLE = "115200 ttymxc0"

ROOT_FLASH_SIZE = "128"

IMAGE_FSTYPES ?= "jffs2"

EXTRA_IMAGECMD_jffs2 = "--little-endian --eraseblock=0x20000 -n \
    --pad ; sumtool --eraseblock=0x20000 -n \
    --littleendian --pad \
    -i ${DEPLOY_DIR_IMAGE}/${IMAGE_NAME}.rootfs.jffs2 \
    -o ${DEPLOY_DIR_IMAGE}/${IMAGE_NAME}.rootfs.jffs2.summary"
```

## conf/machine/tx27.conf
```bitbake
#@TYPE: Machine
#@Name: KARO TX27 
#@DESCRIPTION: Machine configuration for Freescale i.MX27 based Karo TX27 + baseboard

TARGET_ARCH = "arm"

MACHINE_FEATURES = "kernel26 apm alsa ext2 pcmcia usbhost usbgadget screen camera"

GUI_MACHINE_CLASS = "bigscreen"

PREFERRED_PROVIDER_virtual/kernel = "linux"
PREFERRED_VERSION_linux = "2.6.28"

require conf/machine/include/tune-arm926ejs.inc

# used by sysvinit_2
SERIAL_CONSOLE = "115200 ttymxc0"

ROOT_FLASH_SIZE = "128"

IMAGE_FSTYPES ?= "jffs2"

EXTRA_IMAGECMD_jffs2 = "--little-endian --eraseblock=0x20000 \
    --pad ; sumtool --eraseblock=0x20000 \
    --littleendian --pad \
    -i ${DEPLOY_DIR_IMAGE}/${IMAGE_NAME}.rootfs.jffs2 \
    -o ${DEPLOY_DIR_IMAGE}/${IMAGE_NAME}.rootfs.jffs2.summary"
```

## conf/machine/visstrim_m10.conf
```bitbake
#@TYPE: Machine
#@Name: Vista Silicon Visstrim M10
#@DESCRIPTION: Machine configuration for Vista Silicon Visstrim M10

TARGET_ARCH = "arm"

KERNEL_IMAGETYPE = "uImage"
UBOOT_ENTRYPOINT = "0xa0010000"
UBOOT_LOADADDRESS = "0xa0010000"

IMAGE_FSTYPES = "tar.gz squashfs"

# Uncomment this for custom kernel from local git repository
#PREFERRED_PROVIDER_virtual/kernel = "linux-visstrim-m10"

PREFERRED_PROVIDER_virtual/kernel = "linux"

MACHINE_FEATURES = "kernel26 apm alsa ext2 pcmcia usbhost usbgadget"

require conf/machine/include/tune-arm926ejs.inc

#don't try to access tty1
USE_VT = "0"
# used by sysvinit_2
SERIAL_CONSOLE = "115200 ttymxc0"

# used by opie-collections.inc
ROOT_FLASH_SIZE = "32"
```

## conf/machine/vmware.conf
```bitbake
# Copyright (C) 2007, Florian Boor - based on x86.conf:
# Copyright (C) 2007, Stelios Koroneos - Digital OPSiS, All Rights Reserved
# Released under the MIT license (see packages/COPYING)
#@TYPE: Machine
#@NAME: VMWare
#@DESCRIPTION: Machine configuration for a VMWare virtual PC

TARGET_ARCH = "i686"
PACKAGE_EXTRA_ARCHS = "vmware"

PREFERRED_PROVIDER_virtual/kernel = "linux"
PREFERRED_PROVIDER_virtual/xserver = "xserver-kdrive"
XSERVER="xserver-kdrive-vesa"

KERNEL_IMAGETYPE = "bzImage"

MACHINE_EXTRA_RRECOMMENDS = " kernel-modules"
MACHINE_FEATURES = "kernel26 pci usbhost ext2 screen x86"

udevdir = "/dev"
OLDEST_KERNEL = "2.6.17"
GLIBC_ADDONS = "nptl"
GLIBC_EXTRA_OECONF = "--with-tls"

require conf/machine/include/pentiumpro.inc
```

## conf/machine/vmx25.conf
```bitbake
#@TYPE: Machine
#@Name: Voipac vmx25 module
#@DESCRIPTION: Machine configuration for Voipac vmx25 module & baseboard
#@Homepage: http://voipac.com/#X25-DKT-265

TARGET_ARCH = "arm"

PREFERRED_PROVIDER_virtual/bootloader = "barebox"
PREFERRED_PROVIDER_virtual/kernel = "linux"
PREFERRED_PROVIDER_virtual/xserver = "xserver-xorg"

MACHINE_FEATURES = "kernel26 alsa ext2 usbhost usbgadget touchscreen keyboard"

GUI_MACHINE_CLASS = "bigscreen"
XSERVER ?= "xserver-xorg \
           xf86-input-tslib \
           xf86-input-evdev \
           xf86-input-mouse \
           xf86-input-keyboard \
           xf86-video-fbdev \
"

# ubi fs args
UBI_VOLNAME = "rootfs-vmx25"
MKUBIFS_ARGS = "-m 2KiB -e 126KiB -c 989"
UBINIZE_ARGS = "-m 2KiB -p 128KiB -s 512"

IMAGE_FSTYPES += "tar.gz ubi"

require conf/machine/include/tune-arm926ejs.inc

# used by sysvinit_2
SERIAL_CONSOLE = "115200 ttymxc0"
```

## conf/machine/vortex86sx.conf
```bitbake
#@TYPE: Machine
#@NAME: Vortex86sx i486sx clone

require conf/machine/include/tune-i486sx.inc

MACHINE_FEATURES = "kernel26 alsa vfat screen usbhost x86"

KERNEL_IMAGETYPE = "bzImage"

SERIAL_CONSOLE = "115200 ttyS0"

PREFERRED_PROVIDER_virtual/kernel = "linux"

GLIBC_ADDONS = "nptl"
GLIBC_EXTRA_OECONF = "--with-tls"

PREFERRED_PROVIDER_virtual/xserver = "xserver-xorg"
XSERVER = "xserver-xorg \
           xf86-input-evdev \
           xf86-video-vesa \
	   xf86-video-sis"

# There is SIS graphics chipset on board (Z7) which is supported by
# xf86-video-sis driver but most of time it fails.
# VESA driver just works.
```

## conf/machine/vulcano-g20.conf
```bitbake
#@TYPE: Machine
#@Name: Metodo2 Vulcano G20 Board
#@DESCRIPTION: Machine configuration for Metodo2 VulcanoG20 module with AT91SAM9G20

include conf/machine/include/at91-2.6.30.inc

#PREFERRED_VERSION_linux = "2.6.30"

# Has linux config file in OpenEmbedded
#LINUX26_DEFCONFIG = "at91sam9g20ek_defconfig"

UBOOT_MACHINE = "vulcano-g20_nandflash_config"
#UBOOT_MACHINE = "vulcano-g20_dataflash_cs1_config"
# UBOOT_MACHINE = "vulcano-g20_config"

AT91BOOTSTRAP_BOARD = "vulcano-g20 vulcano-g20df vulcano-g20nf"

MACHINE_FEATURES += "usbhost"

#Vulcano with 64MB NAND
#EXTRA_IMAGECMD_jffs2 = "--pad --little-endian -s 0x200 -n  -e 16KiB"
```

## conf/machine/wgt634u.conf
```bitbake
#@TYPE: Machine
#@NAME: Netgear wgt634u wireless router  
#@DESCRIPTION: Machine configuration for the MIPS based wgt634u devices

TARGET_ARCH = "mipsel"
MACHINE_FEATURES = "kernel26 usbhost wifi ext2"


PREFERRED_PROVIDER_virtual/kernel = "linux-brcm"

IMAGE_FSTYPES = "tar.gz squashfs-lzma jffs2"

EXTRA_IMAGECMD_jffs2 = "--pad --little-endian --squash --eraseblock=0x10000 -n" 

EXTRA_IMAGECMD_squashfs-lzma = "-nopad -root-owned -le"
```

## conf/machine/wl500g.conf
```bitbake
#@TYPE: Machine
#@NAME: Asus WL500g(x)
#@DESCRIPTION: Machine configuration for the MIPS based WL500g(x) devices

TARGET_ARCH = "mipsel"
MACHINE_FEATURES = "kernel26 usbhost wifi ext2"

include conf/machine/include/tune-mips2.inc
```

## conf/machine/wrap.conf
```bitbake
#@TYPE: Machine
#@NAME: WRAP1 / WRAP2 wireless router boards
#@DESCRIPTION: Machine configuration for the PC Engines WRAP (Wireless Router Application Platform) boards.

TARGET_ARCH = "i486"
PACKAGE_EXTRA_ARCHS = "i386 x86"

PREFERRED_PROVIDER_virtual/kernel = "linux-wrap-geode"
PREFERRED_PROVIDERS += "virtual/${TARGET_PREFIX}depmod:module-init-tools-cross"

# Serial console settings for sysvinit
SERIAL_CONSOLE = "38400 ttyS0"

# There's no screen on the titan boards
USE_VT = "0"

# We are using UDEV, there is no devfs in 2.6 kernels
USE_DEVFS = "0"

# Create a tar.gz by default which needs to be uncompress onto a
# partition on the compact flash card being used.
IMAGE_FSTYPE ?= "tar.gz"

# Things to include in the fs image
MACHINE_FEATURES = "kernel26 pci ext2 x86"
# The kernel and grub need to installed to boot from flash
MACHINE_EXTRA_RDEPENDS = "kernel grub"

# Minimal device table is fine
IMAGE_DEVICE_TABLES = "files/device_table-minimal.txt"

# glibc
GLIBC_ADDONS = "nptl"
GLIBC_EXTRA_OECONF = "--with-tls"

KERNEL_IMAGETYPE = "bzImage"
```

## conf/machine/wrt54.conf
```bitbake
#@TYPE: Machine
#@NAME: Linksys WRT54G(S)
#@DESCRIPTION: Machine configuration for the MIPS based WRT54G(S) devices

TARGET_ARCH = "mipsel"
TARGET_CC_ARCH = "-Os"
IPKG_ARCHS = "all mipsel ${MACHINE}"

SERIAL_CONSOLE = "tts/0"

BOOTSTRAP_EXTRA_DEPENDS += "virtual/kernel wrt-utils wrt-init loader"
BOOTSTRAP_EXTRA_RDEPENDS += "kernel-module-wl kernel-module-et kernel-module-wlcompat kernel-module-diag"
BOOTSTRAP_EXTRA_RDEPENDS += "wrt-init wrt-utils"
BOOTSTRAP_EXTRA_RRECOMMENDS += ""

PREFERRED_PROVIDER_virtual/kernel = "linux-wrt"

# build jffs2 and squashfs-lzma images
IMAGE_FSTYPES = "squashfs-lzma jffs2"

EXTRA_IMAGECMD_jffs2 = "--pad --little-endian --squash --eraseblock=0x10000 -n" 

# squashfs-lzma image type (could be in bitbake.conf like the others)
IMAGE_DEPENDS_squashfs-lzma = "squashfs-tools-native"
IMAGE_CMD_squashfs-lzma = "mksquashfs-lzma ${IMAGE_ROOTFS} ${DEPLOY_DIR_IMAGE}/${IMAGE_NAME}.rootfs.squashfs-lzma ${EXTRA_IMAGECMD} -noappend"
EXTRA_IMAGECMD_squashfs-lzma = "-root-owned -le"

# build trx images
INHERIT += "wrt-image"

# strip even more: 
# would be nice but breaks automatic shared library dependencies
#DEPENDS_prepend = "${@["elfkickers-native ", ""][(bb.data.getVar('PACKAGES', d, 1) == '')]}"
#export STRIP = "sstrip"
```

## conf/machine/x86-32-nocona.conf
```bitbake
#@TYPE: Machine
#@NAME: x86-nocona
#@DESCRIPTION: Machine configuration for Intel 'Nocona' processor in 32-bit mode
#

TARGET_ARCH = "i686"
MACHINE_ARCH = "x86-32-nocona"
PACKAGE_EXTRA_ARCHS = "x86 i386 i486 i586 i686"

require conf/machine/include/tune-x86-nocona.inc

PREFERRED_PROVIDER_virtual/kernel = "linux-x86"
OLDEST_KERNEL = "2.6.20"

GLIBC_ADDONS = "nptl"
GLIBC_EXTRA_OECONF = "--with-tls"

IMAGE_FSTYPES = "ext2.gz"

MACHINE_FEATURES = "kernel26 screen keyboard pci ushbost acpi ext2 x86"
MACHINE_EXTRA_RRECOMMENDS = " kernel-modules"
```

## conf/machine/x86-prescott.conf
```bitbake
#@TYPE: Machine
#@NAME: x86-prescott
#@DESCRIPTION: Machine configuration for a generic i686 machine

TARGET_ARCH = "i686"
MACHINE_ARCH = "x86-prescott"
PACKAGE_EXTRA_ARCHS = "x86 i386 i486 i586 i686"

require conf/machine/include/tune-x86-prescott.inc

PREFERRED_PROVIDER_virtual/kernel = "linux-x86"
OLDEST_KERNEL = "2.6.20"

GLIBC_ADDONS = "nptl"
GLIBC_EXTRA_OECONF = "--with-tls"

IMAGE_FSTYPES = "ext2.gz"

MACHINE_FEATURES = "kernel26 screen keyboard pci ushbost acpi ext2 x86"
MACHINE_EXTRA_RRECOMMENDS = " kernel-modules"
```

## conf/machine/x86-uml.conf
```bitbake
#@TYPE: Machine
#@NAME: X86 User Mode Linux
#@DESCRIPTION: Machine configuration for a User Mode Linux running on an x86 compatible PC

require conf/machine/x86.conf

PREFERRED_PROVIDER_virtual/kernel = "linux-uml"
```

## conf/machine/x86.conf
```bitbake
# Copyright (C) 2007, Stelios Koroneos - Digital OPSiS, All Rights Reserved
# Released under the MIT license (see packages/COPYING)
#@TYPE: Machine
#@NAME: X86
#@DESCRIPTION: Machine configuration for a Linux running on x86 compatible machines

# i386 doesn't work with NTPL, see http://ecos.sourceware.org/ml/libc-ports/2006-03/msg00030.html
TARGET_ARCH = "i486"
PACKAGE_EXTRA_ARCHS = "x86"

PREFERRED_PROVIDER_virtual/kernel = "linux"
PREFERRED_PROVIDER_virtual/xserver = "xserver-kdrive"
XSERVER="xserver-kdrive-vesa"

KERNEL_IMAGETYPE = "bzImage"

MACHINE_EXTRA_RRECOMMENDS = " kernel-modules"
MACHINE_FEATURES = "kernel26 pci usbhost ext2 screen x86"

udevdir = "/dev"
OLDEST_KERNEL = "2.6.17"
GLIBC_ADDONS = "nptl"
GLIBC_EXTRA_OECONF = "--with-tls"

#require conf/machine/include/tune-x86.inc
```

## conf/machine/x86_64-generic.conf
```bitbake
# Copyright (C) 2007,2009 Stelios Koroneos - Digital OPSiS, All Rights Reserved
# Released under the MIT license (see packages/COPYING)
#@TYPE: Machine
#@NAME: x86_64-generic
#@DESCRIPTION: Machine configuration for a generic x86_64 machine


TARGET_ARCH = "x86_64"

PREFERRED_PROVIDER_virtual/kernel = "linux"
PREFERRED_PROVIDER_virtual/xserver = "xserver-kdrive"
XSERVER="xserver-kdrive-vesa"

KERNEL_IMAGETYPE = "bzImage"

GLIBC_ADDONS = "nptl"
GLIBC_EXTRA_OECONF = "--with-tls"

IMAGE_FSTYPES ?= "ext2.gz"
IMAGE_DEVICE_TABLES = " \
  files/device_table-minimal.txt \
  files/device_table_add-loop.txt \
  files/device_table_add-scsi.txt \
"

MACHINE_FEATURES = "kernel26 screen keyboard pci usbhost acpi ext2 x86"
MACHINE_EXTRA_RRECOMMENDS = " kernel-modules"

#tune for x86_64
require conf/machine/include/tune-x86_64.inc
```
