## conf/machine/tqm8540.conf
```bitbake
#@TYPE: Machine
#@Name: TQM85xx
#@DESCRIPTION: Machine configuration for the Ixxi TQ-Minimodule with MPC8540

TARGET_ARCH = "powerpc"

PREFERRED_PROVIDER_virtual/kernel ?= "linux"

MACHINE_FEATURES = "kernel26 usbhost pci ext2 uboot jffs2"

KERNEL_IMAGETYPE = "uImage"

UBOOT_MACHINE = "TQM8540_config"
UBOOT_ENTRYPOINT = "0"
UBOOT_LOADADDRESS = "0"

EXTRA_IMAGECMD_jffs2 = "--pad --big-endian --eraseblock=0x20000"

#don't try to access tty1
USE_VT = "0"

SERIAL_CONSOLE = "115200 ttyS0"

#tune for the e500 core
require conf/machine/include/tune-ppce500.inc
```
