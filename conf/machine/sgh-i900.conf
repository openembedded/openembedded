## conf/machine/sgh-i900.conf
```bitbake
#@TYPE: Machine
#@NAME: Samsung Omnia SGH-i900
#@DESCRIPTION: Machine configuration for the Samsung Omnia SGH-i900
#@HOMEPAGE: http://andromnia.sourceforge.net

# Hardware-based properties
#

TARGET_ARCH = "arm"

require conf/machine/include/tune-xscale.inc

MACHINE_FEATURES = "alsa apm bluetooth camera gps kernel26 phone screen touchscreen vfat wifi"
MACHINE_EXTRA_RRECOMMENDS = " kernel-modules"

# Software/packages selection
#

PREFERRED_PROVIDER_virtual/kernel = "linux-sgh-i900"
PREFERRED_PROVIDER_virtual/xserver = "xserver-xorg"
XSERVER = "xserver-xorg \
           xf86-input-evdev \
           xf86-input-tslib \
           xf86-video-fbdev"
```

## conf/machine/sh7785lcr.conf
```bitbake
#@TYPE: Machine
#@NAME: sh7785lcr board setup
#@DESCRIPTION: Machine configuration for Renesas sh7785lcr(SH7785) board

TARGET_ARCH = "sh4"

require conf/machine/include/tune-sh4.inc

KERNEL_IMAGETYPE = "uImage"

SERIAL_CONSOLE = "115200 ttySC1"

PREFERRED_PROVIDER_virtual/kernel = "linux"
MACHINE_FEATURES = "kernel26 ext2 vfat ethernet"
MACHINE_EXTRA_RRECOMMENDS = "kernel-modules"

UBOOT_ARCH = "sh"
UBOOT_MACHINE = "sh7785lcr_32bit_config"
UBOOT_LOADADDRESS ?= "0x80001000"
UBOOT_ENTRYPOINT ?= "0x80002000"
```

## conf/machine/shark.conf
```bitbake
#@TYPE: Machine
#@NAME: DNARD NetworkComputer/Shark
#@DESCRIPTION: Machine configuration for the SHARK based SHARK

MACHINE_KERNEL_VERSION ?= "2.6"

TARGET_ARCH = "arm"
PREFERRED_PROVIDER_xserver = "xserver-kdrive"
PREFERRED_PROVIDER_virtual/kernel = "linux-z"

EXTRA_IMAGECMD_jffs2 = "--little-endian --eraseblock=0x20000 -n"
EXTRA_IMAGEDEPENDS = ""
SERIAL_CONSOLE = "ttySA0 115200 vt100"

ROOT_FLASH_SIZE = "16"
USE_VT = "0"

require conf/machine/include/tune-strongarm.inc

MACHINE_FEATURES = "kernel26 apm alsa pcmcia keyboard ext2"
MACHINE_EXTRA_RDEPENDS_append = " mpg321 mpd madplay "

GUI_MACHINE_CLASS = "bigscreen"
```

## conf/machine/sheevaplug.conf
```bitbake
#@NAME: ARM based Marvell Sheevaplug

MACHINE_EXTRA_RDEPENDS          = "u-boot-utils"
MACHINE_EXTRA_RRECOMMENDS       = "kernel-modules"

# do ubiattach /dev/ubi_ctrl -m 4
# From dmesg:
# UBI: smallest flash I/O unit:    2048
# UBI: logical eraseblock size:    129024 bytes
# from ubiattach stdout:
# UBI device number 0, total 4096 LEBs
MKUBIFS_ARGS = "-m 2048 -e 129024 -c 4096"

# do ubiattach /dev/ubi_ctrl -m 4
# from dmesg:
# UBI: smallest flash I/O unit:    2048
# UBI: physical eraseblock size:   131072 bytes (128 KiB)
# UBI: sub-page size:              512
UBINIZE_ARGS = "-m 2048 -p 128KiB -s 512"

require conf/machine/include/kirkwood.inc
```

## conf/machine/shepherd.conf
```bitbake
#@TYPE: Machine
#@NAME: Sharp Zaurus SL-C750
#@DESCRIPTION: Machine configuration for the Sharp Zaurus SL-C750 device

include conf/machine/zaurus-clamshell.conf

ROOT_FLASH_SIZE = "32"
```

## conf/machine/simone.conf
```bitbake
#@TYPE: Machine
#@Name: SimpleMachines Sim.One developer board
#@DESCRIPTION: Machine configuration for SimpleMachines Sim.One developer board
#@HOMEPAGE: http://simplemachines.it/simone.html

require conf/machine/ep93xx.conf

KERNEL_IMAGETYPE = "uImage"

UBOOT_ENTRYPOINT = "c0008000"

EXTRA_IMAGECMD_jffs2 = "-e 0x20000 -p "
```

## conf/machine/simpad-2.4.conf
```bitbake
PREFERRED_PROVIDER_virtual/kernel = "opensimpad-64+0"

# Later versions are broken on kernel 2.4
PREFERRED_VERSION_orinoco-modules = "0.13e"

BOOTSTRAP_EXTRA_DEPENDS = "virtual/kernel hostap-modules orinoco-modules \
pcmcia-cs apmd hostap-utils \
wpa-supplicant-nossl"

BOOTSTRAP_EXTRA_RDEPENDS = "kernel hostap-modules orinoco-modules \
orinoco-modules-cs pcmcia-cs apm hostap-utils \
wpa-supplicant-nossl"

BOOTSTRAP_EXTRA_RRECOMMENDS = "hostap-modules-cs \
kernel-module-sa1100-ir kernel-module-sa1100usb-core kernel-module-usb-eth \
kernel-module-pcnet-cs kernel-module-8390"
```

## conf/machine/simpad-2.6.conf
```bitbake
PREFERRED_PROVIDER_virtual/kernel = "handhelds-pxa-2.6"

PREFERRED_PROVIDERS += "virtual/${TARGET_PREFIX}depmod-2.6:module-init-tools-cross"

BOOTSTRAP_EXTRA_DEPENDS = "udev virtual/kernel hostap-modules hostap-utils orinoco-modules wpa-supplicant-nossl"
BOOTSTRAP_EXTRA_RDEPENDS = "udev kernel"
BOOTSTRAP_EXTRA_RRECOMMENDS = "hostap-modules-cs \
kernel-module-sa1100-ir kernel-module-sa1100usb-core kernel-module-usb-eth \
kernel-module-pcnet-cs kernel-module-8390"
```

## conf/machine/simpad.conf
```bitbake
#@TYPE: Machine
#@NAME: SIEMENS SIMpad SL4, SIEMENS SIMpad CL4, SIEMENS SIMpad SLC, Telekom T-Sinus PAD
#@DESCRIPTION: Machine configuration for the SA1100 based SIEMENS SIMpad and Telekom T-Sinus PAD devices

TARGET_ARCH = "arm"

MACHINE_FEATURES = "apm pcmcia irda screen touchscreen vfat kernel26"

PREFERRED_PROVIDER_virtual/kernel = "linux"
PCMCIA_MANAGER ?= "pcmciautils"

require conf/machine/include/tune-strongarm.inc

ROOT_FLASH_SIZE = "16"
EXTRA_IMAGECMD_jffs2 = "--little-endian --eraseblock=0x20000"

GUI_MACHINE_CLASS = "bigscreen"
MACHINE_DISPLAY_WIDTH_PIXELS = "800" 
MACHINE_DISPLAY_HEIGHT_PIXELS= "600"
SERIAL_CONSOLE = "ttySA0 115200 vt100"
USE_VT = "0"

PREFERRED_PROVIDER_xserver = "xserver-kdrive"
```

## conf/machine/smartq5.conf
```bitbake
#@TYPE: Machine
#@Name: Smartdevices SmartQ5
#@DESCRIPTION: Machine configuration for Smartdevices SmartQ5

TARGET_ARCH = "arm"

PREFERRED_PROVIDER_virtual/xserver = "xserver-xorg"
XSERVER = "xserver-xorg \
           xf86-input-evdev \
           xf86-input-tslib \
           xf86-video-fbdev \
           xf86-input-keyboard \
           xf86-input-mouse \
"

PREFERRED_PROVIDER_virtual/kernel = "linux"
MACHINE_KERNEL_PR = "r1"
KERNEL_IMAGETYPE = "zImage"

# used by sysvinit_2
SERIAL_CONSOLE = "115200 ttySAC0"

IMAGE_FSTYPES = "tar.gz"

MACHINE_FEATURES = "kernel26 apm screen alsa usbgadget usbhost"

require conf/machine/include/tune-arm1176jzf-s.inc
```

## conf/machine/smartqv7.conf
```bitbake
#@TYPE: Machine
#@Name: Smartdevices V7
#@DESCRIPTION: Machine configuration for Smartdevices V7

TARGET_ARCH = "arm"

PREFERRED_PROVIDER_virtual/xserver = "xserver-kdrive"
MACHINE_DISPLAY_WIDTH_PIXELS = "800"
MACHINE_DISPLAY_HEIGHT_PIXELS = "480"
MACHINE_DISPLAY_ORIENTATION = "0"
MACHINE_DISPLAY_PPI = "110"
GUI_MACHINE_CLASS = "bigscreen"
XSERVER = "xserver-kdrive-fbdev"

PREFERRED_PROVIDER_virtual/kernel = "linux"
MACHINE_KERNEL_PR = "r0"
KERNEL_IMAGETYPE = "zImage"

# used by sysvinit
SERIAL_CONSOLE = "115200 ttySAC0"

IMAGE_FSTYPES = "tar.gz"

MACHINE_FEATURES = "kernel26 apm screen touchscreen alsa usbgadget usbhost"
MACHINE_EXTRA_RRECOMMENDS = "marvell-sdio-fw kernel-modules"

require conf/machine/include/tune-arm1176jzf-s.inc
```

## conf/machine/smdk2440.conf
```bitbake
#@TYPE: Machine
#@Name: Samsung SMDK2440 Dev BOard
#@DESCRIPTION: Machine configuration for Samsung SMDK2440 Dev Board


TARGET_ARCH = "arm"
PACKAGE_EXTRA_ARCHS = "armv4t"

PREFERRED_PROVIDER_virtual/kernel = "linux-smdk2440"

# used by sysvinit_2
SERIAL_CONSOLE = "115200 ttySAC0"

IMAGE_FSTYPES = "tar.gz"

MACHINE_FEATURES = "kernel26 apm screen"

require conf/machine/include/tune-arm920t.inc
```

## conf/machine/smdk6410.conf
```bitbake
#@TYPE: Machine
#@Name: Samsung SMDK6410 Dev BOard
#@DESCRIPTION: Machine configuration for Samsung SMDK6410 Dev Board

TARGET_ARCH = "arm"

PREFERRED_PROVIDER_virtual/kernel = "linux"

# used by sysvinit_2
SERIAL_CONSOLE = "115200 ttySAC0"

IMAGE_FSTYPES = "tar.gz"

MACHINE_FEATURES = "kernel26 apm screen alsa usbgadget usbhost"

require conf/machine/include/tune-arm1176jzf-s.inc
```

## conf/machine/spitz.conf
```bitbake
#@TYPE: Machine
#@NAME: Sharp Zaurus SL-C3000
#@DESCRIPTION: Machine configuration for the Sharp Zaurus SL-C3000 device

require conf/machine/include/zaurus-2.6.inc
require conf/machine/include/zaurus-clamshell.inc

MACHINE_FEATURES += "iwmmxt"
PACKAGE_EXTRA_ARCHS += "iwmmxt"

# NAND factory-default
# SL-C3000 (spitz) mtdparts=sharpsl-nand:7168k@0k(smf),5120k@7168k(root),-(home)
# SL-C3100 (borzoi) mtdparts=sharpsl-nand:7168k@0k(smf),32768k@7168k(root),-(home)
# SL-C3200 (terrier) mtdparts=sharpsl-nand:7168k@0k(smf),44032k@7168k(root),-(home)

# There isn't an unique size valid for all models,
# please set the right value in your local.conf
ROOT_FLASH_SIZE ?= "5"

MACHINE_GUI_CLASS = "bigscreen"
MACHINE_DISPLAY_WIDTH_PIXELS = "640"
MACHINE_DISPLAY_HEIGHT_PIXELS = "480"
MACHINE_DISPLAY_ORIENTATION = "270"
MACHINE_DISPLAY_PPI = "216"

# spitz and akita share same u-boot machine
UBOOT_MACHINE = "akita_config"
UBOOT_ENTRYPOINT = "0xA1000000"
UBOOT_LOADADDRESS = "${UBOOT_ENTRYPOINT}"
```

## conf/machine/stamp9g20evb.conf
```bitbake
#@TYPE: Machine
#@Name: taskit Stamp9G20 Evaluation Board
#@DESCRIPTION: Machine configuration for the Stamp9G20 Evaluation Board
#@MAINTAINER: Marco Cavallini <m.cavallini@koansoftware.com>

TARGET_ARCH = "arm"

PREFERRED_PROVIDER_virtual/kernel = "linux"
PREFERRED_VERSION_linux = "2.6.29"

KERNEL_IMAGETYPE = "uImage"

#don't try to access tty1
USE_VT = "0"

MACHINE_FEATURES = "kernel26 ext2 vfat usbhost usbgadget"

# used by sysvinit_2
SERIAL_CONSOLE = "115200 ttyS0"
IMAGE_FSTYPES ?= "jffs2"
EXTRA_IMAGECMD_jffs2 = "--little-endian --eraseblock=0x20000 -n --pad; \
			sumtool -i ${DEPLOY_DIR_IMAGE}/${IMAGE_NAME}.rootfs.jffs2 -o ${DEPLOY_DIR_IMAGE}/${IMAGE_NAME}.rootfs-summary.jffs2 -e 0x20000 -n --pad; \
			mv ${DEPLOY_DIR_IMAGE}/${IMAGE_NAME}.rootfs-summary.jffs2 ${DEPLOY_DIR_IMAGE}/${IMAGE_NAME}.rootfs.jffs2"

require conf/machine/include/tune-arm926ejs.inc
```

## conf/machine/stb225.conf
```bitbake
# PNX8335 STB225 board

TARGET_ARCH = "mipsel"

MACHINE_FEATURES = "kernel26"

IMAGE_FSTYPES += "tar.gz"

PREFERRED_PROVIDER_virtual/kernel = "linux"
KERNEL_IMAGETYPE = "uImage"

SERIAL_CONSOLE ?= "115200 ttySA0"

require conf/machine/include/tune-mips32.inc
```

## conf/machine/storcenter.conf
```bitbake
TARGET_ARCH = "powerpc"
TARGET_OS = "linux"
PACKAGE_EXTRA_ARCHS = "ppc"

INHERIT += "storcenter-image"

MACHINE_FEATURES		= "kernel26 usbhost pci ext2 uboot"
MACHINE_TASK_PROVIDER = "task-base"
MACHINE_EXTRA_RDEPENDS = "u-boot-utils xfsprogs sccd"

USE_DEVFS = "0"

BOOTSTRAP_EXTRA_RDEPENDS 		= "udev module-init-tools"

PREFERRED_PROVIDER_virtual/kernel = "linux-storcenter"
PREFERRED_VERSION_linux-storcenter = "2.6.27.7"
PREFERRED_VERSION_u-boot = "1.2.0"

#don't try to access tty1
USE_VT="0"

IMAGE_DEVICE_TABLES = "files/device_table-slugos.txt"
IMAGE_FSTYPES			= "tar.gz"

SERIAL_CONSOLE="115200 console"

require conf/machine/include/tune-ppc603e.inc

UBOOT_MACHINE = "storcenter"
```

## conf/machine/sun4cdm.conf
```bitbake
TARGET_ARCH = "sparc"

IMAGE_FSTYPE = "cramfs"

BOOTSTRAP_EXTRA_RDEPENDS = "kernel module-init-tools udev"

udevdir = "/dev"
OLDEST_KERNEL = "2.6.5"

IPKG_ARCHS = "sparc"

PREFERRED_PROVIDER_virtual/kernel = "linux-sun4cdm"
```

## conf/machine/terrier.conf
```bitbake
WARNING:="${@bb.fatal('\n*\n*\n*    Sorry, There is no dedicated configuration for the Sharp SL-C3200,\n*    because \
its very similar to the SL-C3000/SL-C3100. Use MACHINE = \"spitz\".\n*\n*\n')}"
```

## conf/machine/titan.conf
```bitbake
#@TYPE: Machine
#@NAME: Nimble NP51R / Linkgear SERIES 100
#@DESCRIPTION: Machine configuration for the SH4 based Nimble NP51R / Linkgear Series 100

TARGET_ARCH = "sh4"

PREFERRED_PROVIDER_virtual/kernel = "linux-titan-sh4"
PREFERRED_PROVIDERS += "virtual/${TARGET_PREFIX}depmod:module-init-tools-cross"

# SH4 specific settings
require conf/machine/include/tune-sh4.conf

# Serial console settings for sysvinit
SERIAL_CONSOLE = "38400 ttySC1"

# There's no screen on the titan boards
USE_VT = "0"

# We are using UDEV, there is no devfs in 2.6 kernels
USE_DEVFS = "0"

# The NP51R has 64MB flash, 2nd partition (/) is 63984k in size.
# The LinkGear Series 100 has 128MB of flash (not tested)
IMAGE_FSTYPE ?= "ext2.gz"
IMAGE_ROOTFS_SIZE_ext2 ?= "63984"

# Extra items to include in the fs image
BOOTSTRAP_EXTRA_RDEPENDS += "kernel pciutils udev kernel-modules lilo-sh"

# Add the SCI (serial) and SM (flash) devices to the minimal /dev
IMAGE_DEVICE_TABLES = "files/device_table-minimal.txt \
                       files/device_table_add-sci.txt \
                       files/device_table_add-sm.txt"
```

## conf/machine/topas910.conf
```bitbake
#-----------------------------------------------------------------------------
#@TYPE: Machine
#@NAME: Toshiba TMPA910 (Topas) Starter Kit
#@DESCRIPTION: Machine description for the Toshiba TMPA910CRAXBG SoC Starter Kit
#-----------------------------------------------------------------------------

TARGET_ARCH = "arm"
GUI_MACHINE_CLASS = "smallscreen"
#PACKAGE_EXTRA_ARCHS = "armv4t"

PREFERRED_PROVIDER_virtual/kernel ?= "linux"
PREFERRED_PROVIDER_virtual/xserver = "xserver-kdrive"
UBOOT_ENTRYPOINT = "40008000"
KERNEL_IMAGETYPE = "uImage"

MACHINE_FEATURES = "kernel26 apm alsa usbgadget usbhost vfat screen touchscreen"
MACHINE_DISPLAY_WIDTH_PIXELS = "320"
MACHINE_DISPLAY_HEIGHT_PIXELS = "240"
MACHINE_DISPLAY_ORIENTATION = "0"
MACHINE_DISPLAY_PPI = "110"
XSERVER = "xserver-kdrive-fbdev"

# package machine specific modules
MACHINE_EXTRA_RRECOMMENDS = "\
"

SERIAL_CONSOLE = "115200 ttyS0"

# used by some images
ROOT_FLASH_SIZE = "16"

# extra jffs2 tweaks
IMAGE_FSTYPES ?= "jffs2"
EXTRA_IMAGECMD_jffs2 = "--little-endian --eraseblock=0x20000 \
	--pad 0x1aa0000 ; sumtool --eraseblock=0x20000 \
	--littleendian --pad 0x1aa0000 \
	-i ${DEPLOY_DIR_IMAGE}/${IMAGE_NAME}.rootfs.jffs2 \
	-o ${DEPLOY_DIR_IMAGE}/${IMAGE_NAME}.rootfs.jffs2.summary"

# build / upload tools
MACHINE_EXTRA_RRECOMMENDS += "mtd-utils"

# tune for cpu
include conf/machine/include/tune-arm920t.inc
```

## conf/machine/tosa-2.4.conf
```bitbake
PREFERRED_PROVIDER_xserver = "xserver-kdrive"
PREFERRED_PROVIDER_virtual/kernel = "openzaurus-pxa"

BOOTSTRAP_EXTRA_DEPENDS += "wlan-ng-modules wlan-ng-utils virtual/kernel hostap-modules \
			    orinoco-modules sharp-sdmmc-support usbutils"
BOOTSTRAP_EXTRA_RDEPENDS += "wlan-ng-modules wlan-ng-utils kernel-module-acm \
			     kernel-module-evdev kernel-module-net-fd \
			     kernel-module-pxa-bi kernel-module-registers \
			     kernel-module-storage-fd kernel-module-usb-ohci-tc6393 \
			     kernel-module-usb-storage \
			     kernel hostap-modules-cs orinoco-modules-cs \
			     sharp-sdmmc-support kernel-module-pxa-bi \
			     kernel-module-ip-gre \
			     kernel-module-irnet kernel-module-ipip kernel-module-usbcore \
			     kernel-module-usbdcore kernel-module-usbdmonitor"

RRECOMMENDS += "kernel-module-usbdserial kernel-module-usbkbd \
		kernel-module-usbmouse kernel-module-hid usbutils \
		kernel-module-evdev"
```

## conf/machine/tosa-2.6.conf
```bitbake
include conf/machine/zaurus-clamshell-2.6.conf
# SOUND Modules
BOOTSTRAP_EXTRA_RDEPENDS += "kernel-module-snd kernel-module-ac97-bus kernel-module-snd-ac97-codec kernel-module-snd-mixer-oss kernel-module-snd-page-alloc kernel-module-snd-pcm kernel-module-snd-pcm-oss kernel-module-snd-pxa2xx-ac97 kernel-module-snd-pxa2xx-pcm kernel-module-snd-timer kernel-module-soundcore"

# WM9712 Modules
BOOTSTRAP_EXTRA_RDEPENDS += "kernel-module-wm97xx"
```

## conf/machine/tosa.conf
```bitbake
#@TYPE: Machine
#@NAME: Sharp Zaurus SL-6000
#@DESCRIPTION: Machine configuration for the PXA255 based Sharp Zaurus SL-6000 device

require conf/machine/include/zaurus-2.6.inc
require conf/machine/include/tune-xscale.inc

ROOT_FLASH_SIZE = "28"

MACHINE_GUI_CLASS = "bigscreen"
MACHINE_DISPLAY_WIDTH_PIXELS = "480"
MACHINE_DISPLAY_HEIGHT_PIXELS = "640"
MACHINE_DISPLAY_ORIENTATION = "0"
MACHINE_DISPLAY_PPI = "200"
```
