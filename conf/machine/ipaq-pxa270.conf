## conf/machine/ipaq-pxa270.conf
```bitbake
#@TYPE: Machine
#@NAME: iPAQ hx47xx hx2xxx
#@DESCRIPTION: Machine configuration for the iPAQ with a pxa27x CPU  devices

TARGET_ARCH = "arm"
IPKG_EXTRA_ARCHS = "armv4 armv4t armv5te iwmmxt ipaqpxa hx4700"
#use this for a hx47xx ipaq
PREFERRED_PROVIDER_virtual/kernel = "handhelds-pxa-2.6"

#use this for a hx2xxx ipaq
#PREFERRED_PROVIDER_virtual/kernel = "linux-openzaurus"

PREFERRED_VERSION_orinoco-modules = "0.15rc1"

ROOT_FLASH_SIZE = "80"

EXTRA_IMAGECMD_jffs2 = "; sumtool -i ${DEPLOY_DIR_IMAGE}/${IMAGE_NAME}.rootfs.jffs2 \
			  -o ${DEPLOY_DIR_IMAGE}/${IMAGE_NAME}.rootfs-summary.jffs2 \
			  -e 256KiB -p"

IMAGE_FSTYPES ?= "jffs2"

MODUTILS = "26"	

MACHINE_FEATURES = "kernel26 touchscreen apm alsa pcmcia bluetooth irda wifi usbgadget"

PCMCIA_MANAGER = "pcmciautils"
BOOTSTRAP_EXTRA_RDEPENDS = "kernel ipaq-boot-params "
BOOTMODULES_RRECOMMENDS = "${@linux_module_packages('${PXA270_MODULES}', d)} ${@linux_module_packages('${HX4700_MODULES}', d)}"
BOOTSTRAP_EXTRA_RRECOMMENDS += " ${BOOTMODULES_RRECOMMENDS}"
BOOTSTRAP_EXTRA_RDEPENDS_append = " udev"
BOOTSTRAP_EXTRA_RDEPENDS_append = " tiinit acx-firmware"

PXA270_MODULES = "g_ether g_file_storage g_serial gadgetfs pxa27x_udc \
		  snd_pcm_oss snd_mixer_oss evdev mmc_block pcmcia hidp \
		  nls_cp437 nls_iso8859-1 nls_utf8 af_key"

SERIAL_CONSOLE = "115200 ttyS0"

include conf/machine/include/handheld-common.conf

GUI_MACHINE_CLASS = "bigscreen"

# Use tune-xscale per default. Machine independent feeds should be built with tune-strongarm.
include conf/machine/include/tune-xscale.conf

# Uncomment this to use iwmmxt optimizations. Remove the above xscale stuff first
#include conf/machine/include/tune-iwmmxt.conf


# These modules are now compiled into the kernel:
#HX4700_MODULES = "asic3_mmc hx4700_bt hx4700_leds hx4700_navpt \
#                  hx4700_pcmcia hx4700_ts hx4700_power"

HX4700_MODULES = "i2c-pxa hx4700_voltage hx4700_acx snd_hx4700_audio"


module_autoload_evdev = "evdev"
module_autoload_hx4700_power = "hx4700_power"
module_autoload_pcmcia = "pcmcia"
module_autoload_hx4700_pcmcia = "hx4700_pcmcia"
module_autoload_asic3_mmc = "asic3_mmc"
module_autoload_mmc_block = "mmc_block"
module_autoload_hx4700_ts = "hx4700_ts"
module_autoload_hx4700_navpt = "hx4700_navpt"
module_autoload_hx4700_bt = "hx4700_bt"
module_autoload_snd-hx4700_audio = "snd-hx4700_audio"
module_autoload_snd-pcm-oss = "snd-pcm-oss"
module_autoload_snd-mixer-oss = "snd-mixer-oss"
module_autoload_pxa27x_udc = "pxa27x_udc"

#FIXME: this should be controlled by a userspace utility later.
module_autoload_g_ether = "g_ether"
```

## conf/machine/iphone.conf
```bitbake
#@TYPE: Machine
#@NAME: iPhone
#@DESCRIPTION: Machine configuration for the iPhone

TARGET_ARCH = "arm"

# For now we don't require tune-arm1176jzf-s as we
# really want the arch to stay "arm".

#require conf/machine/include/tune-arm1176jzf-s.inc
```

## conf/machine/iphone3g.conf
```bitbake
#@TYPE: Machine
#@NAME: iPhone3G
#@DESCRIPTION: Machine configuration for the iPhone3G

TARGET_ARCH = "arm"

require conf/machine/include/tune-arm1176jzf-s.inc

MACHINE_DISPLAY_WIDTH_PIXELS = "320"
MACHINE_DISPLAY_HEIGHT_PIXELS = "480"
MACHINE_DISPLAY_ORIENTATION = "0"

MACHINE_FEATURES = "kernel26 touchscreen screen wifi ext2 phone gps usbgadget bluetooth"

PREFERRED_PROVIDER_virtual/kernel = "linux-iphone"

PREFERRED_PROVIDER_virtual/xserver = "xserver-xorg"

XSERVER = " \
        xserver-xorg \
        xserver-xorg-extension-glx \
        xserver-xorg-extension-dri \
        xf86-input-evdev \
        xf86-video-fbdev \
"

IMAGE_FSTYPES ?= "tar.bz2"
```

## conf/machine/ixp4xxbe.conf
```bitbake
#@TYPE: Machine
#@NAME: Generic IXP4XX kernel
#@DESCRIPTION: Machine configuration for a generic ixp4xx board in big-endian mode

TARGET_ARCH = "armeb"

PACKAGE_EXTRA_ARCHS = "armv5eb"

require conf/machine/include/ixp4xx.inc

EXTRA_IMAGECMD_jffs2 += "--big-endian"
```

## conf/machine/ixp4xxle.conf
```bitbake
#@TYPE: Machine
#@NAME: Generic IXP4XX kernel
#@DESCRIPTION: Machine configuration for a generic ixp4xx board in little-endian mode

TARGET_ARCH = "arm"

PACKAGE_EXTRA_ARCHS = "armv5e"

require conf/machine/include/ixp4xx.inc

EXTRA_IMAGECMD_jffs2 += " --little-endian"
```

## conf/machine/jornada56x.conf
```bitbake
#@TYPE: Machine
#@NAME: HP Jornada 56x
#@DESCRIPTION: Machine configuration for the SA1100 based HP Jornada 56x palmtop computer

TARGET_ARCH = "arm"
PREFERRED_PROVIDER_xserver = "xserver-kdrive"
PREFERRED_PROVIDER_virtual/kernel = "linux-handhelds-2.6"
PREFERRED_PROVIDERS += "virtual/${TARGET_PREFIX}depmod:module-init-tools-cross"
BOOTSTRAP_EXTRA_RDEPENDS = "kernel kernel-modules module-init-tools" 

EXTRA_IMAGECMD_jornada56x_jffs2 = "-e 0x40000 -p"

SERIAL_CONSOLE = "115200 ttySA0"

require conf/machine/include/tune-strongarm.inc
```

## conf/machine/jornada6xx.conf
```bitbake
#@TYPE: Machine
#@NAME: HP Jornada 680
#@DESCRIPTION: Machine configuration for the HITACHI SH3 based HP Jornada 6xx palmtop computer

TARGET_ARCH = "sh3"

require conf/machine/include/tune-sh3.inc

MACHINE_FEATURES = "kernel26 alsa pcmcia irda keyboard touchscreen screen vfat"
MACHINE_EXTRA_RRECOMMENDS = " kernel-modules"

PREFERRED_PROVIDER_virtual/kernel = "linux-jlime-jornada6xx"
PREFERRED_VERSION_linux-jlime-jornada6xx = "2.6.17"

PREFERRED_PROVIDER_virtual/xserver = "xserver-kdrive"
PREFERRED_VERSION_xserver-kdrive = "1.3.0.0"

XSERVER = "xserver-kdrive-fbdev"

PCMCIA_MANAGER = "pcmciautils"

SYSVINIT_ENABLED_GETTYS = "1 2"
```

## conf/machine/jornada7xx.conf
```bitbake
#@TYPE: Machine
#@NAME: HP Jornada 7xx 
#@DESCRIPTION: Machine configuration for the SA1110 based HP Jornada 7xx palmtop computer

TARGET_ARCH = "arm"

require conf/machine/include/tune-strongarm.inc

PREFERRED_PROVIDER_virtual/kernel = "linux-jlime-jornada7xx"
PCMCIA_MANAGER = "pcmciautils"
MACHINE_FEATURES = "kernel26 apm alsa pcmcia irda keyboard touchscreen screen vfat"
MACHINE_EXTRA_RDEPENDS = "kernel-modules bluez-dtl1-workaround"

PREFERRED_PROVIDER_virtual/xserver = "xserver-kdrive"
PREFERRED_VERSION_xserver-kdrive = "1.3.0.0"
XSERVER = "xserver-kdrive-fbdev"

#screeninfo
MACHINE_GUI_CLASS = "smallscreen"
MACHINE_DISPLAY_WIDTH_PIXELS = "640"
MACHINE_DISPLAY_HEIGHT_PIXELS = "240"

SYSVINIT_ENABLED_GETTYS = "1 2 3 4 5 6"
```

## conf/machine/kb9202.conf
```bitbake
#@TYPE: Machine
#@Name: KwikByte KB9202 devboard
#@DESCRIPTION: Machine configuration for KwikByte KB9202 devboard

TARGET_ARCH = "arm"

PREFERRED_PROVIDER_virtual/kernel = "linux"
PACKAGE_EXTRA_ARCHS = "armv4 armv4t"

require conf/machine/include/tune-arm920t.inc

# used by sysvinit_2
# Needs at91 serial port
#SERIAL_CONSOLE = "57600 ttyAM0"
 
# used by some images
# 16MB nor + 32MB nand
ROOT_FLASH_SIZE = "12"

MACHINE_FEATURES = "kernel26 usbhost usbgadget irda"

KERNEL_IMAGETYPE = "uImage"
```

## conf/machine/kilauea.conf
```bitbake
#@TYPE: Machine
#@Name: AMCC Kilauea (405EX)
#@DESCRIPTION: Machine configuration for the AMCC Kilauea (405EX)

TARGET_ARCH = "powerpc"

PREFERRED_PROVIDER_virtual/kernel = "linux"

MACHINE_FEATURES = "kernel26"

KERNEL_IMAGETYPE = "uImage"

PREFERRED_VERSION_u-boot = "1.3.2"
UBOOT_MACHINE = "kilauea_config"
UBOOT_ENTRYPOINT = "0"
UBOOT_LOADADDRESS = "0"

SERIAL_CONSOLE = "115200 ttyS0"

#tune for the 405 cpu
require conf/machine/include/tune-ppc405.inc
```

## conf/machine/kixrp435.conf
```bitbake
#@TYPE: Machine
#@NAME: Intel IXP43x eval platform KIXRP435 (little-endian)
#@DESCRIPTION: Machine configuration for an KIXRP435 in little-endian mode

TARGET_ARCH = "arm"

# Note: armv4 armv4t armv5te will be added by tune-xscale.inc automatically.
PACKAGE_EXTRA_ARCHS = "armv5e ixp4xxle"

MACHINE_OVERRIDES += "ixp4xx nslu2"

PREFERRED_PROVIDER_virtual/kernel = "linux"
PREFERRED_VERSION_linux = "2.6.30"
ROOT_FLASH_SIZE ?= "32"

MACHINE_FEATURES ?= "kernel26 usbhost pci ext2 vfat redboot pcmcia"

require conf/machine/include/ixp4xx.inc

EXTRA_IMAGECMD_jffs2 += "--little-endian"
```

## conf/machine/ks8695.conf
```bitbake
#@TYPE: Machine
#@Name: Micrel KS8695(P) Development Platform
#@DESCRIPTION: Machine configuration for Micrel KS8695(P) Development Platform
#@SPECS: http://www.micrel.com/_PDF/Ethernet/ks8695.pdf
#@DEVICES: PePLink MANGA Triple Balance, Telegent TG100

TARGET_ARCH = "arm"

PREFERRED_PROVIDER_virtual/kernel = "linux-${MACHINE}"

require conf/machine/include/tune-arm920t.conf

# used by sysvinit_2
SERIAL_CONSOLE = "115200 ttyS0"

# used by opie-collections.inc
ROOT_FLASH_SIZE = "8"
```

## conf/machine/kuropro.conf
```bitbake
#@NAME: ARM based Revolution Kurobox Pro

MACHINE_EXTRA_RDEPENDS          = "micro-evtd u-boot-utils"

require conf/machine/include/orion.inc
```

## conf/machine/linkstationppchd.conf
```bitbake
#@TYPE: Machine
#@NAME: HD Linkstation
#@DESCRIPTION: Machine configuration for the Buffalo Linkstation HD

UBOOT_MACHINE = "linkstation_HDLAN"

require conf/machine/include/linkstationppc.conf
```

## conf/machine/linkstationppchg.conf
```bitbake
#@TYPE: Machine
#@NAME: HG Linkstation
#@DESCRIPTION: Machine configuration for the Buffalo Linkstation HG

UBOOT_MACHINE = "linkstation_HGLAN"

require conf/machine/include/linkstationppc.conf
```

## conf/machine/lite5200.conf
```bitbake
TARGET_ARCH = "powerpc"
UBOOT_MACHINE = "Lite5200"
SERIAL_CONSOLE="115200 ttyPSC0"

IMAGE_FSTYPES = "jffs2 tar.bz2"

PREFERRED_PROVIDER_virtual/kernel = "linux"
KERNEL_IMAGETYPE = "uImage"

MACHINE_FEATURES = "kernel26 ext2 usbhost pci uboot"

UBOOT_MACHINE = "Lite5200_config"

require conf/machine/include/tune-ppc603e.inc
```

## conf/machine/logicpd-pxa270.conf
```bitbake
#@TYPE: Machine
#@Name: LogicPD PXA270 Development Platform
#@DESCRIPTION: Machine configuration for LogicPD PXA270 Zoom Development Platform
#OLDEST_KERNEL = "2.6.17-rc5"
TARGET_ARCH = "arm"
PREFERRED_VERSION_logicpd-pxa270 = "2.6.19.2"
GUI_MACHINE_CLASS = "smallscreen"

PREFERRED_PROVIDER_virtual/kernel = "${MACHINE}"
PACKAGE_EXTRA_ARCHS = "armv4 armv4t armv5te"

require conf/machine/include/tune-xscale.inc

# used by sysvinit_2
SERIAL_CONSOLE = "115200 ttyS0"

# used by opie-collections.inc
ROOT_FLASH_SIZE = "32"

# default flash partition setup of the LogicPD flash board is:
# 0x00000000-0x000c0000 : "Bootloader"
# 0x000c0000-0x01000000 : "YAFFS"
# 0x01000000-0x02000000 : "Filesystem" (JFFS2)

EXTRA_IMAGECMD_jffs2 = "--pad=0x1000000 --eraseblock=0x40000"

MACHINE_FEATURES = "kernel26 pcmcia usbhost usbgadget pcmcia touchscreen alsa"
```

## conf/machine/lsarm.conf
```bitbake
#@TYPE: Machine
#@NAME: ARM based Buffalo Linkstation
#@DESCRIPTION: Machine configuration for various different ARM based linkstations
TARGET_ARCH = "arm"
PACKAGE_EXTRA_ARCHS = "armv4 armv4t armv5te"
INHERIT += "lsarm-image"

MACHINE_EXTRA_RDEPENDS = "miconapl micro-evtd"
MACHINE_FEATURES = "kernel26 usbhost ext2 pci uboot"

TARGET_FPU = "soft"

PREFERRED_PROVIDER_virtual/bootloader = ""

USE_DEVFS = "0"

require conf/machine/include/tune-arm926ejs.inc

IMAGE_FSTYPES = "tar.gz"

# serial console port on devboard rev. B3
SERIAL_CONSOLE = "115200 ttyS0"

HOTPLUG = "udev"
udevdir = "/dev"

IMAGE_DEVICE_TABLES = "files/device_table-slugos.txt"

BOOTSTRAP_EXTRA_RDEPENDS = "udev module-init-tools kernel-modules"
PREFERRED_PROVIDER_virtual/kernel = "linux-linkstationarm"
```

## conf/machine/lsmipsel.conf
```bitbake
#@TYPE: Machine
#@NAME: Linkstation HD-HLAN
#@DESCRIPTION: Machine configuration for the Buffalo Linkstation HD-HLAN (mipsel)

TARGET_ARCH = "mipsel"

MACHINE_FEATURES		= "kernel26 usbhost ext2"
MACHINE_TASK_PROVIDER		= "task-base"
MACHINE_EXTRA_RDEPENDS		= "avr-evtd"
MACHINE_EXTRA_RRECOMMENDS	= "u-boot-utils"

USE_DEVFS = "0"

PREFERRED_PROVIDER_virtual/kernel 		= "linux-lsmipsel"
PREFERRED_PROVIDER_virtual/bootloader 		= ""
PREFERRED_VERSION_linux-lsmipsel	 	= "2.6.23.17"

#don't try to access tty1
USE_VT = "0"

IMAGE_DEVICE_TABLES 	= "files/device_table-slugos.txt"
IMAGE_FSTYPES			= "tar.gz"
```

## conf/machine/lsppchd.conf
```bitbake
#@TYPE: Machine
#@NAME: HD Linkstation
#@DESCRIPTION: Machine configuration for the Buffalo Linkstation HD

UBOOT_MACHINE = "linkstation_HDLAN_config"

require conf/machine/include/lsppc.inc
```

## conf/machine/lsppchg.conf
```bitbake
#@TYPE: Machine
#@NAME: HG Linkstation
#@DESCRIPTION: Machine configuration for the Buffalo Linkstation HG

UBOOT_MACHINE = "linkstation_HGLAN_config"

require conf/machine/include/lsppc.inc
```

## conf/machine/lspro.conf
```bitbake
#@NAME: ARM based Revolution Kurobox Pro

INHERIT += "lspro-image"
MACHINE_EXTRA_RDEPENDS          = "micro-evtd u-boot-utils"

require conf/machine/include/orion.inc
```

## conf/machine/m8050.conf
```bitbake
#-----------------------------------------------------------------------------
#@TYPE: Machine
#@NAME: AML M8050
#@DESCRIPTION: Machine configuration for the American Microsystems Ltd M8050 Industrial PDA
#-----------------------------------------------------------------------------

TARGET_ARCH = "arm"

PREFERRED_PROVIDER_virtual/kernel ?= "linux"

MACHINE_FEATURES = "kernel26 apm alsa bluetooth usbgadget usbhost wifi"
MACHINE_DISPLAY_WIDTH_PIXELS = "240"
MACHINE_DISPLAY_HEIGHT_PIXELS = "320"
MACHINE_DISPLAY_ORIENTATION = "270"

XSERVER = "xserver-kdrive-fbdev"

# package machine specific modules
MACHINE_EXTRA_RRECOMMENDS = "\
  kernel-module-libertas-sdio \
"

SERIAL_CONSOLE = "115200 ttySAC1"

IMAGE_FSTYPES ?= "tar.gz"

# tune for S3C24x0
include conf/machine/include/tune-arm920t.inc
```

## conf/machine/magicbox.conf
```bitbake
# Copyright (C) 2007, Stelios Koroneos - Digital OPSiS, All Rights Reserved
# Released under the MIT license (see packages/COPYING)
#@TYPE: Machine
#@Name: Magicbox router board
#@DESCRIPTION: Machine configuration for Magicbox router board http://wwww.magicbox.pl

INHERIT += "magicbox-image"

TARGET_ARCH = "powerpc"
PACKAGE_EXTRA_ARCHS = "ppc405"

PREFERRED_PROVIDER_virtual/kernel = "linux-${MACHINE}"

MACHINE_FEATURES = "kernel26"

TARGET_CPU = "405"
OLDEST_KERNEL = "2.6.18"

SERIAL_CONSOLE = "115200 ttyS0"

PREFERRED_VERSION_u-boot = "1.1.2"
EXTRA_IMAGECMD_jffs2 = "-pad --big-endian --squash -e 0x10000"
EXTRA_IMAGECMD_squashfs = " -be -all-root -nopad -noappend -root-owned"
EXTRA_IMAGECMD_squashfs-lzma = " -be -all-root -nopad -noappend -root-owned"



#tune for the 405 cpu
require conf/machine/include/tune-ppc405.inc
```
