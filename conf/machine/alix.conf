## conf/machine/at91sam9g45ekes.conf
```bitbake
#@TYPE: Machine
#@Name: Atmel AT91SAM9G45EKES Development Platform
#@DESCRIPTION: Machine configuration for the at91sam9g45ekes development board with a at91sam9g45-es processor

include conf/machine/include/at91-2.6.30.inc
include conf/machine/include/at91-lcd.inc

# Has linux config file in OpenEmbedded
#
# LINUX26_DEFCONFIG = "at91sam9g45ek_defconfig"
# LINUX26_DEFCONFIG = "at91sam9m10g45ek_defconfig"

# Supported u-boot machines
#UBOOT_MACHINE = "at91sam9m10g45ek_nandflash_config"
#UBOOT_MACHINE = "at91sam9m10g45ek_dataflash_config"
UBOOT_MACHINE = "at91sam9m10g45ek_dataflash_cs0_config"
#UBOOT_MACHINE = "at91sam9m10g45ek_config"
#UBOOT_MACHINE = "at91sam9g45ekes_nandflash_config"
#UBOOT_MACHINE = "at91sam9g45ekes_dataflash_config"
#UBOOT_MACHINE = "at91sam9g45ekes_dataflash_cs0_config"
#UBOOT_MACHINE = "at91sam9g45ekes_config"

AT91BOOTSTRAP_BOARD = "at91sam9g45df at91sam9g45ek at91sam9g45nf"

MACHINE_FEATURES += "usbhost"
```

## conf/machine/at91sam9m10ekes.conf
```bitbake
#@TYPE: Machine
#@Name: Atmel AT91SAM9M10EKES Development Platform
#@DESCRIPTION: Machine configuration for the at91sam9m10ekes board with a at91sam9m10-es2 processor

include conf/machine/include/at91-2.6.30.inc
include conf/machine/include/at91-lcd.inc

# Has linux config file in OpenEmbedded
#
# LINUX26_DEFCONFIG = "at91sam9m10ekes_defconfig"
# LINUX26_DEFCONFIG = "at91sam9m10g45ek_defconfig"

# Supported u-boot machines
#UBOOT_MACHINE = "at91sam9m10g45ek_nandflash_config"
#UBOOT_MACHINE = "at91sam9m10g45ek_dataflash_config"
#UBOOT_MACHINE = "at91sam9m10g45ek_dataflash_cs0_config"
#UBOOT_MACHINE = "at91sam9m10g45ek_config"
UBOOT_MACHINE = "at91sam9m10g45ek_sd_config"
UBOOT_MACHINES = "at91sam9m10g45ek_sd at91sam9m10g45ek_nandflash at91sam9m10g45ek_dataflash"

AT91BOOTSTRAP_BOARD = "at91sam9m10dfes at91sam9m10ekes at91sam9m10nfes at91sam9m10sdu"

MACHINE_FEATURES += "usbhost"
```

## conf/machine/at91sam9m10g45ek.conf
```bitbake
#@TYPE: Machine
#@Name: Atmel AT91SAM9M10G45EK Development Platform
#@DESCRIPTION: Machine configuration for the at91sam9m10g45ek board with a at91sam9m10 processor

include conf/machine/include/at91-2.6.30.inc
include conf/machine/include/at91-lcd.inc

# Has linux config file in OpenEmbedded
# 
# LINUX26_DEFCONFIG = "at91sam9m10ekes_defconfig"
# LINUX26_DEFCONFIG = "at91sam9m10g45ek_defconfig"

# Supported u-boot machines
#UBOOT_MACHINE = "at91sam9m10g45ek_nandflash_config"
#UBOOT_MACHINE = "at91sam9m10g45ek_dataflash_config"
UBOOT_MACHINE = "at91sam9m10g45ek_dataflash_cs0_config"
#UBOOT_MACHINE = "at91sam9m10g45ek_config"

AT91BOOTSTRAP_BOARD = "at91sam9g45df at91sam9g45ek at91sam9g45nf"

MACHINE_FEATURES += "usbhost"
```

## conf/machine/at91sam9rlek.conf
```bitbake
#@TYPE: Machine
#@Name: Atmel AT91SAM9RLEK Development Platform
#@DESCRIPTION: Machine configuration for the at91sam9rlek development board with a at91sam9rl64 processor

TARGET_ARCH = "arm"
#PACKAGE_EXTRA_ARCHS = "armv4t armv5te"

PREFERRED_PROVIDER_virtual/kernel = "linux"
PREFERRED_VERSION_linux = "2.6.28"
PREFERRED_PROVIDER_xserver = "xserver-kdrive"

KERNEL_IMAGETYPE = "uImage"
UBOOT_MACHINE = "at91sam9rlek_config"

PREFERRED_VERSION_at91bootstrap = "2.10"

#don't try to access tty1
USE_VT = "0"

MACHINE_FEATURES = "kernel26 alsa ext2 usbgadget screen touchscreen"
EXTRA_IMAGEDEPENDS += "u-boot"
#EXTRA_IMAGEDEPENDS += "at91bootstrap"

# used by sysvinit_2
SERIAL_CONSOLE = "115200 ttyS0"
IMAGE_FSTYPES ?= "jffs2"
EXTRA_IMAGECMD_jffs2 = "--pad --little-endian --eraseblock=0x20000 -n"

require conf/machine/include/tune-arm926ejs.inc
```

## conf/machine/atngw100.conf
```bitbake
#@TYPE: Machine
#@Name: Atmel ATNGW100 AVR32AP7000 Network Gateway Kit 
#@DESCRIPTION: Atmel ATNGW100 Network Gateway Kit

TARGET_ARCH = "avr32"

PREFERRED_PROVIDER_virtual/kernel = "linux"
PREFERRED_PROVIDER_xserver = "xserver-kdrive"

#don't try to access tty1
USE_VT = "0"

MACHINE_FEATURES = "kernel26 alsa ext2 usbgadget"

# used by sysvinit_2
SERIAL_CONSOLE = "115200 ttyS0"

# used by some images
IMAGE_FSTYPES ?= "tar.bz2 jffs2"
ROOT_FLASH_SIZE = "8"
EXTRA_IMAGECMD_jffs2 = " --big-endian --pagesize=4096 --eraseblock=65536"

KERNEL_IMAGETYPE = "uImage"
PREFERRED_VERSION_u-boot = "2009.01"

UBOOT_MACHINE = "atngw100_config"
UBOOT_ENTRYPOINT = "0x90000000"
UBOOT_LOADADDRESS = "0x10000000"

require conf/machine/include/tune-at32ap7000.inc
```
