## conf/machine/alix.conf
```bitbake
#@TYPE: Machine
#@NAME: Alix
#@DESCRIPTION: Machine.inciguration for PC Engines Alix1c board
#
# http://pcengines.ch/alix1c.htm

# i386 doesn't work with NTPL, see http://ecos.sourceware.org/ml/libc-ports/2006-03/msg00030.html
TARGET_ARCH = "i586"

PACKAGE_EXTRA_ARCHS = "x86 i386 i486 geode"
PREFERRED_PROVIDER_virtual/kernel = "linux"
PREFERRED_PROVIDER_virtual/xserver = "xserver-xorg"

OLDEST_KERNEL = "2.6.17"
GLIBC_ADDONS = "nptl"
GLIBC_EXTRA_OECONF = "--with-tls"

MACHINE_FEATURES = "kernel26 usbhost ext2 pci screen alsa acpi x86"

require conf/machine/include/tune-geodelx.inc

IMAGE_FSTYPES += "tar.gz"

MACHINE_EXTRA_RRECOMMENDS = "\
	kernel-modules \
	"

KERNEL_IMAGETYPE = "bzImage"
```

## conf/machine/am3517-crane.conf
```bitbake
#@TYPE: Machine
#@NAME: craneboard machine
#@DESCRIPTION: Machine configuration for the AM3517 Crane board
TARGET_ARCH = "arm"
PREFERRED_PROVIDER_virtual/xserver = "xserver-xorg"
XSERVER = "xserver-xorg \
           xf86-input-evdev \
           xf86-input-mouse \
           xf86-video-omapfb \
           xf86-input-keyboard"

# Only has DVI connector for external screen
GUI_MACHINE_CLASS = "bigscreen"

require conf/machine/include/omap3.inc

# Ship all kernel modules

IMAGE_FSTYPES ?= "jffs2 tar.bz2"
EXTRA_IMAGECMD_jffs2 = "-lnp -e 0x20000 -s 2048"
EXTRA_IMAGEDEPENDS += " u-boot x-load"

SERIAL_CONSOLE = "115200 ttyS2"
USE_VT = "2"

PREFERRED_PROVIDER_virtual/kernel = "linux-omap-psp"

PREFERRED_PROVIDER_virtual/bootloader = "u-boot"

UBOOT_ARCH = "arm"
UBOOT_MACHINE = "am3517_crane_config"
XLOAD_MACHINE = "am3517crane_config"

MACHINE_FEATURES = "kernel26 apm usbgadget usbhost vfat ext2 screen ethernet"

# NOTE: there are NAND and OneNAND versions of this board...

# do ubiattach /dev/ubi_ctrl -m 4
# From dmesg:
# UBI: smallest flash I/O unit:    2048
# UBI: logical eraseblock size:    129024 bytes
# from ubiattach stdout:
# UBI device number 0, total 1996 LEBs
MKUBIFS_ARGS = "-m 2048 -e 129024 -c 1996"

# do ubiattach /dev/ubi_ctrl -m 4
# from dmesg:
# UBI: smallest flash I/O unit:    2048
# UBI: physical eraseblock size:   131072 bytes (128 KiB)
# UBI: sub-page size:              512
UBINIZE_ARGS = "-m 2048 -p 128KiB -s 512"
```

## conf/machine/am387x-evm.conf
```bitbake
#@TYPE: Machine
#@NAME: AM389x evm
#@DESCRIPTION: Machine configuration for the AM389x evm

require conf/machine/include/ti814x.inc
```

## conf/machine/am389x-evm.conf
```bitbake
#@TYPE: Machine
#@NAME: am389x evm
#@DESCRIPTION: Machine configuration for the am389x evm

require conf/machine/include/ti816x.inc
```

## conf/machine/am45x-evm.conf
```bitbake
#@TYPE: Machine
#@NAME: AM45X EVM
#@DESCRIPTION: Machine configuration for the AM45x EVM

# Currently the am45x-evm machine type mimics the panda
# machine for its configuration.  This is expected to change
# as the hardware and software evolves.  Currently the unique
# machine type is used to differentiate software stack being
# built for the two devices.
require conf/machine/omap4430-panda.conf
```

## conf/machine/amdbarcelona-generic.conf
```bitbake
#@TYPE: Machine
#@NAME: amdbarcelona-generic
#@DESCRIPTION: Machine configuration for a generic AMD64 K10 machine


TARGET_ARCH = "x86_64"
#PACKAGE_EXTRA_ARCHS = "x86_64"

PREFERRED_PROVIDER_virtual/kernel = "linux"
PREFERRED_PROVIDER_virtual/xserver = "xserver-kdrive"
XSERVER="xserver-kdrive-vesa"

KERNEL_IMAGETYPE = "bzImage"

GLIBC_ADDONS = "nptl"
GLIBC_EXTRA_OECONF = "--with-tls"

IMAGE_FSTYPES ?= "ext2.gz"

MACHINE_FEATURES = "kernel26 screen keyboard pci usbhost acpi ext2 amd64"
MACHINE_EXTRA_RRECOMMENDS = " kernel-modules"

#tune for K10 "Barcelona" CPU
require conf/machine/include/tune-barcelona.inc
```

## conf/machine/amsdelta.conf
```bitbake
#@TYPE: Machine
#@NAME: OMAP5910 cpu on an Amstrad E3
#@DESCRIPTION: Machine configuration for the Amstrad E3

TARGET_ARCH = "arm"

PREFERRED_PROVIDER_xserver = "xserver-kdrive"
XSERVER = "xserver-kdrive-fbdev"
PREFERRED_PROVIDER_virtual/kernel = "linux-amsdelta-2.6"

EXTRA_IMAGEDEPENDS += "u-boot linux-amsdelta-2.6"

MACHINE_FEATURES = "screen usbhost usbgadget kernel26 apm alsa"

SERIAL_CONSOLE ?= "115200 ttyS0"
EXTRA_IMAGECMD_jffs2 = "--pad --little-endian --eraseblock=0x40000"

GUI_MACHINE_CLASS="smallscreen"

PREFERRED_VERSION_u-boot = "1.1.4"

require conf/machine/include/tune-arm920t.inc

IMAGE_ROOTFS_SIZE_ext2 = "8192"
IMAGE_ROOTFS_SIZE_ext2.gz = "8192"
IMAGE_FSTYPES = "ext2.gz tar.bz2"
```

## conf/machine/archos5it.conf
```bitbake
#@TYPE: Machine
#@NAME: OMAP3 based Archos 5 IT
#@DESCRIPTION: Machine configuration for the Archos 5 IT (Gen7)

TARGET_ARCH = "arm"
require conf/machine/include/omap3.inc

ASSUME_PROVIDED += "u-boot"

PREFERRED_PROVIDER_virtual/xserver = "xserver-xorg"
XSERVER = "xserver-xorg \
           xf86-input-evdev \
           xf86-input-mouse \
           xf86-input-tslib \
           xf86-video-omapfb \
           xf86-input-keyboard"

#What is the correct one, both seem in use?
MACHINE_GUI_CLASS = "bigscreen"
GUI_MACHINE_CLASS = "bigscreen"

#800 * 480 Widescreen
MACHINE_DISPLAY_WIDTH_PIXELS = "800"
MACHINE_DISPLAY_HEIGHT_PIXELS = "480"

KERNEL_IMAGETYPE = "zImage"

PREFERRED_PROVIDER_virtual/kernel = "linux-omap-archos"

# Ship all kernel modules
MACHINE_EXTRA_RRECOMMENDS = "kernel-modules"

IMAGE_FSTYPES += "tar.bz2"
EXTRA_IMAGECMD_jffs2 = "-lnp "

SERIAL_CONSOLE = "115200 ttyS2"

CMDLINE = "root=/dev/sda1 rw init=/sbin/init console=ttyS2,115200n8 mem=256M nohz=off omapfb.vram=3686400 extrabaud=1000000"

MACHINE_FEATURES = "kernel26 apm alsa bluetooth usbgadget usbhost keyboard vfat ext2 screen touchscreen wifi"
```

## conf/machine/asus730.conf
```bitbake
#@TYPE: Machine
#@NAME: Asus MyPal A730
#@DESCRIPTION: Machine configuration for the asus730 with a pxa27x CPU

#
# Hardware-based properties
#
TARGET_ARCH = "arm"
PACKAGE_EXTRA_ARCHS = "iwmmxt"

# Use tune-xscale per default. Machine independent feeds should be built with tune-strongarm.
require conf/machine/include/tune-xscale.inc

# Uncomment this to use iwmmxt optimizations. Remove the above xscale stuff first
#require conf/machine/include/tune-iwmmxt.inc

ROOT_FLASH_SIZE = "64"
VOLATILE_STORAGE_SIZE = "64"
MACHINE_GUI_CLASS = "bigscreen"
MACHINE_DISPLAY_WIDTH_PIXELS = "480"
MACHINE_DISPLAY_HEIGHT_PIXELS = "640"
MACHINE_FEATURES = "kernel26 touchscreen apm alsa pcmcia bluetooth irda wifi usbgadget screen"

#
# Software/packages selection
#
PREFERRED_PROVIDER_virtual/kernel = "linux-handhelds-2.6"
PCMCIA_MANAGER = "pcmciautils"
MODUTILS = "26"	
XSERVER = "xserver-kdrive"

PREFERRED_VERSION_orinoco-modules = "0.15rc1"


#
# Modules autoload and other boot properties
#

#FIXME: this should be controlled by a userspace utility later.
module_autoload_g_ether = "g_ether"

SERIAL_CONSOLE = "115200 ttyS0"
```

## conf/machine/at2440evb.conf
```bitbake
#@TYPE: Machine
#@Name: Avantech AT2440EVB Dev Board
#@DESCRIPTION: Machine configuration for Avantech AT2440EVB Dev Board


TARGET_ARCH = "arm"

PREFERRED_PROVIDER_virtual/kernel = "linux"

# used by sysvinit_2
SERIAL_CONSOLE = "115200 ttySAC0"

IMAGE_FSTYPES = "tar.gz"
KERNEL_IMAGETYPE = "uImage"
UBOOT_ENTRYPOINT = "30008000"

MACHINE_FEATURES = "kernel26 screen touchscreen"

require conf/machine/include/tune-arm920t.inc
```

## conf/machine/at32stk1000.conf
```bitbake
#@TYPE: Machine
#@Name: Atmel STK1000 AVR32AP7000 Development Platform
#@DESCRIPTION: Atmel STK1000 AVR32AP7000 Development Platform

TARGET_ARCH = "avr32"

PREFERRED_PROVIDER_virtual/kernel = "linux"
PREFERRED_VERSION_linux = "2.6.28"
PREFERRED_PROVIDER_xserver = "xserver-kdrive"

#don't try to access tty1
USE_VT = "0"

MACHINE_FEATURES = "kernel26 alsa ext2 usbgadget touchscreen screen"

# used by sysvinit_2
SERIAL_CONSOLE = "115200 ttyS0"

# used by some images
IMAGE_FSTYPES ?= "tar.bz2 jffs2"
ROOT_FLASH_SIZE = "8"
EXTRA_IMAGECMD_jffs2 = " --big-endian --pagesize=4096 --eraseblock=65536"

KERNEL_IMAGETYPE = "uImage"
PREFERRED_VERSION_u-boot = "2009.01"

UBOOT_MACHINE = "atstk1002_config"
UBOOT_ENTRYPOINT = "0x90000000"
UBOOT_LOADADDRESS = "0x10000000"

require conf/machine/include/tune-at32ap7000.inc
```

## conf/machine/at91-l9260.conf
```bitbake
#@TYPE: Machine
#@Name: Olimex eval board for the AT91SAM9260
#@DESCRIPTION: Machine configuration for the AT91SAM9260 development board with a at91sam9260 processor

TARGET_ARCH = "arm"

PREFERRED_PROVIDER_virtual/kernel = "linux"
PREFERRED_VERSION_linux = "2.6.25"
PREFERRED_PROVIDER_xserver = "xserver-kdrive"

KERNEL_IMAGETYPE = "uImage"

#don't try to access tty1
USE_VT = "0"

MACHINE_FEATURES = "kernel26 alsa ext2 usbhost usbgadget"

# used by sysvinit_2
SERIAL_CONSOLE = "115200 ttyS0"
IMAGE_FSTYPES ?= "jffs2"
EXTRA_IMAGECMD_jffs2 = "--pad --little-endian --eraseblock=0x20000 -n"

require conf/machine/include/tune-arm926ejs.inc
```

## conf/machine/at91cap9adk.conf
```bitbake
#@TYPE: Machine
#@Name: Atmel AT91CAP9ADK Development Platform
#@DESCRIPTION: Machine configuration for the at91cap9adk development board with a at91cap9500 processor

TARGET_ARCH = "arm"

PREFERRED_PROVIDER_virtual/kernel = "linux"
PREFERRED_VERSION_linux = "2.6.28"
PREFERRED_PROVIDER_xserver = "xserver-kdrive"

KERNEL_IMAGETYPE = "uImage"
UBOOT_MACHINE = "at91cap9adk_config"

PREFERRED_VERSION_at91bootstrap = "2.10"

#don't try to access tty1
USE_VT = "0"

MACHINE_FEATURES = "kernel26 alsa ext2 usbhost usbgadget screen touchscreen"
EXTRA_IMAGEDEPENDS += "u-boot"
#EXTRA_IMAGEDEPENDS += "at91bootstrap"

# used by sysvinit_2
SERIAL_CONSOLE = "115200 ttyS0"
IMAGE_FSTYPES ?= "jffs2"
EXTRA_IMAGECMD_jffs2 = "--pad --little-endian --eraseblock=0x20000 -n"

require conf/machine/include/tune-arm926ejs.inc
```

## conf/machine/at91sam9260ek.conf
```bitbake
#@TYPE: Machine
#@Name: Atmel AT91SAM9260EK Development Platform
#@DESCRIPTION: Machine configuration for the at91sam9260ek development board with a at91sam9260 processor

TARGET_ARCH = "arm"
#PACKAGE_EXTRA_ARCHS = "armv4t armv5te"

PREFERRED_PROVIDER_virtual/kernel = "linux"
PREFERRED_VERSION_linux = "2.6.28"

KERNEL_IMAGETYPE = "uImage"
UBOOT_MACHINE = "at91sam9260ek_config"

PREFERRED_VERSION_at91bootstrap = "2.10"

#don't try to access tty1
USE_VT = "0"

MACHINE_FEATURES = "kernel26 alsa ext2 usbhost usbgadget"
EXTRA_IMAGEDEPENDS += "u-boot"
EXTRA_IMAGEDEPENDS += "at91bootstrap"

# used by sysvinit_2
SERIAL_CONSOLE = "115200 ttyS0"
IMAGE_FSTYPES ?= "jffs2"
EXTRA_IMAGECMD_jffs2 = "--pad --little-endian --eraseblock=0x20000 -n"

require conf/machine/include/tune-arm926ejs.inc
```

## conf/machine/at91sam9263ek.conf
```bitbake
#@TYPE: Machine
#@Name: Atmel AT91SAM9263EK Development Platform
#@DESCRIPTION: Machine configuration for the at91sam9263ek development board with a at91sam9263 processor

TARGET_ARCH = "arm"

PREFERRED_PROVIDER_virtual/kernel = "linux"
PREFERRED_PROVIDER_xserver = "xserver-kdrive"

#don't try to access tty1
USE_VT = "0"

MACHINE_FEATURES = "kernel26 alsa ext2 usbhost usbgadget screen"

# used by sysvinit_2
SERIAL_CONSOLE = "115200 ttyS0"
IMAGE_FSTYPES ?= "jffs2"
EXTRA_IMAGECMD_jffs2 = "--pad --little-endian --eraseblock=0x20000 -n"

require conf/machine/include/tune-arm926ejs.inc

KERNEL_IMAGETYPE = "uImage"
```

## conf/machine/at91sam9g10ek.conf
```bitbake
#@TYPE: Machine
#@Name: Atmel AT91SAM9G10EK Development Platform
#@DESCRIPTION: Machine configuration for the at91sam9g10ek development board with a at91sam9g10 processor

include conf/machine/include/at91-2.6.30.inc
include conf/machine/include/at91-lcd.inc

UBOOT_MACHINE = "at91sam9g10ek_dataflash_cs0_config"
AT91BOOTSTRAP_BOARD = "at91sam9g10ek at91sam9g10df at91sam9g10nf"

MACHINE_FEATURES += "usbhost"
```

## conf/machine/at91sam9g20ek.conf
```bitbake
#@TYPE: Machine
#@Name: Atmel AT91SAM9G20EK Development Platform
#@DESCRIPTION: Machine configuration for the at91sam9g20ek development board with a at91sam9g20 processor

include conf/machine/include/at91-2.6.30.inc

# UBOOT_MACHINE = "at91sam9g20ek_nandflash_config"
# UBOOT_MACHINE = "at91sam9g20ek_dataflash_cs0_config"
# UBOOT_MACHINE = "at91sam9g20ek_dataflash_cs1_config"
# UBOOT_MACHINE = "at91sam9g20ek_config"

UBOOT_MACHINES = " \
	at91sam9g20ek_nandflash \
	at91sam9g20ek_dataflash_cs0 \
	at91sam9g20ek_dataflash_cs1 \
	at91sam9g20ek \
	"

AT91BOOTSTRAP_BOARD = "at91sam9g20ek at91sam9g20df at91sam9g20nf at91sam9g20sd"

MACHINE_FEATURES += "usbhost"
```

## conf/machine/at91sam9g20ek_2mmc.conf
```bitbake
#@TYPE: Machine
#@Name: Atmel AT91SAM9G20EK Development Platform
#@DESCRIPTION: Machine configuration for the at91sam9g20ek development board with a at91sam9g20 processor

include conf/machine/include/at91-2.6.39a.inc

UBOOT_MACHINES = " \
	at91sam9g20ek_2mmc_nandflash \
	at91sam9g20ek_2mmc_dataflash_cs0 \
	at91sam9g20ek_2mmc_dataflash_cs1 \
	at91sam9g20ek_2mmc_sd \
	at91sam9g20ek_2mmc \
	"

AT91BOOTSTRAP_BOARD = " \
	at91sam9g20ek_2mmc \
	at91sam9g20ek_2mmcdfc \
	at91sam9g20ek_2mmcdf \
	at91sam9g20ek_2mmcnf \
	at91sam9g20ek_2mmcsd \
	"

MACHINE_FEATURES += "usbhost"
```

## conf/machine/at91sam9g35ek.conf
```bitbake
#@TYPE: Machine
#@Name: Atmel AT91SAM9x5EK Development Platform
#@DESCRIPTION: Machine configuration for the at91sam9x5ek board with a at91sam9g35 CPU module

include conf/machine/include/at91-2.6.39.inc
include conf/machine/include/at91-xserver-xorg.inc

# Has linux config file in OpenEmbedded
#
# LINUX26_DEFCONFIG = "at91sam9g45ek_defconfig"
# LINUX26_DEFCONFIG = "at91sam9g35ek_defconfig"

# Supported u-boot machines
UBOOT_MACHINES = "\
		at91sam9x5ek_nandflash	\
		at91sam9x5ek_dataflash	\
		at91sam9x5ek		\
		"

AT91BOOTSTRAP_BOARD = " at91sam9x5df_defconfig \
			at91sam9x5nf_defconfig \
			at91sam9x5sd_defconfig \
			at91sam9x5sduboot_defconfig \
			"

#800 * 480 Widescreen
MACHINE_DISPLAY_WIDTH_PIXELS = "800"
MACHINE_DISPLAY_HEIGHT_PIXELS = "480"
MACHINE_GUI_CLASS = "bigscreen"

MACHINE_FEATURES += "usbhost"
```

## conf/machine/at91sam9g45ek.conf
```bitbake
#@TYPE: Machine
#@Name: Atmel AT91SAM9G45EK Development Platform
#@DESCRIPTION: Machine configuration for the at91sam9g45ek development board with a at91sam9g45-ES2 processor
# Once a at91sam9g45ek development board with a production at91sam9g45 processor
# is available we should change the recipe to use the at91sam9m10g45ek_defconfig

include conf/machine/include/AT91-LCD.inc

# Has linux config file in OpenEmbedded
# 
# LINUX26_DEFCONFIG = "at91sam9g45ek_defconfig"
# LINUX26_DEFCONFIG = "at91sam9m10g45ek_defconfig"

# Supported u-boot machines
#UBOOT_MACHINE = "at91sam9m10g45ek_nandflash_config"
#UBOOT_MACHINE = "at91sam9m10g45ek_dataflash_config"
UBOOT_MACHINE = "at91sam9m10g45ek_dataflash_cs0_config"
#UBOOT_MACHINE = "at91sam9m10g45ek_config"
#UBOOT_MACHINE = "at91sam9g45ekes_nandflash_config"
#UBOOT_MACHINE = "at91sam9g45ekes_dataflash_config"
#UBOOT_MACHINE = "at91sam9g45ekes_dataflash_cs0_config"
#UBOOT_MACHINE = "at91sam9g45ekes_config"

# Boot from Dataflash, so we do not have to reprogram
# At91bootstrap/U-Boot everytime we erase the NAND flash
AT91BOOTSTRAP_BOARD = "at91sam9g45df"

MACHINE_FEATURES += "usbhost"
```
