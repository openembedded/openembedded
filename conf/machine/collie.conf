## conf/machine/collie.conf
```bitbake
#@TYPE: Machine
#@NAME: Sharp Zaurus SL-5000, Sharp Zaurus SL-5500
#@DESCRIPTION: Machine configuration for the SA1100 based Sharp Zaurus SL-5000 and SL-5500 devices

require conf/machine/include/zaurus-2.6.inc
require conf/machine/include/tune-strongarm.inc

ROOT_FLASH_SIZE = "14"
# actually 14680064
EXTRA_IMAGECMD_jffs2 = "--pad=14680064 --little-endian --eraseblock=0x20000 -n"

MACHINE_GUI_CLASS = "smallscreen"
MACHINE_DISPLAY_WIDTH_PIXELS = "240"
MACHINE_DISPLAY_HEIGHT_PIXELS = "320"
MACHINE_DISPLAY_ORIENTATION = "270"
MACHINE_DISPLAY_PPI = "114"
```

## conf/machine/compulab-pxa270.conf
```bitbake
#@TYPE: Machine
#@Name: Compulab PXA270 system
#@DESCRIPTION: Machine configuration for Compulab PXA270 system
#OLDEST_KERNEL = "2.6.16"
TARGET_ARCH = "arm"
PREFERRED_VERSION_compulab-pxa270 = "2.6.22"
GUI_MACHINE_CLASS ?= "bigscreen"

PREFERRED_PROVIDER_virtual/kernel = "${MACHINE}"
PACKAGE_EXTRA_ARCHS = "armv4 armv5te"

require conf/machine/include/tune-xscale.inc

# used by sysvinit_2 package, so rebuild this
# package if you change the SERIAL_CONSOLE setting
# the following is the for the cm-x270 L module
# I think the W module would use ttyS0, but has
# not been tested.  This can be overwritten in 
# local.conf
SERIAL_CONSOLE ?= "38400 ttyS1"

# used by opie-collections.inc
ROOT_FLASH_SIZE ?= "32"

# for NAND flash.
EXTRA_IMAGECMD_jffs2 = "--little-endian --eraseblock=0x20000 --pad=0x20000 --no-cleanmarkers;\
	sumtool -i ${DEPLOY_DIR_IMAGE}/${IMAGE_NAME}.rootfs.jffs2 \
	-o ${DEPLOY_DIR_IMAGE}/${IMAGE_NAME}.rootfs-summary.jffs2 \
	-e 0x20000 -p; \
	cd ${DEPLOY_DIR_IMAGE}; \
	rm -f ${DEPLOY_DIR_IMAGE}/${IMAGE_LINK_NAME}.rootfs-summary.jffs2; \
	ln -s ${IMAGE_NAME}.rootfs-summary.jffs2 ${IMAGE_LINK_NAME}.rootfs-summary.jffs2 \
	"

MACHINE_FEATURES = "kernel26 pcmcia usbhost usbgadget pcmcia touchscreen alsa"

# to program the compulab NAND flash, the following scheme is suggested.  Create
# a small rootfs that can fit in NOR flash using the following config:
#   - Angstrom distro
#   - uclibc
#   - angstrom-minimal-image-with-mtd-utils bitbake target
#   - put the following in your local.conf
#     - IMAGE_FSTYPES = "jffs2 tar cpio.gz"
# now, when you build the image, a cpio.gz will be generated
# that can be used as an initramfs.  You can boot into this image and then
# program the main rootfs jffs2 image in NAND flash using mtd-utils
```

## conf/machine/corgi.conf
```bitbake
WARNING:="${@bb.fatal('\n*\n*\n*    Sorry, There is no dedicated configuration for the Sharp SL-C700,\n*    because \
of the similarities of the clamshell series. Use MACHINE = \"c7x0\".\n*\n*\n')}"
```

## conf/machine/cs-e9302.conf
```bitbake
#@TYPE: Machine
#@Name: Olimex CS-E9302 Development Platform
#@DESCRIPTION: Machine configuration for Olimex CS-E9302 Development Platform

TARGET_ARCH = "arm"

PREFERRED_PROVIDER_virtual/kernel = "linux"

#don't try to access tty1
USE_VT = "0"

MACHINE_FEATURES = "kernel26 apm alsa ext2 usbhost"

# used by sysvinit_2
SERIAL_CONSOLE = "57600 ttyAM0"

# used by some images
ROOT_FLASH_SIZE = "8"
#extra jffs2 tweaks
EXTRA_IMAGECMD_jffs2 = "--eraseblock=0x40000 --pad=0x500000 "

require conf/machine/include/tune-arm920t.inc
```

## conf/machine/cyclone3_starter.conf
```bitbake
#@TYPE: Machine
#@NAME: Altera Cyclone III FPGA Starter 
#@DESCRIPTION: Machine configuration for a Altera Cyclone III FPGA Starter Kit

TARGET_ARCH = "nios2"

require conf/machine/include/nios2.inc
```

## conf/machine/d201gly2.conf
```bitbake
# Copyright (C) 2007, Stelios Koroneos - Digital OPSiS, All Rights Reserved
# Released under the MIT license (see packages/COPYING)
#@TYPE: Machine
#@NAME: D201GLY2 
#@DESCRIPTION: Machine configuration for Intel D201GLY2 board


TARGET_ARCH = "i686"

PREFERRED_PROVIDER_virtual/kernel = "linux"
KERNEL_IMAGETYPE = "bzImage"
OLDEST_KERNEL = "2.6.17"

PREFERRED_PROVIDER_virtual/xserver = "xserver-kdrive"
XSERVER="xserver-kdrive-sis"


GLIBC_ADDONS = "nptl"
GLIBC_EXTRA_OECONF = "--with-tls"


IMAGE_FSTYPES = "ext2.gz"

MACHINE_FEATURES = "kernel26 screen keyboard pci usbhost acpi ext2"
MACHINE_EXTRA_RRECOMMENDS = " kernel-modules"
MACHINE_TASK_PROVIDER = "task-base"

udevdir = "/dev"


#tune for P4 celeron cpu
require conf/machine/include/tune-pentium4c.inc
```

## conf/machine/da830-omapl137-evm.conf
```bitbake
#@TYPE: Machine
#@NAME: DA830 CPUs on a DA830/OMAPL137 EVM board
#@DESCRIPTION: Machine configuration for the TI DA830/OMAPL137 EVM board

require conf/machine/include/davinci.inc
require conf/machine/include/omapl137.inc

UBOOT_MACHINE = "da830_omapl137_evm_config"
UBOOT_ENTRYPOINT = "0xc0008000"
UBOOT_LOADADDRESS = "0xc0008000"

MACHINE_FEATURES = "kernel26 serial ethernet"

SERIAL_CONSOLE = "115200 ttyS2"
```

## conf/machine/da850-omapl138-evm.conf
```bitbake
#@TYPE: Machine
#@NAME: DA850 CPUs on a DA850/OMAPL138 EVM board
#@DESCRIPTION: Machine configuration for the TI DA850/OMAPL138 EVM board

require conf/machine/include/davinci.inc
require conf/machine/include/omapl138.inc

UBOOT_MACHINE = "da850_omapl138_evm_config"
UBOOT_ENTRYPOINT = "0xc0008000"
UBOOT_LOADADDRESS = "0xc0008000"

MACHINE_FEATURES = "kernel26 serial ethernet"

# do ubiattach /dev/ubi_ctrl -m 4
# From dmesg:
# UBI: smallest flash I/O unit:    2048
# UBI: logical eraseblock size:    129024 bytes
# from ubiattach stdout:
# UBI device number 0, total 971 LEBs (125282304 bytes, 119.5 MiB), available 958 LEBs
MKUBIFS_ARGS = "-m 2048 -e 129024 -c 950"

# do ubiattach /dev/ubi_ctrl -m 4
# from dmesg:
# UBI: smallest flash I/O unit:    2048
# UBI: physical eraseblock size:   131072 bytes (128 KiB)
# UBI: sub-page size:              512
UBINIZE_ARGS = "-m 2048 -p 128KiB -s 512"

SERIAL_CONSOLE = "115200 ttyS2"
```

## conf/machine/davinci-dvevm.conf
```bitbake
#@TYPE: Machine
#@NAME: DM6446 cpu on a Davinci EVM board
#@DESCRIPTION: Machine configuration for the TI Davinci EVM board

TARGET_ARCH = "arm"

HOTPLUG = "udev"

PREFERRED_PROVIDER_xserver = "xserver-kdrive"
PREFERRED_PROVIDER_virtual/kernel = "linux-davinci"
PREFERRED_PROVIDERS += "virtual/${TARGET_PREFIX}depmod:module-init-tools-cross"

#PREFERRED_VERSION_u-boot = "1.3.2"
UBOOT_MACHINE = "davinci_dvevm_config"
UBOOT_ENTRYPOINT="0x80008000"

SERIAL_CONSOLE ?= "115200 ttyS0"
EXTRA_IMAGECMD_jffs2 = "--pad --little-endian --eraseblock=0x20000 -n"

#ROOT_FLASH_SIZE = "29"

MACHINE_FEATURES = "kernel26 pcmcia usbhost alsa"

MACHINE_EXTRA_RDEPENDS = "dsplink"
MACHINE_EXTRA_RRECOMMENDS = "dsplink-module"

require conf/machine/include/tune-arm926ejs.inc
```

## conf/machine/davinci-sffsdr.conf
```bitbake
#@TYPE: Machine
#@NAME: DM6446 cpu on a Lyrtech Small Form Factor SDR board
#@DESCRIPTION: Machine configuration for the Lyrtech Small Form Factor SDR board

TARGET_ARCH = "arm"

HOTPLUG = "udev"

PREFERRED_PROVIDER_virtual/kernel = "linux-davinci"
PREFERRED_PROVIDERS += "virtual/${TARGET_PREFIX}depmod:module-init-tools-cross"

PREFERRED_VERSION_u-boot = "git"
UBOOT_MACHINE = "davinci_sffsdr_config"

KERNEL_IMAGETYPE = "uImage"

UBOOT_ENTRYPOINT = "0x80008000"
UBOOT_LOADADDRESS = "0x80008000"

SERIAL_CONSOLE ?= "115200 ttyS0"
EXTRA_IMAGECMD_jffs2 = "--pad --little-endian --eraseblock=0x20000 -n"

#ROOT_FLASH_SIZE = "29"

MACHINE_FEATURES = "kernel26 serial"

#MACHINE_EXTRA_RDEPENDS = "dsplink"
#MACHINE_EXTRA_RRECOMMENDS = "dsplink-module"

require conf/machine/include/tune-arm926ejs.inc
require conf/machine/include/dm6446.inc
```

## conf/machine/db1200.conf
```bitbake
# Alchemy db1200

TARGET_ARCH = "mipsel"

PREFERRED_PROVIDERS += " virtual/${TARGET_PREFIX}depmod:module-init-tools-cross"

PREFERRED_PROVIDER_virtual/kernel = "linux"
KERNEL_IMAGETYPE = "vmlinux.srec"

SERIAL_CONSOLE="/dev/ttyS0 115200 vt100"
USE_VT="0"

TARGET_CC_ARCH="-march=mips32"

FLASH_OFFSET="0xBC000000"
# The NAND has an eraseblock of 0x4000 (16kB) and NOR with 0x20000 (128kB)
ERASEBLOCK_SIZE = "0x20000"
EXTRA_IMAGECMD_jffs2 = "--little-endian --no-cleanmarkers --eraseblock=${ERASEBLOCK_SIZE}"

MACHINE_FEATURES = "kernel26 pcmcia usbhost"
```

## conf/machine/devkitidp-pxa255.conf
```bitbake
#@TYPE: Machine
#@Name: BSQUARE PXA255 DevKitIDP Development Platform
#@DESCRIPTION: Machine configuration for PXA255 DevKitIDP 

TARGET_ARCH = "arm"

GUI_MACHINE_CLASS = "bigscreen"

PREFERRED_PROVIDER_virtual/bootloader = "u-boot"
PREFERRED_PROVIDER_virtual/kernel = "${MACHINE}"
PREFERRED_VERSION_u-boot = "1.1.6"
UBOOT_MACHINE = "pxa255_idp_config"

require conf/machine/include/tune-xscale.inc

# used by sysvinit_2
SERIAL_CONSOLE = "115200 ttyS0"

# used by opie-collections.inc
ROOT_FLASH_SIZE = "32"

MACHINE_FEATURES = "kernel26 pcmcia usbhost usbgadget pcmcia touchscreen alsa"
```

## conf/machine/dht-walnut.conf
```bitbake
# Copyright (C) 2007, Stelios Koroneos - Digital OPSiS, All Rights Reserved
# Released under the MIT license (see packages/COPYING)
#@TYPE: Machine
#@Name: DHT-Walnut Development Platform
#@DESCRIPTION: Machine configuration for the DHT-Walnut 405GP  development platform

TARGET_ARCH = "powerpc"
PACKAGE_EXTRA_ARCHS = "ppc ppc405"

PREFERRED_PROVIDER_virtual/kernel = "linux-${MACHINE}"
UBOOT_ENTRYPOINT = "0"

MACHINE_FEATURES = "kernel26 ext2"

TARGET_CPU = "405"

#don't try to access tty1
USE_VT = "0"

SERIAL_CONSOLE = "115200 ttyS0"

PREFERRED_VERSION_u-boot = "1.1.4"
KERNEL_IMAGETYPE = "uImage"

#tune for the 405 cpu
require conf/machine/include/tune-ppc405.inc
```

## conf/machine/dm355-evm.conf
```bitbake
#@TYPE: Machine
#@NAME: DM355 CPUs on a Davinci DM355 EVM board
#@DESCRIPTION: Machine configuration for the TI Davinci DM355 EVM board

require conf/machine/include/davinci.inc
require conf/machine/include/dm355.inc

UBOOT_MACHINE = "davinci_dm355_evm_config"
```

## conf/machine/dm355-leopard.conf
```bitbake
#@TYPE: Machine
#@NAME: Leopard "beagle buddy" DM355 based IP cam board
#@DESCRIPTION: Machine configuration for the DM355 leopard board

require conf/machine/include/davinci.inc
require conf/machine/include/dm355.inc

TARGET_ARCH = "arm"

UBOOT_MACHINE = "davinci_dm355leopard_config"
UBOOT_ENTRYPOINT = "0x80008000"

SERIAL_CONSOLE ?= "115200 ttyS0"

MACHINE_FEATURES = "kernel26 alsa ethernet usbhost usbgadget mmc"
```

## conf/machine/dm357-evm.conf
```bitbake
#@TYPE: Machine
#@NAME: DM357 CPUs on a Davinci DM357 EVM board
#@DESCRIPTION: Machine configuration for the TI Davinci DM357 EVM board

require conf/machine/include/davinci.inc

UBOOT_MACHINE = "davinci_dvevm_config"
```

## conf/machine/dm365-evm.conf
```bitbake
#@TYPE: Machine
#@NAME: DM365 CPUs on a Davinci DM365 EVM board
#@DESCRIPTION: Machine configuration for the TI Davinci DM365 EVM board

require conf/machine/include/davinci.inc
require conf/machine/include/dm365.inc

UBOOT_MACHINE = "davinci_dm365_evm_config"
```

## conf/machine/dm368-evm.conf
```bitbake
#@TYPE: Machine
#@NAME: DM368 CPUs on a Davinci DM368 EVM board
#@DESCRIPTION: Machine configuration for the TI Davinci DM368 EVM board

require conf/machine/include/davinci.inc
require conf/machine/include/dm365.inc

UBOOT_MACHINE = "davinci_dm365_evm_config"
```

## conf/machine/dm3730-am3715-evm.conf
```bitbake
#@TYPE: Machine
#@NAME: DM37x/AM37x EVM
#@DESCRIPTION: Machine configuration for the TI DM37x/AM37x EVM
TARGET_ARCH = "arm"

PREFERRED_PROVIDER_virtual/xserver = "xserver-xorg"
XSERVER = "xserver-xorg \
           xf86-input-evdev \
           xf86-input-mouse \
           xf86-input-tslib \
           xf86-video-omapfb \
           xf86-input-keyboard"

GUI_MACHINE_CLASS = "smallscreen"

require conf/machine/include/omap3.inc

# Ship all kernel modules

IMAGE_FSTYPES ?= "jffs2 tar.bz2"
EXTRA_IMAGECMD_jffs2 = "-lnp "

SERIAL_CONSOLE = "115200 ttyS0"

PREFERRED_PROVIDER_virtual/kernel = "linux-omap-psp"

PREFERRED_PROVIDER_virtual/bootloader = "u-boot"
PREFERRED_VERSION_u-boot = "git"

UBOOT_ARCH = "arm"
UBOOT_MACHINE = "omap3_evm_config"

MACHINE_FEATURES = "kernel26 apm usbgadget usbhost vfat ext2 screen touchscreen"

# NOTE: there are NAND and OneNAND versions of this board...

# do ubiattach /dev/ubi_ctrl -m 4
# From dmesg:
# UBI: smallest flash I/O unit:    2048
# UBI: logical eraseblock size:    129024 bytes
# from ubiattach stdout:
# UBI device number 0, total 1996 LEBs
MKUBIFS_ARGS = "-m 2048 -e 129024 -c 1996"

# do ubiattach /dev/ubi_ctrl -m 4
# from dmesg:
# UBI: smallest flash I/O unit:    2048
# UBI: physical eraseblock size:   131072 bytes (128 KiB)
# UBI: sub-page size:              512
UBINIZE_ARGS = "-m 2048 -p 128KiB -s 512"
```

## conf/machine/dm500hd.conf
```bitbake
#@TYPE: Machine
#@NAME: Dreambox DM500HD
#@DESCRIPTION: Machine configuration for the Dreambox DM500HD

TARGET_ARCH = "mipsel"
IPKG_ARCHS = "all mipsel ${MACHINE}"
PREFERRED_PROVIDER_avahi = "avahi"
PREFERRED_PROVIDER_xserver = "xserver-kdrive"
PREFERRED_PROVIDER_virtual/kernel = "linux-dm8000"
BOOTSTRAP_EXTRA_DEPENDS = "virtual/kernel dreambox-dvb-modules"
BOOTSTRAP_EXTRA_RDEPENDS = "kernel dreambox-dvb-modules \
	kernel-module-exportfs \
	kernel-module-reiserfs \
	kernel-module-sd-mod \
	kernel-module-sg \
	kernel-module-sr-mod \
	kernel-module-usbhid \
	kernel-module-usbmon \
	kernel-module-xfs"



TARGET_FPU = "soft"
#OLDEST_KERNEL = "2.6.9"

PREFERRED_PROVIDERS += " virtual/${TARGET_PREFIX}gcc-initial:gcc-cross-initial"
PREFERRED_PROVIDERS += " virtual/${TARGET_PREFIX}gcc:gcc-cross"
PREFERRED_PROVIDERS += " virtual/${TARGET_PREFIX}g++:gcc-cross"
PREFERRED_PROVIDERS += " virtual/${TARGET_PREFIX}libc-for-gcc:glibc"

PREFERRED_VERSION_glibc = "2.3.5+cvs20051107"
PREFERRED_VERSION_gcc-cross-initial = "3.4.5"
PREFERRED_VERSION_gcc-cross = "4.1.1"
PREFERRED_VERSION_gcc-cross-sdk = "4.1.1" 
PREFERRED_VERSION_gcc = "4.1.1"
PREFERRED_VERSION_binutils-cross = "2.16.1"
PREFERRED_VERSION_binutils-cross-sdk = "2.16.1"
PREFERRED_VERSION_binutils = "2.16.1"
PREFERRED_VERSION_linux-libc-headers = "2.6.12.0"
GLIBC_ADDONS = "nptl"
GLIBC_EXTRA_OECONF = "--disable-profile --with-tls --without-fp --with-__thread"

EXTRA_IMAGEDEPENDS += "dreambox-secondstage dreambox-buildimage-native"
EXTRA_IMAGECMD_jffs2 = " --eraseblock=0x4000 -n -l "
IMAGE_CMD_jffs2 = "mkfs.jffs2 --root=${IMAGE_ROOTFS}/boot --faketime \
       --output=${DEPLOY_DIR_IMAGE}/${IMAGE_NAME}.boot.jffs2 \
       ${EXTRA_IMAGECMD}; rm -rf ${IMAGE_ROOTFS}/boot/*; \
				mkfs.jffs2 --root=${IMAGE_ROOTFS} --faketime \
       --output=${DEPLOY_DIR_IMAGE}/${IMAGE_NAME}.rootfs.jffs2 \
       ${EXTRA_IMAGECMD}; \
       buildimage ${STAGING_LIBDIR}/dreambox-secondstage/main.bin.gz \
       ${DEPLOY_DIR_IMAGE}/${IMAGE_NAME}.boot.jffs2 \
       ${DEPLOY_DIR_IMAGE}/${IMAGE_NAME}.rootfs.jffs2 \
       ${MACHINE} 64 \
       > ${DEPLOY_DIR_IMAGE}/${IMAGE_NAME}.nfi"
```
