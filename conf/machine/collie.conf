## conf/machine/dm600pvr.conf
```bitbake
TARGET_ARCH = "powerpc"
IPKG_ARCHS = "all powerpc ${MACHINE}"
PREFERRED_PROVIDER_xserver = "xserver-kdrive"
PREFERRED_PROVIDER_virtual/kernel = "linux-dm600pvr"
BOOTSTRAP_EXTRA_DEPENDS = "virtual/kernel dreambox-dvb-modules"
BOOTSTRAP_EXTRA_RDEPENDS = "kernel dreambox-dvb-modules"

TARGET_FPU = "soft"
TARGET_CPU = "405"
OLDEST_KERNEL = "2.6.12"

PREFERRED_PROVIDERS += " virtual/${TARGET_PREFIX}gcc-initial:gcc-cross-initial"
PREFERRED_PROVIDERS += " virtual/${TARGET_PREFIX}gcc:gcc-cross"
PREFERRED_PROVIDERS += " virtual/${TARGET_PREFIX}g++:gcc-cross"
PREFERRED_PROVIDERS += " virtual/${TARGET_PREFIX}libc-for-gcc:glibc"

PREFERRED_VERSION_glibc = "2.3.5+cvs20050627"
PREFERRED_VERSION_glibc-initial = "2.3.2+cvs20040726"
PREFERRED_VERSION_gcc-cross-initial = "3.4.4"
PREFERRED_VERSION_gcc-cross = "3.4.4"
PREFERRED_VERSION_gcc-cross-sdk = "3.4.4" 
PREFERRED_VERSION_gcc = "3.4.4"
PREFERRED_VERSION_binutils-cross = "2.15.94.0.1"
PREFERRED_VERSION_binutils-cross-sdk = "2.15.94.0.1"
PREFERRED_VERSION_binutils = "2.15.94.0.1"
PREFERRED_VERSION_busybox = "1.01"

GLIBC_ADDONS = "nptl"
GLIBC_EXTRA_OECONF = "--with-tls --without-fp --with-__thread"

EXTRA_IMAGEDEPENDS += "dreambox-secondstage dreambox-buildimage-native"
EXTRA_IMAGECMD_jffs2 = " --eraseblock=0x4000 -n -b "
IMAGE_CMD_jffs2 = "mkfs.jffs2 --root=${IMAGE_ROOTFS}/boot --faketime \
       --output=${DEPLOY_DIR_IMAGE}/${IMAGE_NAME}.boot.jffs2 \
       ${EXTRA_IMAGECMD}; rm -rf ${IMAGE_ROOTFS}/boot/*; \
				mkfs.jffs2 --root=${IMAGE_ROOTFS} --faketime \
       --output=${DEPLOY_DIR_IMAGE}/${IMAGE_NAME}.rootfs.jffs2 \
       ${EXTRA_IMAGECMD}; \
       buildimage ${STAGING_LIBDIR}/dreambox-secondstage/main.bin.gz \
       ${DEPLOY_DIR_IMAGE}/${IMAGE_NAME}.boot.jffs2 \
       ${DEPLOY_DIR_IMAGE}/${IMAGE_NAME}.rootfs.jffs2 \
       > ${DEPLOY_DIR_IMAGE}/${IMAGE_NAME}.nfi"
```

## conf/machine/dm6446-evm.conf
```bitbake
#@TYPE: Machine
#@NAME: DM644x CPUs on a Davinci DM6446 EVM board
#@DESCRIPTION: Machine configuration for the TI Davinci DM6446 EVM board

require conf/machine/include/davinci.inc
require conf/machine/include/dm6446.inc

UBOOT_MACHINE = "davinci_dvevm_config"
```

## conf/machine/dm6467-evm.conf
```bitbake
#@TYPE: Machine
#@NAME: DM646x CPUs on a Davinci HD DM6467 EVM board
#@DESCRIPTION: Machine configuration for the TI Davinci HD DM6467 EVM board

require conf/machine/include/davinci.inc
require conf/machine/include/dm6467.inc

UBOOT_MACHINE = "davinci_dm6467_evm_config"
```

## conf/machine/dm6467t-evm.conf
```bitbake
#@TYPE: Machine
#@NAME: DM646x CPUs 1GHz on a Davinci HD DM6467T EVM board
#@DESCRIPTION: Machine configuration for the TI Davinci HD DM6467T 1GHz EVM board

require conf/machine/include/davinci.inc
require conf/machine/include/dm6467.inc

UBOOT_MACHINE = "davinci_dm6467_evm_config"
```

## conf/machine/dm7025.conf
```bitbake
#@TYPE: Machine
#@NAME: Dreambox DM7025
#@DESCRIPTION: Machine configuration for the Dreambox DM7025

TARGET_ARCH = "mipsel"
IPKG_ARCHS = "all mipsel ${MACHINE}"
PREFERRED_PROVIDER_xserver = "xserver-kdrive"
PREFERRED_PROVIDER_virtual/kernel = "linux-dm7025"
BOOTSTRAP_EXTRA_DEPENDS = "virtual/kernel dreambox-dvb-modules gst-plugin-dvbmediasink \
	gst-plugin-fluendo-mpegdemux"
BOOTSTRAP_EXTRA_RDEPENDS = "kernel dreambox-dvb-modules kernel-module-stv0299 \
	kernel-module-cdrom	kernel-module-cifs	kernel-module-exportfs \
	kernel-module-ide-cd kernel-module-reiserfs kernel-module-sd-mod \
	kernel-module-sg	kernel-module-sr-mod \
	kernel-module-xfs kernel-module-autofs4 kernel-module-msdos kernel-module-vfat \
	kernel-module-fat	gst-plugin-dvbmediasink gst-plugin-fluendo-mpegdemux "

BOOTSTRAP_EXTRA_RDEPENDS += ${@bb.data.getVar('DISTRO_VERSION', d, 1) != "1.4.0" and "kernel-module-squashfs kernel-module-sqlzma kernel-module-unlzma kernel-module-loop unionfs-modules dreambox-boottool " or " "}

TARGET_FPU = "soft"
OLDEST_KERNEL = "2.6.9"

PREFERRED_PROVIDERS += " virtual/${TARGET_PREFIX}gcc-initial:gcc-cross-initial"
PREFERRED_PROVIDERS += " virtual/${TARGET_PREFIX}gcc:gcc-cross"
PREFERRED_PROVIDERS += " virtual/${TARGET_PREFIX}g++:gcc-cross"
PREFERRED_PROVIDERS += " virtual/${TARGET_PREFIX}libc-for-gcc:glibc"

#PREFERRED_VERSION_glibc = "2.3.5+cvs20050627"
#PREFERRED_VERSION_gcc-cross-initial = "3.4.5"
#PREFERRED_VERSION_gcc-cross = "3.4.5"
#PREFERRED_VERSION_gcc-cross-sdk = "3.4.5"
#PREFERRED_VERSION_gcc = "3.4.5"
#PREFERRED_VERSION_binutils-cross = "2.15.94.0.1"
#PREFERRED_VERSION_binutils-cross-sdk = "2.15.94.0.1"
#PREFERRED_VERSION_binutils = "2.15.94.0.1"
#PREFERRED_VERSION_linux-libc-headers = "2.6.11.1"

PREFERRED_VERSION_glibc = "2.3.5+cvs20051107"
PREFERRED_VERSION_gcc-cross-initial = "3.4.5"
PREFERRED_VERSION_gcc-cross = "4.1.1"
PREFERRED_VERSION_gcc-cross-sdk = "4.1.1"
PREFERRED_VERSION_gcc = "4.1.1"
PREFERRED_VERSION_gdb = "6.6.50.20061209"
PREFERRED_VERSION_gdb-cross = "6.6.50.20061209"
PREFERRED_VERSION_binutils-cross = "2.16.1"
PREFERRED_VERSION_binutils-cross-sdk = "2.16.1"
PREFERRED_VERSION_binutils = "2.16.1"
PREFERRED_VERSION_linux-libc-headers = "2.6.12.0"
GLIBC_ADDONS = "nptl"
GLIBC_EXTRA_OECONF = "--disable-profile --with-tls --without-fp --with-__thread"
#JAVA_mipsel = ",java"

EXTRA_IMAGEDEPENDS += "dreambox-secondstage dreambox-buildimage-native"
EXTRA_IMAGECMD_jffs2 = " --eraseblock=0x4000 -n -l "

KERNEL_VERSION = 2.6.12.6

IMAGE_CMD_jffs2 = "\
	if [ "${@bb.data.getVar('DISTRO_VERSION', d, 1)}" != "1.4.0" ]; \
	then \
		install -d ${DEPLOY_DIR_IMAGE}/boot_tmp; \
		for i in bin dev mnt/flash mnt/squashfs mnt/root; \
		do \
			install -d ${IMAGE_ROOTFS}/boot/$i; \
		done; \
		install -d ${IMAGE_ROOTFS}/boot/lib/modules/${KERNEL_VERSION}/kernel/fs; \
		install -d ${IMAGE_ROOTFS}/boot/lib/modules/${KERNEL_VERSION}/kernel/drivers/block; \
		mv ${IMAGE_ROOTFS}/lib/modules/${KERNEL_VERSION}/kernel/fs/squashfs \
			${IMAGE_ROOTFS}/boot/lib/modules/${KERNEL_VERSION}/kernel/fs; \
		mv ${IMAGE_ROOTFS}/lib/modules/${KERNEL_VERSION}/kernel/fs/unionfs.ko \
			${IMAGE_ROOTFS}/boot/lib/modules/${KERNEL_VERSION}/kernel/fs; \
		mv ${IMAGE_ROOTFS}/lib/modules/${KERNEL_VERSION}/kernel/drivers/block/loop.ko \
			${IMAGE_ROOTFS}/boot/lib/modules/${KERNEL_VERSION}/kernel/drivers/block; \
		mkfs.jffs2 --root=${IMAGE_ROOTFS}/boot --faketime \
			--output=${DEPLOY_DIR_IMAGE}/${IMAGE_NAME}.boot.jffs2 \
			${EXTRA_IMAGECMD}; \
		mv ${IMAGE_ROOTFS}/boot/* ${DEPLOY_DIR_IMAGE}/boot_tmp; \
		\
		install -d ${DEPLOY_DIR_IMAGE}/${IMAGE_NAME}/delta; \
		cd ${IMAGE_ROOTFS}; \
		for i in `find -maxdepth 3 -name enigma2 | xargs`; \
		do \
			install -d ${DEPLOY_DIR_IMAGE}/${IMAGE_NAME}/delta/${i%%/enigma2}; \
			mv $i ${DEPLOY_DIR_IMAGE}/${IMAGE_NAME}/delta/${i%%/enigma2}; \
		done; \
		for i in `find -type d -name extra | xargs`; \
		do \
			install -d ${DEPLOY_DIR_IMAGE}/${IMAGE_NAME}/delta/${i%%/extra}; \
			mv $i ${DEPLOY_DIR_IMAGE}/${IMAGE_NAME}/delta/${i%%/extra}; \
		done; \
		cat ${IMAGE_ROOTFS}/etc/fstab | sed 's/^\/dev\/mtdblock\/2/\/dev\/root/;' > ${IMAGE_ROOTFS}/etc/fstab_neu; \
		mv -f ${IMAGE_ROOTFS}/etc/fstab_neu ${IMAGE_ROOTFS}/etc/fstab; \
		mksquashfs ${IMAGE_ROOTFS}/* ${DEPLOY_DIR_IMAGE}/${IMAGE_NAME}/squashfs \
			-root-owned -le -noappend; \
		\
		mkfs.jffs2 --root=${DEPLOY_DIR_IMAGE}/${IMAGE_NAME} --faketime \
			--output=${DEPLOY_DIR_IMAGE}/${IMAGE_NAME}.rootfs.jffs2 \
			${EXTRA_IMAGECMD}; \
		\
		for i in ${DEPLOY_DIR_IMAGE}/${IMAGE_NAME}/delta/*; \ 
			do cp -R $i ${IMAGE_ROOTFS}; done; \
		rm -rf ${DEPLOY_DIR_IMAGE}/${IMAGE_NAME}; \
		rm -rf ${IMAGE_ROOTFS}/boot; \
		mv ${DEPLOY_DIR_IMAGE}/boot_tmp ${IMAGE_ROOTFS}/boot; \
	else \
		mkfs.jffs2 --root=${IMAGE_ROOTFS}/boot --faketime \
			--output=${DEPLOY_DIR_IMAGE}/${IMAGE_NAME}.boot.jffs2 \
			${EXTRA_IMAGECMD}; \
		rm -rf ${IMAGE_ROOTFS}/boot/*; \
		\
		mkfs.jffs2 --root=${IMAGE_ROOTFS} --faketime \
			--output=${DEPLOY_DIR_IMAGE}/${IMAGE_NAME}.rootfs.jffs2 \
			${EXTRA_IMAGECMD}; \
	fi; \
	buildimage ${STAGING_LIBDIR}/dreambox-secondstage/main.bin.gz \
		${DEPLOY_DIR_IMAGE}/${IMAGE_NAME}.boot.jffs2 \
		${DEPLOY_DIR_IMAGE}/${IMAGE_NAME}.rootfs.jffs2 \
		${MACHINE} \
		> ${DEPLOY_DIR_IMAGE}/${IMAGE_NAME}.nfi"
```
