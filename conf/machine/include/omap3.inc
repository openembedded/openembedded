## conf/machine/include/omap3.inc
```bitbake
SOC_FAMILY = "omap3"

require conf/machine/include/tune-cortexa8.inc
PREFERRED_PROVIDER_virtual/kernel = "linux-omap"
# Increase this everytime you change something in the kernel
MACHINE_KERNEL_PR = "r84"

KERNEL_IMAGETYPE = "uImage"

UBOOT_ENTRYPOINT = "0x80008000"
UBOOT_LOADADDRESS = "0x80008000"

EXTRA_IMAGEDEPENDS += "u-boot x-load"
```

## conf/machine/include/orion.inc
```bitbake
#@TYPE: Machine
#@DESCRIPTION: Machine configuration for various different Marvell Orion based devices

TARGET_ARCH = "arm"

MACHINE_FEATURES 		= "kernel26 usbhost ext2 vfat"
MACHINE_TASK_PROVIDER 		= "task-base"

USE_DEVFS = "0"

PREFERRED_PROVIDER_virtual/bootloader = ""
PREFERRED_PROVIDER_virtual/kernel = "linux-orion"
PREFERRED_VERSION_linux-orion = "2.6.28.4"

IMAGE_DEVICE_TABLES = "files/device_table-slugos.txt"
IMAGE_FSTYPES = "tar.gz"
SERIAL_CONSOLE = "ttyS0 115200"

# Currently all the orion devices we support use uImage
KERNEL_IMAGETYPE = "uImage"
UBOOT_ENTRYPOINT = "0x00008000"
UBOOT_LOADADDRESS = "0x00008000"

require conf/machine/include/tune-arm926ejs.inc
```

## conf/machine/include/palm.inc
```bitbake
#
# Hardware-based properties
#

TARGET_ARCH = "arm"

SERIAL_CONSOLE = "115200 ttyS0"

# Use tune-xscale per default. Machine independent feeds should be built with tune-strongarm.
require conf/machine/include/tune-xscale.inc

MACHINE_FEATURES = "kernel26 touchscreen apm alsa bluetooth irda usbgadget screen ext2 vfat"

#
# Software/packages selection
#

PREFERRED_PROVIDER_virtual/kernel = "linux-hackndev-2.6"

PREFERRED_PROVIDER_virtual/xserver = "xserver-kdrive"

module_autoload_sa1100-rtc = "sa1100-rtc"
module_autoload_snd-ac97-bus = "snd-ac97-bus"
module_autoload_apm_power = "apm_power"
module_autoload_backlight = "backlight"
module_autoload_battery = "battery"
module_autoload_bcm2035_uart = "bcm2035_uart"
module_autoload_gpioed = "gpioed"
module_autoload_gpioed-ng = "gpioed-ng"
module_autoload_lcd = "lcd"
module_autoload_led-class = "led-class"
module_autoload_leds-palmld = "leds-palmld"
module_autoload_ledtrig-heartbeat = "ledtrig-heartbeat"
module_autoload_ledtrig-hwtimer = "ledtrig-hwtimer"
module_autoload_ledtrig-timer = "ledtrig-timer"
module_autoload_palmld_battery = "palmld-battery"
module_autoload_palmld_ide = "palmld-ide"
module_autoload_palmld_pcmcia = "palmld-pcmcia"
module_autoload_pcmcia = "pcmcia"
module_autoload_pcmcia_core = "pcmcia-core"
module_autoload_pda_power = "pda_power"
module_autoload_pxa2xx_core = "pxa2xx-core"
module_autoload_snd = "snd"
module_autoload_snd-ac97-codec = "snd-ac97-codec"
module_autoload_snd-mixer-oss = "snd-mixer-oss"
module_autoload_snd-page-alloc = "snd-page-alloc"
module_autoload_snd-pcm = "snd-pcm"
module_autoload_snd-pcm-oss = "snd-pcm-oss"
module_autoload_snd-pxa2xx-pcm = "snd-pxa2xx-pcm"
module_autoload_snd-pxa2xx-ac97 = "snd-pxa2xx-ac97"
module_autoload_snd-seq = "snd-seq"
module_autoload_snd-seq-device = "snd-seq-device"
module_autoload_seq-midi-event = "seq-midi-event"
module_autoload_snd-seq-oss = "snd-seq-oss"
module_autoload_snd-timer = "snd-timer"
module_autoload_soundcore = "soundcore"
module_autoload_wm97xx-ts = "wm97xx-ts"
module_autoload_pxa27x-keyboard = "pxa27x-keyboard"
module_autoload_palmtx_battery = "palmtx_battery"
module_autoload_palmz72_battery = "palmz72_battery"
module_autoload_i2c-dev = "i2c-dev"
module_autoload_i2c-pxa = "i2c-pxa"


MACHINE_EXTRA_RRECOMMENDS = "\
	kernel-module-ac97-bus \
	kernel-module-apm-power \
	kernel-module-backlight \
	kernel-module-battery \
	kernel-module-led-class \
	kernel-module-lcd \
	kernel-module-gpioed \
	kernel-module-gpioed-ng \
	kernel-module-external-power \
	kernel-module-snd \
	kernel-module-snd-ac97-codec \
	kernel-module-snd-page-alloc \
	kernel-module-snd-pcm \
	kernel-module-snd-seq \
	kernel-module-snd-seq-device \
	kernel-module-snd-seq-midi-event \
	kernel-module-snd-seq-oss \
	kernel-module-snd-timer \
	kernel-module-soundcore \
	"
```

## conf/machine/include/palmpre.inc
```bitbake
# use this for overrides
MACHINE_CLASS = "palmpre"

TARGET_ARCH = "arm"

PREFERRED_PROVIDER_virtual/xserver = "xserver-xorg"
XSERVER = "xserver-xorg \
           xf86-input-evdev \
           xf86-input-mouse \
           xf86-video-omapfb \
           xf86-input-keyboard"

MACHINE_DISPLAY_WIDTH_PIXELS = "320"
MACHINE_DISPLAY_HEIGHT_PIXELS = "480"
MACHINE_DISPLAY_ORIENTATION = "0"
MACHINE_DISPLAY_PPI = "185"

require conf/machine/include/omap3.inc

# Copied from include/omap3.inc (as we do not use linux-omap recipes):
# Increase this everytime you change something in the kernel
MACHINE_KERNEL_PR = "r93"

PREFERRED_PROVIDER_virtual/kernel = "linux-palmpre"

IMAGE_FSTYPES += "tar.gz"

# Let's keep the following three from the beagleboard machine config
UBOOT_MACHINE = "omap3_beagle_config"
PREFERRED_VERSION_u-boot = "git"
XLOAD_MACHINE = "omap3530beagle_config"

MACHINE_FEATURES = "kernel26 screen apm usbgadget usbhost vfat alsa phone bluetooth touchscreen keyboard wifi"
MACHINE_EXTRA_RDEPENDS = " \
 tsmd \
 read-tokens \
 tellbootie \
 lvm2 \
 palmpre-audio-scripts \
 compat-wireless-2.6-old \
"

PREFERRED_PROVIDER_udev-compat = "udev-compat141"
```

## conf/machine/include/poodle-2.4.conf
```bitbake
PREFERRED_PROVIDER_virtual/kernel = "openzaurus-pxa"

# Later versions are broken on kernel 2.4
PREFERRED_VERSION_ = "0.13e"

BOOTSTRAP_EXTRA_RDEPENDS = "kernel hostap-modules-cs   sharp-sdmmc-support \
hostap-utils prism3-firmware prism3-support"
BOOTSTRAP_EXTRA_RRECOMMENDS = "kernel-module-net-fd kernel-module-registers kernel-module-pxa-bi \
kernel-module-usbdcore kernel-module-usbdmonitor" 
```

## conf/machine/include/poodle-2.6.conf
```bitbake
PREFERRED_PROVIDER_virtual/kernel = "linux-openzaurus"

BOOTSTRAP_EXTRA_DEPENDS = "virtual/kernel udev sysfsutils modutils-collateral \
			   alsa-utils alsa-settings wpa-supplicant"
BOOTSTRAP_EXTRA_RDEPENDS = "kernel udev sysfsutils udev-utils wpa-supplicant \
			    alsa-utils-alsactl alsa-utils-alsamixer alsa-conf alsa-settings"

# Sound Modules
BOOTSTRAP_EXTRA_RRECOMMENDS_append_poodle += " kernel-module-snd-soc-poodle "

PREFERRED_VERSION_linux-openzaurus = "2.6.17"
```

## conf/machine/include/qemu.inc
```bitbake
PCMCIA_MANAGER = "pcmciautils"
PREFERRED_PROVIDER_virtual/xserver = "xserver-xorg"
XSERVER = "xserver-xorg \
           xf86-input-evdev \
           xf86-input-tslib \
           xf86-input-mouse \
           xf86-video-fbdev \
           xf86-input-keyboard"
GUI_MACHINE_CLASS = "bigscreen"

MACHINE_FEATURES = "kernel26 apm alsa pcmcia bluetooth irda usbgadget screen keyboard touchscreen"

IMAGE_FSTYPES ?= "tar.bz2 ext2"

ROOT_FLASH_SIZE = "230"
IMAGE_ROOTFS_SIZE_ext2 ?= "230000"

# Don't include kernels in standard images
RDEPENDS_kernel-base = ""

EXTRA_IMAGEDEPENDS += "qemu-native"
```

## conf/machine/include/simpad-2.4.conf
```bitbake
PREFERRED_PROVIDER_virtual/kernel = "opensimpad-64+0"

# Later versions are broken on kernel 2.4
PREFERRED_VERSION_orinoco-modules = "0.13e"

BOOTSTRAP_EXTRA_RDEPENDS += "hostap-modules orinoco-modules \
orinoco-modules-cs pcmcia-cs apm hostap-utils wpa-supplicant-nossl"
```

## conf/machine/include/simpad-2.4.inc
```bitbake
PREFERRED_PROVIDER_virtual/kernel = "opensimpad-64+0"

MACHINE_FEATURES_append = "kernel24"
MACHINE_EXTRA_RRECOMMENDS = " kernel-module-sa1100-ir \
	kernel-module-sa1100usb-core kernel-module-usb-eth \
	kernel-module-pcnet-cs kernel-module-8390 "

USE_DEVFS = "1"

PREFERRED_PROVIDER_hostap-modules = "hostap-modules"

# Later versions are broken on kernel 2.4
PREFERRED_VERSION_orinoco-modules = "0.13e"
```

## conf/machine/include/simpad-2.6.conf
```bitbake
PREFERRED_PROVIDER_virtual/kernel = "linux"

PCMCIA_MANAGER ?= "pcmciautils"

MACHINE_FEATURES_append = "kernel26"
```

## conf/machine/include/smartphone-common.conf
```bitbake
HANDHELD_MODULES = "ipv6 \
ipsec \
nvrd \
mip6-mn \
tun \
nls-base nls-cp437 nls-iso8859-1 \
fat vfat \
loop \
rfcomm bnep l2cap sco hci_uart hidp \
af_packet \
ppp-async ppp-deflate ppp-mppe \
ip-gre ip-tables ipip \
irda irlan irnet irport irtty ircomm-tty \
input uinput \
"

# Configuration bits for "generic samrtphone"
BOOTSTRAP_EXTRA_RDEPENDS +=  "apm apmd network-suspend-scripts"
BOOTSTRAP_EXTRA_RRECOMMENDS += "ppp wireless-tools irda-utils wpa-supplicant-nossl lrzsz ppp-dialin ${@linux_module_packages('${HANDHELD_MODULES}', d)}"

INHERIT += "linux_modules"
```

## conf/machine/include/ti814x.inc
```bitbake
TARGET_ARCH = "arm"
SOC_FAMILY = "ti814x"

require conf/machine/include/tune-cortexa8.inc

PREFERRED_PROVIDER_virtual/kernel = "linux-omap3"
PREFERRED_PROVIDER_virtual/bootloader = "u-boot"

# Increase this everytime you change something in the kernel
MACHINE_KERNEL_PR = "r1"

KERNEL_IMAGETYPE = "uImage"

UBOOT_ARCH = "arm"
UBOOT_MACHINE = "ti8148_evm_config_nand"
UBOOT_ENTRYPOINT = "0x80008000"
UBOOT_LOADADDRESS = "0x80008000"

# Only build u-boot
EXTRA_IMAGEDEPENDS += "u-boot"

# Ship all kernel modules
IMAGE_FSTYPES ?= "jffs2 tar.bz2"
EXTRA_IMAGECMD_jffs2 = "-lqn -e 128"
SERIAL_CONSOLE = "115200 ttyO0"
MACHINE_FEATURES = "kernel26 apm usbgadget usbhost vfat ext2 ethernet"
```

## conf/machine/include/ti816x.inc
```bitbake
TARGET_ARCH = "arm"
SOC_FAMILY = "ti816x"

require conf/machine/include/tune-cortexa8.inc

PREFERRED_PROVIDER_virtual/kernel = "linux-omap3"
PREFERRED_PROVIDER_virtual/bootloader = "u-boot"

# Increase this everytime you change something in the kernel
MACHINE_KERNEL_PR = "r1"

KERNEL_IMAGETYPE = "uImage"

UBOOT_ARCH = "arm"
UBOOT_MACHINE = "ti816x_evm_config"
UBOOT_ENTRYPOINT = "0x80008000"
UBOOT_LOADADDRESS = "0x80008000"

# Only build u-boot
EXTRA_IMAGEDEPENDS += "u-boot"

# Ship all kernel modules
IMAGE_FSTYPES += "jffs2 tar.bz2"
EXTRA_IMAGECMD_jffs2 = "-lnp -e 0x20000 -s 2048"
SERIAL_CONSOLE = "115200 ttyS2"
MACHINE_FEATURES = "kernel26 apm usbgadget usbhost vfat ext2 ethernet"
```

## conf/machine/include/tosa-2.6.conf
```bitbake
include conf/machine/include/zaurus-clamshell-2.6.conf

# WM97xx Modules
#BOOTSTRAP_EXTRA_RDEPENDS += "kernel-module-wm97xx-core kernel-module-wm9705 kernel-module-pxa-wm97xx"
```

## conf/machine/include/tune-arm1136-novfp.inc
```bitbake
TARGET_ARCH = "arm"
TARGET_CC_ARCH = "-march=armv6j -mtune=arm1136jf-s"

# Not all kernels enable floating point emulation in the kernel, so we exclude 'armv6' for now
FEED_ARCH = "armv6-novfp"
BASE_PACKAGE_ARCH = "armv6-novfp"
PACKAGE_EXTRA_ARCHS += "armv4 armv4t armv5te armv6-novfp"

# Include tune file for thumb support, it defaults to off so DISTROs can turn it on if they wish
require conf/machine/include/tune-thumb.inc
```

## conf/machine/include/tune-arm1136jf-s.conf
```bitbake
TARGET_CC_ARCH = "-march=armv6j -mtune=arm1136jf-s -mfpu=vfp -mfloat-abi=softfp"
PACKAGE_ARCH = "armv6"
```

## conf/machine/include/tune-arm1136jf-s.inc
```bitbake
TARGET_CC_ARCH = "-march=armv6j -mtune=arm1136jf-s -mfpu=vfp -mfloat-abi=softfp"
FEED_ARCH = "armv6"
BASE_PACKAGE_ARCH = "armv6"
PACKAGE_EXTRA_ARCHS += "armv4 armv4t armv5te armv6"

# Include tune file for thumb support, it defaults to off so DISTROs can turn it on if they wish
require conf/machine/include/tune-thumb.inc
```

## conf/machine/include/tune-arm926ejs.inc
```bitbake
FEED_ARCH = "armv5te"
PACKAGE_EXTRA_ARCHS += "armv4 armv4t armv5te"
# For gcc 3.x you need:
#TARGET_CC_ARCH = "-march=armv5te -mtune=arm926ejs"
# For gcc 4.x you need:
TARGET_CC_ARCH = "-march=armv5te -mtune=arm926ej-s"
BASE_PACKAGE_ARCH = "armv5te"

# Include tune file for thumb support, it defaults to off so DISTROs can turn it on if they wish
require conf/machine/include/tune-thumb.inc
```

## conf/machine/include/tune-arm9tdmi.inc
```bitbake
FEED_ARCH = "armv4t"
BASE_PACKAGE_ARCH = "armv4t"
PACKAGE_EXTRA_ARCHS += "armv4 armv4t"
TARGET_CC_ARCH = "-mcpu=arm9tdmi -mtune=arm9tdmi"

# Include tune file for thumb support, it defaults to off so DISTROs can turn it on if they wish
require conf/machine/include/tune-thumb.inc
```

## conf/machine/include/tune-athlonmp.inc
```bitbake
TARGET_CC_ARCH = "-march=i686"
PACKAGE_EXTRA_ARCHS += "i386 i486 i586"
BASE_PACKAGE_ARCH = "i686"
FEED_ARCH = "i686"
```

## conf/machine/include/tune-atom.inc
```bitbake
# GCC 4.3.0- (see Poky)
# TARGET_CC_ARCH = "-march=i586"
# GCC 4.3.1+ (see Gentoo)
TARGET_CC_ARCH = "-march=core2"
# GCC 4.4.2+ (see Fedora 12)
#TARGET_CC_ARCH = "-march=i686 -mtune=atom"
BASE_PACKAGE_ARCH = "i686"
FEED_ARCH = "i686"
PACKAGE_EXTRA_ARCHS += "x86 i386 i486 i586"
```

## conf/machine/include/tune-barcelona.inc
```bitbake
TARGET_CC_ARCH = "-m64 -march=barcelona"
BASE_PACKAGE_ARCH = "amd64"
PACKAGE_EXTRA_ARCH += "amd64"
FEED_ARCH = "amd64"
```
