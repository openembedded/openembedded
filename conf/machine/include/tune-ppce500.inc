## conf/machine/include/tune-ppce500v2.inc
```bitbake
TARGET_CC_ARCH = "-mcpu=8548 -mspe=yes -mabi=spe -mhard-float -mfloat-gprs=double"
BASE_PACKAGE_ARCH = "ppce500v2"
FEED_ARCH = "ppce500v2"
PACKAGE_EXTRA_ARCHS += "ppce500v2"
```

## conf/machine/include/tune-ppce600.inc
```bitbake
TARGET_CC_ARCH = "-mcpu=7450"
BASE_PACKAGE_ARCH = "ppce600"
FEED_ARCH = "ppce600"
PACKAGE_EXTRA_ARCHS += "ppce600"
```

## conf/machine/include/tune-sh4a.inc
```bitbake
# NOTE: This file provides the option for m4a(sh4a).
# It is not compatible in m4a and m4(sh4). 
# The binary optimized by m4a doesn't operate on sh4. It works on sh4a only.
# If you want to use binary that  work on sh4 and sh4a, you should use 
# "conf/machine/include/tune-sh4.inc".

TARGET_CC_ARCH = "-ml -m4a"
FEED_ARCH = "sh4"
BASE_PACKAGE_ARCH = "sh4"
```

## conf/machine/include/tune-strongarm.inc
```bitbake
# This machine lists common configuration options for Strongarm devices
# gcc does not differentiate between the different Strongarm versions, so neither do we
# http://lists.linuxtogo.org/pipermail/openembedded-devel/2008-January/004031.html

TARGET_CC_ARCH = "-march=armv4 -mtune=strongarm"
FEED_ARCH = "armv4"
BASE_PACKAGE_ARCH = "armv4" 
PACKAGE_EXTRA_ARCHS += "armv4"

ARM_INSTRUCTION_SET = "arm"
THUMB_INTERWORK = "no"
```

## conf/machine/include/tune-supersparc.inc
```bitbake
TARGET_CC_ARCH = "-mcpu=supersparc"
PACKAGE_ARCH = "supersparc"
FEED_ARCH = "supersparc" 
```

## conf/machine/include/tune-x86-atom.inc
```bitbake
TARGET_CC_ARCH = "-march=core2 -mfpmath=sse -msse4.1"
TARGET_CC_KERNEL_ARCH = "-march=core2 -mfpmath=sse -msse4.1"
PACKAGE_EXTRA_ARCHS += "x86 i386 i486 i586"
```

## conf/machine/include/tune-x86-nocona.inc
```bitbake
TARGET_CC_ARCH = "-march=nocona"
TARGET_CC_KERNEL_ARCH = "-march=nocona"
PACKAGE_EXTRA_ARCHS += "x86 i386 i486 i586"
```

## conf/machine/include/tune-x86_64.conf
```bitbake
ARCH_MULTILIB = "i686"
LIB_MULTILIB = "lib32"
CFLAGS_MULTILIB = "-march=i686 -m32"
TARGET_SYS_MULTILIB = "${ARCH_MULTILIB}${TARGET_VENDOR}-${TARGET_OS}"

base_multilibdir = "${layout_base_prefix}/${LIB_MULTILIB}"
multilibdir = "${layout_exec_prefix}/${LIB_MULTILIB}"
```

## conf/machine/include/tune-x86_64.inc
```bitbake
TARGET_CC_ARCH = "-mtune=generic"
BASE_PACKAGE_ARCH = "x86_64"
FEED_ARCH = "x86_64"
PACKAGE_EXTRA_ARCHS += "x86 i386 i486 i586 i686"
```

## conf/machine/include/tune-xscale.conf
```bitbake
TARGET_CC_ARCH = "-march=armv5te -mtune=xscale"
TARGET_CC_KERNEL_ARCH = "-march=armv5te -mtune=xscale"
PACKAGE_ARCH = "armv5te"
```

## conf/machine/include/tune-xscale.inc
```bitbake
# this depends on fact that for ARM the TARGET_ARCH is 'arm' for little endian and 'armeb' for bigendian
# this is the case as of now for all arm machines in OE.

FEED_ARCH =  "${@['armv5teb', 'armv5te'][bb.data.getVar('TARGET_ARCH', d, 1) == 'arm']}"

TARGET_CC_ARCH = "-march=armv5te -mtune=xscale"
TARGET_CC_KERNEL_ARCH = "-march=armv5te -mtune=xscale"
PACKAGE_EXTRA_ARCHS += "${@['armv4b armv4tb armv5teb', 'armv4 armv4t armv5te'][ bb.data.getVar('TARGET_ARCH', d, 1) == 'arm']}"
BASE_PACKAGE_ARCH = "${@['armv5teb', 'armv5te'][bb.data.getVar('TARGET_ARCH', d, 1) == 'arm']}"
```

## conf/machine/include/zaurus-2.6.conf
```bitbake
# Zaurus Clamshell specific configuration for kernel 2.6
# Don't forget to include zaurus-clamshell.conf as well

TARGET_ARCH = "arm"
PACKAGE_EXTRA_ARCHS = "armv4 armv4t armv5e armv5te"

MACHINE_KERNEL_VERSION = "2.6"

EXTRA_IMAGECMD_jffs2 = "--little-endian --eraseblock=0x4000 --pad --faketime -n" 

IMAGE_CMD_jffs2 = "mkfs.jffs2 --root=${IMAGE_ROOTFS} --output=${DEPLOY_DIR_IMAGE}/${IMAGE_NAME}.rootfs.jffs2.bin ${EXTRA_IMAGECMD}"

EXTRA_IMAGEDEPENDS += "zaurus-updater"

IMAGE_FSTYPES ?= "jffs2 tar.gz"

# Use tune-xscale per default. Machine independent feeds should be built with tune-strongarm.
include conf/machine/include/tune-xscale.conf

SERIAL_CONSOLE = "115200 ttyS0"

PREFERRED_PROVIDER_virtual/kernel = "linux-rp"
PREFERRED_PROVIDER_xserver = "xserver-kdrive"

PCMCIA_MANAGER ?= "pcmciautils"

MACHINE_FEATURES = "kernel26 apm alsa pcmcia irda usbgadget keyboard touchscreen screen"
MACHINE_FEATURES_append_tosa  = " usbhost usbwlanng "
MACHINE_FEATURES_append_akita = " usbhost "
MACHINE_FEATURES_append_spitz = " usbhost ext2 "

MACHINE_EXTRA_RDEPENDS = "zaurusd"
MACHINE_EXTRA_RRECOMMENDS_c7x0   = "kernel-module-snd-soc-corgi"
MACHINE_EXTRA_RRECOMMENDS_akita  = "kernel-module-snd-soc-spitz"
MACHINE_EXTRA_RRECOMMENDS_spitz  = "kernel-module-snd-soc-spitz"
MACHINE_EXTRA_RRECOMMENDS_poodle = "kernel-module-snd-soc-poodle"

MACHINE_TASK_PROVIDER = "task-base"
GUI_MACHINE_CLASS = "bigscreen"
GUI_MACHINE_CLASS_poodle = "smallscreen"
```

## conf/machine/include/zaurus-2.6.inc
```bitbake
########################
# Zaurus common settings
########################

ERASEBLOCKSIZE = "0x4000"
ERASEBLOCKSIZE_akita = "0x20000"

# Warning! SL-C3000 has "0x4000" (16MiB NAND) 
# C3100 and C3200 have same 128MiB NAND device as akita
ERASEBLOCKSIZE_spitz = "0x20000"

IMAGE_FSTYPES += "jffs2 tar.gz"

# kernel now supports favourlzo
IMAGE_CMD_jffs2 = "mkfs.jffs2 --root=${IMAGE_ROOTFS} --faketime -m favourlzo \
                   --output=${T}/${IMAGE_NAME}.rootfs.jffs2 --pad --little-endian --eraseblock=${ERASEBLOCKSIZE} -n \
                   && sumtool -i ${T}/${IMAGE_NAME}.rootfs.jffs2 \
                   -o ${T}/${IMAGE_NAME}.rootfs.jffs2.summary \
                   --eraseblock=${ERASEBLOCKSIZE} -l -p; \
                   cat ${T}/${IMAGE_NAME}.rootfs.jffs2 > ${DEPLOY_DIR_IMAGE}/${IMAGE_NAME}.rootfs.jffs2; \
                   rm ${T}/${IMAGE_NAME}.rootfs.jffs2; \
                   cat ${T}/${IMAGE_NAME}.rootfs.jffs2.summary > ${DEPLOY_DIR_IMAGE}/${IMAGE_NAME}.rootfs.summary.jffs2; \
                   rm ${T}/${IMAGE_NAME}.rootfs.jffs2.summary;"


EXTRA_IMAGEDEPENDS += "zaurus-installer"


#########
# xserver (FIXME: xserver-xorg is in testing on spitz)
#########

PREFERRED_PROVIDER_virtual/xserver = "xserver-kdrive"
XSERVER = "xserver-kdrive-fbdev"

# c7x0 uses kdrive-imageon_1.2.0
PREFERRED_PROVIDER_virtual/xserver_c7x0 = "xserver-kdrive-imageon"
XSERVER_c7x0 = "xserver-kdrive-imageon"

# collie uses kdrive-fbdev
PREFERRED_PROVIDER_virtual/xserver_collie = "xserver-kdrive"
XSERVER_collie = "xserver-kdrive-fbdev"

# FIXME xserver-kdrive 1.3.0.0 is still the only working version ?
PREFERRED_PROVIDER_virtual/xserver_akita = "xserver-kdrive-1300"
XSERVER_akita = "xserver-kdrive-1300-fbdev"

# spitz uses xserver-xorg
PREFERRED_PROVIDER_virtual/xserver_spitz = "xserver-xorg"
XSERVER_spitz = "xserver-xorg xf86-video-fbdev xf86-input-keyboard xf86-input-mouse xf86-input-evdev"
PREFERRED_PROVIDER_virtual/libgl_spitz = "mesa-dri"


########
# kernel
########

PREFERRED_PROVIDER_virtual/kernel = "linux-rp"

# Starting with 2.6.32 linux-rp is deprecated for some models
#PREFERRED_PROVIDER_virtual/kernel = "linux"
PREFERRED_PROVIDER_virtual/kernel_collie = "linux"
PREFERRED_PROVIDER_virtual/kernel_tosa = "linux"

# udev-141 is the latest version that works with linux-2.6.26-RP
PREFERRED_PROVIDER_udev-compat_akita = "udev-compat141"
PREFERRED_PROVIDER_udev-compat_spitz = "udev-compat141"
PREFERRED_PROVIDER_udev-compat_c7x0 = "udev-compat141"
PREFERRED_PROVIDER_udev-compat_poodle = "udev-compat141"

# Default bootloader expects "zImage", use "uImage" for u-boot
# Note: kexecboot can boot both kind of images
ZAURUS_KERNEL_IMAGETYPE ?= "zImage"
KERNEL_IMAGETYPE = "${ZAURUS_KERNEL_IMAGETYPE}"

# kernel bootlogo
LOGO_SIZE = '${@base_conditional("GUI_MACHINE_CLASS", "bigscreen", "vga", "qvga", d)}'

################
# machine tuning
################

TARGET_ARCH = "arm"

SERIAL_CONSOLE = "115200 ttyS0"
SERIAL_CONSOLE_collie = "115200 ttySA0"

PCMCIA_MANAGER ?= "pcmciautils"

MACHINE_FEATURES = "kernel26 apm alsa pcmcia irda usbgadget keyboard touchscreen screen vfat ext2"
MACHINE_FEATURES_append_akita = " usbhost "
MACHINE_FEATURES_append_spitz = " usbhost "
MACHINE_FEATURES_append_tosa  = " usbhost wifi "

MACHINE_EXTRA_RDEPENDS = "zaurusd mtd-utils nandlogical"
MACHINE_EXTRA_RDEPENDS_collie = "zaurusd"

# Fixme ? pcmcia and pxa2xx-cs are now compiled in kernel
# Fixme ? module-snd for collie
MACHINE_EXTRA_RRECOMMENDS_collie = ""
MACHINE_EXTRA_RRECOMMENDS_c7x0   = "kernel-module-snd-soc-corgi kernel-module-pxa2xx-cs kernel-module-pcmcia"
MACHINE_EXTRA_RRECOMMENDS_akita  = "kernel-module-snd-soc-spitz kernel-module-pxa2xx-cs kernel-module-pcmcia"
MACHINE_EXTRA_RRECOMMENDS_spitz  = "kernel-module-snd-soc-spitz kernel-module-pxa2xx-cs kernel-module-pcmcia"
MACHINE_EXTRA_RRECOMMENDS_poodle = "kernel-module-snd-soc-poodle kernel-module-pxa2xx-cs kernel-module-pcmcia"
# For tosa: OHCI suspend/resume fixup
# wlan-ng is now in kernel (2.6.29)
# Fixme ? module-snd for tosa
MACHINE_EXTRA_RRECOMMENDS_tosa = "apm-tosa-suspendfix"


##################################
# build kexecboot kernel while
# making sure rootfs is compatible
##################################

require conf/machine/include/initramfs-kexecboot.inc
```

## conf/machine/include/zaurus-clamshell.conf
```bitbake
EXTRA_IMAGEDEPENDS += "sharp-flash-header-c700"

IMAGE_CMD_jffs2 = "mkfs.jffs2 --root=${IMAGE_ROOTFS} --faketime \
		   --output=${T}/${IMAGE_NAME}.rootfs.jffs2 ${EXTRA_IMAGECMD}; \
		   cat ${STAGING_LIBDIR}/sharp-flash-header/header-c700.bin \
		   ${T}/${IMAGE_NAME}.rootfs.jffs2 > ${DEPLOY_DIR_IMAGE}/${IMAGE_NAME}.rootfs.img"

# add a summary to the jffs2 file to make it mount a lot faster
EXTRA_IMAGECMD_jffs2 += "&& sumtool -i ${T}/${IMAGE_NAME}.rootfs.jffs2 \
                         -o ${T}/${IMAGE_NAME}.rootfs.jffs2.summary \
                         --eraseblock=0x4000 -l -p"

IMAGE_CMD_jffs2 +=	"; cat ${STAGING_LIBDIR}/sharp-flash-header/header-c700.bin \
		         ${T}/${IMAGE_NAME}.rootfs.jffs2.summary > ${DEPLOY_DIR_IMAGE}/${IMAGE_NAME}.rootfs.summary.img"
```

## conf/machine/include/zaurus-kernel.inc
```bitbake
# Zaurus common kernel settings

MACHINE_KERNEL_VERSION = "2.6"

PREFERRED_PROVIDER_virtual/kernel = "linux-rp"

# Starting with 2.6.32 linux-rp is deprecated for some models
#PREFERRED_PROVIDER_virtual/kernel = "linux"
PREFERRED_PROVIDER_virtual/kernel_collie = "linux"
PREFERRED_PROVIDER_virtual/kernel_tosa = "linux"

# Default bootloader expects "zImage", use "uImage" for u-boot
# Note: kexecboot can boot both kind of images
ZAURUS_KERNEL_IMAGETYPE ?= "zImage"
KERNEL_IMAGETYPE = "${ZAURUS_KERNEL_IMAGETYPE}"
```

## conf/machine/include/zaurus.inc
```bitbake
########################
# Zaurus common settings
########################

ERASEBLOCKSIZE = "0x4000"
ERASEBLOCKSIZE_akita = "0x20000"

# Warning! SL-C3000 has "0x4000" (16MiB NAND) 
# C3100 and C3200 have same 128MiB NAND device as akita
ERASEBLOCKSIZE_spitz = "0x20000"

IMAGE_FSTYPES += "jffs2 tar.gz"

# kernel now supports favourlzo
IMAGE_CMD_jffs2 = "mkfs.jffs2 --root=${IMAGE_ROOTFS} --faketime -m favourlzo \
                   --output=${T}/${IMAGE_NAME}.rootfs.jffs2 --pad --little-endian --eraseblock=${ERASEBLOCKSIZE} -n \
                   && sumtool -i ${T}/${IMAGE_NAME}.rootfs.jffs2 \
                   -o ${T}/${IMAGE_NAME}.rootfs.jffs2.summary \
                   --eraseblock=${ERASEBLOCKSIZE} -l -p; \
                   cat ${T}/${IMAGE_NAME}.rootfs.jffs2 > ${DEPLOY_DIR_IMAGE}/${IMAGE_NAME}.rootfs.jffs2; \
                   rm ${T}/${IMAGE_NAME}.rootfs.jffs2; \
                   cat ${T}/${IMAGE_NAME}.rootfs.jffs2.summary > ${DEPLOY_DIR_IMAGE}/${IMAGE_NAME}.rootfs.summary.jffs2; \
                   rm ${T}/${IMAGE_NAME}.rootfs.jffs2.summary;"

EXTRA_IMAGEDEPENDS += "zaurus-installer"

IMAGE_DEVICE_TABLES = "files/device_table-minimal.txt \
                       files/device_table_add-scsi.txt \
                       files/device_table_add-loop.txt \
                       "

#########
# xserver (FIXME: xserver-xorg is in testing on spitz)
#########

PREFERRED_PROVIDER_virtual/xserver = "xserver-kdrive"
XSERVER = "xserver-kdrive-fbdev"

# c7x0 uses kdrive-imageon_1.2.0
PREFERRED_PROVIDER_virtual/xserver_c7x0 = "xserver-kdrive-imageon"
XSERVER_c7x0 = "xserver-kdrive-imageon"

# collie uses kdrive-fbdev
PREFERRED_PROVIDER_virtual/xserver_collie = "xserver-kdrive"
XSERVER_collie = "xserver-kdrive-fbdev"

# FIXME xserver-kdrive 1.3.0.0 is still the only working version ?
PREFERRED_PROVIDER_virtual/xserver_akita = "xserver-kdrive-1300"
XSERVER_akita = "xserver-kdrive-1300-fbdev"

# spitz uses xserver-xorg
PREFERRED_PROVIDER_virtual/xserver_spitz = "xserver-xorg"
XSERVER_spitz = "xserver-xorg xf86-video-fbdev xf86-input-keyboard xf86-input-mouse xf86-input-evdev"
PREFERRED_PROVIDER_virtual/libgl_spitz = "mesa-dri"


########
# kernel
########

PREFERRED_PROVIDER_virtual/kernel = "linux"

# Default bootloader expects "zImage", use "uImage" for u-boot
# Note: kexecboot can boot both kind of images
ZAURUS_KERNEL_IMAGETYPE ?= "zImage"
KERNEL_IMAGETYPE = "${ZAURUS_KERNEL_IMAGETYPE}"

# sane defaults for devices with only 32Mb RAM (see man xz)
XZ_COMPRESSION_LEVEL = "-e -7"

# kernel bootlogo
LOGO_SIZE = '${@base_conditional("GUI_MACHINE_CLASS", "bigscreen", "vga", "qvga", d)}'

################
# machine tuning
################

TARGET_ARCH = "arm"

SERIAL_CONSOLE = "115200 ttyS0"
SERIAL_CONSOLE_collie = "115200 ttySA0"

PCMCIA_MANAGER ?= "pcmciautils"

CMDLINE_akita = "console=ttyS0,115200n8 console=tty1 fbcon=rotate:1"
CMDLINE_c7x0 = "console=ttyS0,115200n8 console=tty1"
CMDLINE_collie = "console=ttySA0,115200n8 console=tty1 mem=64M fbcon=rotate:1"
CMDLINE_poodle = "console=ttyS0,115200n8 console=tty1 fbcon=rotate:1"
CMDLINE_spitz = "console=ttyS0,115200n8 console=tty1 fbcon=rotate:1"
CMDLINE_tosa = "console=ttyS0,115200n8 console=tty1"

MACHINE_FEATURES = "kernel26 apm alsa pcmcia irda usbgadget keyboard touchscreen screen vfat ext2"
MACHINE_FEATURES_append_akita = " usbhost"
MACHINE_FEATURES_append_spitz = " usbhost"
MACHINE_FEATURES_append_tosa  = " usbhost wifi "

MACHINE_EXTRA_RDEPENDS = "zaurusd mtd-utils nandlogical"
MACHINE_EXTRA_RDEPENDS_collie = "zaurusd"

# Still actual? OHCI suspend/resume fixup
# MACHINE_EXTRA_RRECOMMENDS_tosa = "apm-tosa-suspendfix"

##################################
# build kexecboot kernel while
# making sure rootfs is compatible
##################################

require conf/machine/include/initramfs-kexecboot.inc

# FIXME
# blindly import from linux-rp.inc (2.6.2x)
#
module_autoload_pxaficp_ir = "pxaficp_ir"
module_autoload_snd-pcm-oss = "snd-pcm-oss"
module_autoload_pcmcia_core = "pcmcia_core"
module_autoload_pxa2xx_cs = "pxa2xx_cs"
module_autoload_ohci-hcd_tosa = "ohci-hcd"
module_autoload_snd-soc-corgi_c7x0 = "snd-soc-corgi"
module_autoload_snd-soc-spitz_akita = "snd-soc-spitz"
module_autoload_snd-soc-spitz_spitz = "snd-soc-spitz"
module_autoload_snd-soc-poodle_poodle = "snd-soc-poodle"
module_autoload_locomo-spi_collie = "locomo-spi"
module_autoload_mmc_block_collie = "mmc_block"
module_autoload_mmc_spi = "mmc-spi"
module_autoload_locomokbd_collie = "locomokbd"
module_autoload_sa1100-cs_collie = "sa1100_cs"
module_autoload_collie-ts_collie = "collie-ts"
module_autoload_leds-locomo_collie = "leds-locomo"
module_autoload_power_collie = "power"
# Fixme ? module-snd for tosa
```

## conf/machine/ion.conf
```bitbake
#@TYPE: Machine
#@NAME: Ion

#@DESCRIPTION: Machine configuration for NVidia Ion based machines.
#Point of View ION, Asrock 330, etc.

TARGET_ARCH = "i686"

#MACHINE_ARCH = "core2"

include conf/machine/include/tune-atom.inc

MACHINE_FEATURES = "kernel26 screen keyboard pci usbhost ext2 ext3 x86 wifi \
                    acpi"

KERNEL_IMAGETYPE = "bzImage"

PREFERRED_PROVIDER_virtual/kernel ?= "linux"

GLIBC_ADDONS = "nptl"
GLIBC_EXTRA_OECONF = "--with-tls"
```
