## conf/machine/ipaq-common.conf
```bitbake
IPAQ_MODULES = "apm h3600_generic_sleeve ipaq-sleeve ipaq-mtd-asset nvrd atmelwlandriver sa1100-rtc ipaq-hal h3600_ts usb-eth wavelan_cs keybdev" 

BOOTSTRAP_EXTRA_DEPENDS += "kbdd bl hostap-modules orinoco-modules mipv6 atmelwlandriver"
BOOTSTRAP_EXTRA_RRECOMMENDS += "kbdd bl hostap-modules-cs orinoco-modules-cs mipv6 atmelwlandriver ${@linux_module_packages('${IPAQ_MODULES}')}"
```

## conf/machine/ipaq-pxa-2.6.conf
```bitbake
IPKG_ARCHS = "all arm h3900 ${MACHINE}"
TARGET_ARCH = arm
PREFERRED_PROVIDER_xserver = "xserver-kdrive"
PREFERRED_PROVIDER_virtual/kernel = "handhelds-pxa-2.6"
PREFERRED_PROVIDERS += "virtual/${TARGET_PREFIX}depmod:module-init-tools-cross"
BOOTSTRAP_EXTRA_DEPENDS = "udev virtual/kernel modutils-collateral module-init-tools"
BOOTSTRAP_EXTRA_RDEPENDS = "udev kernel kernel-modules modutils-collateral module-init-tools"
include conf/machine/handheld-common.conf

GUI_MACHINE_CLASS = "smallscreen"
```
