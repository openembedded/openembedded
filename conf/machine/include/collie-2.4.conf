## conf/machine/include/collie-2.4.conf
```bitbake
PREFERRED_PROVIDER_virtual/kernel = "collie-kernels-2.4-embedix"
BOOTSTRAP_EXTRA_DEPENDS += "hostap-modules orinoco-modules sharp-sdmmc-support"
BOOTSTRAP_EXTRA_RRECOMMENDS = "hostap-modules-cs orinoco-modules-cs \
							   sharp-sdmmc-support kernel-module-net-fd kernel-module-sa1100-bi \
							   kernel-module-usbdcore kernel-module-usbdmonitor"

# kernel-module-collie-ssp kernel-module-collie-tc35143af if buzzer.patch applied

# Later versions are broken on kernel 2.4
PREFERRED_VERSION_orinoco-modules = "0.13e"
```

## conf/machine/include/collie-2.4.inc
```bitbake
PREFERRED_PROVIDER_virtual/kernel = "openzaurus-sa"
COLLIE_MEMORY_SIZE ?= "64"

# workaround for bug 1877
PREFERRED_PROVIDER_hostap-modules = "hostap-modules"

SERIAL_CONSOLE = "115200 ttyS0"
#
# no keyboard feature because 2.4 kernel keymap works ok and we have limited flash
# no usbgadget feature because 2.4 kernel handle it in own way on each machine
#
MACHINE_FEATURES = "kernel24 apm pcmcia screen irda"

MACHINE_EXTRA_RRECOMMENDS = "kernel-module-net-fd kernel-module-sa1100-bi \
                             kernel-module-usbdcore kernel-module-usbdmonitor \
                             sharp-sdmmc-support"

# kernel-module-collie-ssp kernel-module-collie-tc35143af if buzzer.patch applied

# Later versions are broken on kernel 2.4
PREFERRED_VERSION_orinoco-modules = "0.13e"
```

## conf/machine/include/collie-2.6.conf
```bitbake
PREFERRED_PROVIDER_virtual/kernel = "linux-rp"

SERIAL_CONSOLE = "115200 ttySA0"
MACHINE_FEATURES = "kernel26 apm pcmcia screen irda usbgadget keyboard touchscreen wifi"

MACHINE_EXTRA_RDEPENDS = "kernel-modules"
```

## conf/machine/include/collie-2.6.inc
```bitbake
PREFERRED_PROVIDER_virtual/kernel = "linux-rp"

SERIAL_CONSOLE = "115200 ttySA0"
MACHINE_FEATURES = "kernel26 apm pcmcia screen irda usbgadget keyboard touchscreen wifi vfat"

MACHINE_EXTRA_RDEPENDS = "kernel-modules"

MACHINE_POSTPROCESS_COMMAND = "zaurus_make_installkit"
```

## conf/machine/include/dm6446.inc
```bitbake
SOC_FAMILY = "dm6446"

# TI DVSDK stuff:
DSPCFG            ?= "DM6446GEMSHMEM"
DSPLINKDSPCFG     ?= "DM6446GEMSHMEM"
DSPLINKGPPOS      ?= "MVL5G"
DSPLINKPLATFORM   ?= "DAVINCI"
DSPLINKSOC        ?= "DM6446"
DSPPOWERSOC       ?= "DM6446"
GPPOS             ?= "LINUX_GCC"
PLATFORM          ?= "dm6446"
XDC_PLATFORM      ?= "ti.platforms.evmDM6446"
```

## conf/machine/include/gumstix.inc
```bitbake
#@TYPE: Machine
#@Name: Gumstix pxa2xx boards
#@DESCRIPTION:  Gumstix pxa2xx boards

# Don't edit this file unless you *really* know what you are doing!

TARGET_ARCH = "arm"

#Compile with armv5te optimizations, incompatible with armv4(t) cpus
require conf/machine/include/tune-xscale.inc


PREFERRED_PROVIDER_virtual/kernel = "gumstix-kernel"
KERNEL_IMAGETYPE = "uImage"
RDEPENDS_kernel-base = ""

KERNEL_IMAGE_MAXSIZE = "1048577"

UBOOT_ENTRYPOINT = "a0008000"

MACHINE_FEATURES += "kernel26 "

IMAGE_FSTYPES = "jffs2 tar.gz"
EXTRA_IMAGECMD_jffs2 = "--little-endian --eraseblock=0x20000 --squash-uids"

SERIAL_CONSOLE = "115200 ttyS0 vt100"

MACHINE_ESSENTIAL_EXTRA_RDEPENDS =     " \
                                       "

MACHINE_ESSENTIAL_EXTRA_RRECOMMENDS ?= " \
                                       "
```

## conf/machine/include/handheld-common.conf
```bitbake
HANDHELD_MODULES = "ipv6 \
nvrd \
mip6-mn \
tun \
ide-cs ide-disk ide-probe-mod \
loop \
vfat ext2 \
sunrpc nfs \
btuart-cs dtl1-cs bt3c-cs rfcomm bnep l2cap sco hci_uart hidp \
pcnet-cs serial-cs airo-cs \
af_packet \
ppp-async ppp-deflate ppp-mppe \
ip-gre ip-tables ipip \
irda irlan irnet irport irtty ircomm-tty \
input uinput \
"

PCMCIA_MANAGER ?= "pcmcia-cs"

# Configuration bits for "generic handheld"
BOOTSTRAP_EXTRA_DEPENDS += "${PCMCIA_MANAGER} apmd ppp wireless-tools irda-utils lrzsz ppp-dialin scap network-suspend-scripts"
BOOTSTRAP_EXTRA_RDEPENDS +=  "${PCMCIA_MANAGER} apm apmd network-suspend-scripts"
BOOTSTRAP_EXTRA_RRECOMMENDS += "ppp wireless-tools irda-utils lrzsz ppp-dialin scap ${@linux_module_packages('${HANDHELD_MODULES}', d)}"

INHERIT += "linux_modules"
```

## conf/machine/include/htc-msm7.inc
```bitbake
# kernel
PREFERRED_PROVIDER_virtual/kernel = "linux-msm7"

# xserver
PREFERRED_PROVIDER_virtual/xserver = "xserver-xorg"

XSERVER = " \
	xserver-xorg \
	xserver-xorg-extension-glx \
	xserver-xorg-extension-dri \
	xf86-input-evtouch \	
	xf86-input-evdev \
	xf86-input-mouse \
	xf86-input-keyboard \
	xf86-video-msm \
"

# capability database
MACHINE_DISPLAY_WIDTH_PIXELS = "480"
MACHINE_DISPLAY_HEIGHT_PIXELS = "640"

# use this for overrides
MACHINE_CLASS = "htc-msm7"

# features
MACHINE_FEATURES = "kernel26 touchscreen screen phone gps usb keyboard"

# CPU
require conf/machine/include/tune-arm1136-novfp.inc
```

## conf/machine/include/htc-qsd8.inc
```bitbake
# kernel
PREFERRED_PROVIDER_virtual/kernel = "linux-qsd8"

# xserver
PREFERRED_PROVIDER_virtual/xserver = "xserver-xorg"

XSERVER = " \
	xserver-xorg \
	xserver-xorg-extension-glx \
	xserver-xorg-extension-dri \
	xf86-input-tslib \
	xf86-input-evtouch \
	xf86-input-evdev \
	xf86-input-mouse \
	xf86-input-keyboard \
	xf86-video-fbdev \
"

# capability database
MACHINE_DISPLAY_WIDTH_PIXELS = "480"
MACHINE_DISPLAY_HEIGHT_PIXELS = "640"

# use this for overrides
MACHINE_CLASS = "htc-qsd8"

# use uncompressed kernel image
KERNEL_IMAGETYPE = Image

# features
MACHINE_FEATURES = "kernel26 touchscreen screen phone gps usb keyboard"

# CPU
TARGET_ARCH = "arm"
require conf/machine/include/tune-cortexa8.inc
```

## conf/machine/include/imx28.inc
```bitbake
SOC_FAMILY = "mx28"
TARGET_ARCH = "arm"

require conf/machine/include/tune-arm926ejs.inc

PREFERRED_PROVIDER_virtual/bootloader = "u-boot"

# Increase this everytime you change something in the kernel
MACHINE_KERNEL_PR = "r0"

KERNEL_IMAGETYPE = "uImage"

UBOOT_ENTRYPOINT = "0x40008000"
UBOOT_LOADADDRESS = "0x40008000"

EXTRA_IMAGEDEPENDS += "u-boot"

IMAGE_FSTYPES += "jffs2 tar.bz2"
```

## conf/machine/include/imx51.inc
```bitbake
require conf/machine/include/tune-cortexa8.inc
PREFERRED_PROVIDER_virtual/kernel = "linux"
# Increase this everytime you change something in the kernel

KERNEL_IMAGETYPE = "uImage"

UBOOT_ENTRYPOINT = "0x90008000"
UBOOT_LOADADDRESS = "0x90008000"

EXTRA_IMAGEDEPENDS += "u-boot"
```

## conf/machine/include/initramfs-kexecboot.inc
```bitbake
# Initramfs-kexecboot extra config


# If set here, each image will also build linux-kexecboot.
# Usually the machine-installer recipe already DEPENDS on it
#
EXTRA_IMAGEDEPENDS += "linux-kexecboot"


# Force inclusion of kernel in target images
# (done by default)
#
RDEPENDS_kernel-base = "kernel-image"


# Install /boot/boot.cfg in target images
#
MACHINE_ESSENTIAL_EXTRA_RRECOMMENDS_append = " kexecboot-cfg "
```

## conf/machine/include/ixp4xx.conf
```bitbake
#@TYPE: Machine configuration
#@NAME: ixp4xx
#@DESCRIPTION: genric machine configuration for ixp4xx platforms

MACHINE_FEATURES = "kernel26 usbhost ext2"

EXTRA_IMAGECMD_jffs2 = "--pad --eraseblock=0x20000 -n"

PREFERRED_PROVIDER_virtual/kernel ?= "ixp4xx-kernel"

#-------------------------------------------------------------------------------
# INPUTS
#-------------------------------------------------------------------------------
# conf/${DISTRO}.conf is included after this file and should be used to modify
# variables identified as 'INPUTS' to the required values for the DISTRO, this
# will cause the board specific settings (which depend for the most part on the
# exact CPU used) to be set correctly within this file.  The results are the
# variables identifies here as 'OUTPUTS'
#
#variable = "default"
# <possible values>
#    description

DISTRO_BASE = ""
# "" ":<base>"
#    If given this must be the name of a 'distro' to add to the bitbake OVERRIDES
#    after ${DISTRO}, this allows different distros to share a common base of
#    overrides.  The value given must include a leading ':' or chaos will result.

#-------------------------------------------------------------------------------
# OUTPUTS
#-------------------------------------------------------------------------------

#OVERRIDES
#    The standard ':' separated list of overrides used by bitbake - see the
#    basic setting in bitbake.conf.  This list is based on that used for the
#    standard setting however :<base> will be
#    inserted at appropriate points if a base distro is enabled in the inputs.
OVERRIDES = "local:${MACHINE}:ixp4xx:${DISTRO}${DISTRO_BASE}:${TARGET_OS}:${TARGET_ARCH}:build-${BUILD_OS}:fail-fast"

require conf/machine/include/tune-xscale.conf
require conf/machine/include/tune-thumb.conf

#-------------------------------------------------------------------------------
# Board defaults
#-------------------------------------------------------------------------------
# These values are board specific but they seem to be common to a large number
# of boards so are reasonable defaults.
SERIAL_CONSOLE = "115200 ttyS0"
KERNEL_CONSOLE = "ttyS0,115200n8"
USE_VT = "0"
```

## conf/machine/include/ixp4xx.inc
```bitbake
#@TYPE: Machine configuration
#@NAME: ixp4xx
#@DESCRIPTION: genric machine configuration for ixp4xx platforms

# Set default for common ixp4xx-based machines
MACHINE_FEATURES ?= "kernel26 usbhost ext2 vfat redboot apex"

# Select an appropriate default kernel
PREFERRED_PROVIDER_virtual/kernel ?= "linux-ixp4xx"
PREFERRED_VERSION_linux-ixp4xx ?= "2.6.21.7+svnr${SRCREV}"

# Add packages required for basic networking support
MACHINE_ESSENTIAL_EXTRA_RDEPENDS ?= "ixp4xx-npe"

# Set default for 16MB machines - can be overridden for more or less flash.
ROOT_FLASH_SIZE ?= "12"

# Allow for rootfs loaded direct from internal hard disk
IMAGE_FSTYPES ?= "jffs2 tar.gz"

# Set default for common ixp4xx-based machines
EXTRA_IMAGECMD_jffs2 = "--pad --eraseblock=0x20000 -n"

require conf/machine/include/tune-xscale.inc
require conf/machine/include/tune-thumb.inc

#-------------------------------------------------------------------------------
# Board defaults
#-------------------------------------------------------------------------------
# These values are board specific but they seem to be common to a large number
# of boards so are reasonable defaults.
SERIAL_CONSOLE = "115200 ttyS0"
KERNEL_CONSOLE = "ttyS0,115200n8"
USE_VT = "0"
```

## conf/machine/include/kexecboot.inc
```bitbake
# kexecboot specific config options

# NOTE: include this file after zaurus-2.6.inc for zaurus machines

MACHINE_FEATURES_append = " kexecboot "

IMAGE_FSTYPES += " tar.gz "
EXTRA_IMAGEDEPENDS += "linux-kexecboot"

# Include Kernel image in kexecboot enabled images
RDEPENDS_kernel-base = "kernel-image" 

# we store kernel images in rootfs and only a minimal initramfs kernel in mtd1 for booting other kernels
DONT_CHECK_KERNELSIZE ?= "1"

MACHINE_ESSENTIAL_EXTRA_RRECOMMENDS_append = " kexecboot-cfg"

IMAGE_LOGIN_MANAGER = ""
IMAGE_INIT_MANAGER = ""
IMAGE_INITSCRIPTS = ""
IMAGE_DEV_MANAGER = ""
ONLINE_PACKAGE_MANAGEMENT = "none"
```

## conf/machine/include/kirkwood.inc
```bitbake
#@TYPE: Machine
#@DESCRIPTION: Machine configuration for various different Marvell Kirkwood based devices

TARGET_ARCH = "arm"

MACHINE_FEATURES 		= "kernel26 usbhost ext2 vfat mmc"
MACHINE_TASK_PROVIDER 		= "task-base"

USE_DEVFS = "0"

PREFERRED_PROVIDER_virtual/bootloader = ""
PREFERRED_PROVIDER_virtual/kernel = "linux-kirkwood"

MACHINE_KERNEL_PR = "r18"

IMAGE_FSTYPES += "tar.gz ubi"
SERIAL_CONSOLE = "ttyS0 115200"

# Currently all the orion devices we support use uImage
KERNEL_IMAGETYPE = "uImage"
UBOOT_ENTRYPOINT = "0x00008000"
UBOOT_LOADADDRESS = "0x00008000"

require conf/machine/include/tune-arm926ejs.inc
```

## conf/machine/include/linkstationppc.conf
```bitbake
#@TYPE: Machine configuration
#@Name: Buffalo PPC Linkstations
#@DESCRIPTION: Generic Machine configuration for ppc based linkstations


TARGET_ARCH = "powerpc"
PACKAGE_EXTRA_ARCHS = "ppc ppc603e"
MACHINE_FEATURES = "kernel26 usbhost ext2"
TARGET_FPU = "hard"

USE_DEVFS = "0"

BOOTSTRAP_EXTRA_RDEPENDS = "udev module-init-tools kernel-modules"
FEED_URIS = "openlink##http://ipkg.linkstationwiki.net/2007.1/powerpc/"
PREFERRED_PROVIDER_virtual/kernel = "linux-linkstationppc"

#don't try to access tty1
USE_VT = "0"

HOTPLUG = "udev"
udevdir = "/dev"

IMAGE_DEVICE_TABLES = "files/device_table-slugos.txt"

#tune for the MPC5200B cpu
require conf/machine/include/tune-ppc603e.conf
```

## conf/machine/include/lsppc.inc
```bitbake
#@TYPE: Machine configuration
#@Name: Buffalo PPC Linkstations
#@DESCRIPTION: Generic Machine configuration for ppc based linkstations

TARGET_ARCH = "powerpc"
PACKAGE_EXTRA_ARCHS = "ppc"

MACHINE_FEATURES = "kernel26 usbhost ext2"
MACHINE_EXTRA_RDEPENDS = "kernel-devicetree avr-evtd"
MACHINE_EXTRA_RRECOMMENDS = "u-boot-utils"

USE_DEVFS = "0"

BOOTSTRAP_EXTRA_RDEPENDS = "udev module-init-tools kernel-modules"
PREFERRED_PROVIDER_virtual/kernel = "linux-linkstationppc"

#don't try to access tty1
USE_VT = "0"

HOTPLUG = "udev"
udevdir = "/dev"

IMAGE_DEVICE_TABLES = "files/device_table-slugos.txt"
IMAGE_FSTYPES = "tar.gz"

KERNEL_IMAGETYPE = "uImage"
UBOOT_ENTRYPOINT = "0x00000000"
UBOOT_LOADADDRESS = "0x00000000"

require conf/machine/include/tune-ppc603e.inc
```

## conf/machine/include/motorola-ezx-base.inc
```bitbake
# use this for overrides
MACHINE_CLASS = "motorola-ezx"

#
# Hardware-based properties
#
TARGET_ARCH = "arm"

# Use tune-xscale per default. Machine independent feeds should be built with tune-strongarm.
require conf/machine/include/tune-xscale.inc

# Uncomment this to use iwmmxt optimizations. Remove the above xscale stuff first
#require conf/machine/include/tune-iwmmxt.inc

#cat /proc/mtd
#dev:    size   erasesize  name
#mtd0: 00020000 00008000 "Bootloader"
#mtd1: 000e0000 00020000 "Kernel"
#mtd2: 00580000 00020000 "VFM_Filesystem"
#mtd3: 00020000 00020000 "Logo"

ROOT_FLASH_SIZE = "24"
MACHINE_GUI_CLASS = "smallscreen"
MACHINE_DISPLAY_WIDTH_PIXELS = "240"
MACHINE_DISPLAY_HEIGHT_PIXELS = "320"
MACHINE_DISPLAY_ORIENTATION = "0"
MACHINE_DISPLAY_PPI = "180"
MACHINE_FEATURES = "alsa apm bluetooth kernel26 keyboard phone screen touchscreen usbgadget usbhost vfat"
MACHINE_FEATURES += " iwmmxt"

# Comment this out if you change to tune-iwmmxt.inc above
PACKAGE_EXTRA_ARCHS += "iwmmxt"

#
# Software/packages selection
#
PREFERRED_PROVIDER_virtual/kernel ?= "openezx-kernel"
MODUTILS = "26"
XSERVER = "xserver-kdrive-fbdev"
PREFERRED_PROVIDER_virtual/xserver = "xserver-kdrive"

IMAGE_FSTYPES ?= "jffs2"
EXTRA_IMAGECMD_jffs2 = "--pad=14680064 --little-endian --eraseblock=0x20000 -n"

# In order to enable UIBIFS add "uibi and ubifs"
#IMAGE_FSTYPES += "ubi ubifs"

# From dmesg:
# UBI: smallest flash I/O unit:    1
# UBI: logical eraseblock size:    131072 bytes
# from ubiattach stdout:
# UBI device number 0, total 1996 LEBs
MKUBIFS_ARGS = "-m 1 -e 130944 -c 487"

# from dmesg:
# UBI: smallest flash I/O unit:    1
# UBI: physical eraseblock size:   131072 bytes (128 KiB)
# UBI: sub-page size:              512
UBINIZE_ARGS = "-m 1 -p 128KiB "


EXTRA_IMAGEDEPENDS += "moto-boot-usb-native ezx-gen-blob"

IMAGE_INSTALL_append += "\
  kernel-module-ohci-hcd \
  kernel-module-moto-usb-ipc \
  kernel-module-ts27010mux \
"

# Ezxd needs to be started very early so we need the mux devices in static /dev
IMAGE_DEVICE_TABLES = "files/device_table-minimal.txt \
                       files/device_table-ezx.txt"

SERIAL_CONSOLE = "115200 ttyS0"
```
