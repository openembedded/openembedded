## conf/machine/include/motorola-ezx.conf
```bitbake
# choose the proper kernel for this hardware
PREFERRED_PROVIDER_virtual/kernel = "ezx-kernels"
# we don't need support for kernel 2.4
MODUTILS = "26"
# build tar.gz for SD/MMC/Transflash and jffs2 for later when we have mtd
IMAGE_FSTYPES = "tar.gz jffs2"

BOOTSTRAP_EXTRA_RDEPENDS += "kernel udev sysfsutils apm irda-utils udev-utils ppp ppp-dialin module-init-tools"

#
# disable all modules until we have something that boots...
#

# Ethernet modules
#BOOTSTRAP_EXTRA_RDEPENDS += "kernel-module-pcnet-cs"
# NFS Modules
#BOOTSTRAP_EXTRA_RDEPENDS += "kernel-module-nfs kernel-module-lockd kernel-module-sunrpc"
# Crypto Modules
#BOOTSTRAP_EXTRA_RDEPENDS += "kernel-module-des kernel-module-md5"
# SMB and CRAMFS
#BOOTSTRAP_EXTRA_RDEPENDS += "kernel-module-smbfs kernel-module-cramfs"
# Serial Modules
#BOOTSTRAP_EXTRA_RDEPENDS += "kernel-module-8250 kernel-module-serial-cs"
# Bluetooth Modules
#BOOTSTRAP_EXTRA_RDEPENDS += "kernel-module-bluetooth kernel-module-l2cap kernel-module-rfcomm kernel-module-hci-vhci \
#                              kernel-module-bnep kernel-module-hidp kernel-module-hci-uart kernel-module-sco \
#                              kernel-module-bt3c-cs kernel-module-bluecard-cs kernel-module-btuart-cs kernel-module-dtl1-cs"
# Infrared Modules
#BOOTSTRAP_EXTRA_RDEPENDS += "kernel-module-pxaficp-ir kernel-module-irda kernel-module-ircomm \
#                             kernel-module-ircomm-tty kernel-module-irlan kernel-module-irnet kernel-module-ir-usb"
#
# USB Gadget Modules
#BOOTSTRAP_EXTRA_RDEPENDS += "kernel-module-gadgetfs kernel-module-g-file-storage \
#                             kernel-module-g-serial kernel-module-g-ether"
#
# Sound Modules
#BOOTSTRAP_EXTRA_RDEPENDS += "kernel-module-snd-mixer-oss kernel-module-snd-pcm-oss"
#BOOTSTRAP_EXTRA_SOUND     = "kernel-module-soundcore kernel-module-snd kernel-module-snd-page-alloc 
#                              kernel-module-snd-timer kernel-module-snd-pcm  \
#                              kernel-module-snd-soc-core kernel-module-snd-soc-pxa2xx kernel-module-snd-soc-pxa2xx-i2s"
#                             
```

## conf/machine/include/neuros.inc
```bitbake
MACHINE_POSTPROCESS_COMMAND = "neuros_make_installkit"
EXTRA_IMAGECMD_yaffs2 = "0"

EXTRA_IMAGEDEPENDS += "u-boot u-boot-env virtual/kernel neuros-pkggen-native"

neuros_make_installkit () {
    cd ${DEPLOY_DIR_IMAGE}
    rm -rf ${DEPLOY_DIR_IMAGE}/${IMAGE_NAME}-installkit/
    mkdir -p ${IMAGE_NAME}-installkit/temp

    # Get the latest kernel and u-boot using the foo-<machine>.bin symlinks
    cp uImage-${MACHINE}.bin ${IMAGE_NAME}-installkit/temp/uImage
    [ -f u-boot-${MACHINE}.bin ] && cp u-boot-${MACHINE}.bin ${IMAGE_NAME}-installkit/u-boot.bin
    [ -f default_env.img ] && cp default_env.img ${IMAGE_NAME}-installkit/	

    cp ${IMAGE_NAME}.rootfs.yaffs2 ${IMAGE_NAME}-installkit/rootfs.yaffs2 

    cd ${DEPLOY_DIR_IMAGE}/${IMAGE_NAME}-installkit/ 
      mkfs.jffs2 -x lzo -d ./temp -o uImage.jffs2 -e 0x20000 -s 0x800 --pad=0x400000 -n
      echo "${MACHINE}" > rootfs.version
      echo "${MACHINE}" > u-boot.version
      echo "${MACHINE}" > uImage.version
      packet_osd2 osd20.pkg '${DISTRO} Developer UPK' default_env.img u-boot.bin uImage.jffs2 rootfs.yaffs2 
      cd ${DEPLOY_DIR_IMAGE} 
    
    cp ${DEPLOY_DIR_IMAGE}/${IMAGE_NAME}-installkit/osd20.pkg ${DEPLOY_DIR_IMAGE}/${IMAGE_NAME}-osd20.pkg
    rm -rf ${DEPLOY_DIR_IMAGE}/${IMAGE_NAME}-installkit/
}
```

## conf/machine/include/nios2.inc
```bitbake
#@TYPE: Machine configuration
#@NAME: nios2
#@DESCRIPTION: generic machine configuration for nios2 with mmu 

# there are some hooks for uclibc in this file
# however uclibc is not working yet

TARGET_CC_ARCH = ""
BASE_PACKAGE_ARCH = "nios2"
FEED_ARCH = "nios2"

# LIBC = "uclibc" 
LIBC = "glibc" 
# and for the angstrom folks
ANGSTROMLIBC = "${LIBC}"

# fix up target strings
# TARGET_PREFIX = "nios2-linux-uclibc-"
TARGET_PREFIX = "nios2-linux-"
TARGET_VENDOR_nios2 = ""

# Set default for common nios2-based machines
MACHINE_FEATURES ?= "kernel26"
# Select an appropriate default kernel

PREFERRED_PROVIDER_virtual/kernel ?= "linux-nios2"

# Set default for 16MB machines - can be overridden for more or less flash.
ROOT_FLASH_SIZE ?= "12"

# Allow for rootfs loaded direct from internal hard disk
IMAGE_FSTYPES ?= "jffs2 tar.gz"

# Set default for common ixp4xx-based machines
EXTRA_IMAGECMD_jffs2 = "--pad --eraseblock=0x20000 -n"

#-------------------------------------------------------------------------------
# Board defaults
#-------------------------------------------------------------------------------
# These values are board specific but they seem to be common to a large number
# of boards so are reasonable defaults.
SERIAL_CONSOLE = "115200 ttyS0"
KERNEL_CONSOLE = "ttyS0,115200n8"
USE_VT = "0"
```
