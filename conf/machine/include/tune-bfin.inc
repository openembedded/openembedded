## conf/machine/include/tune-bfin.inc
```bitbake
# Blackfin-specific configuration

TARGET_ARCH = "bfin"
TARGET_CC_ARCH = "-mfdpic"
FEED_ARCH = "blackfin"
```

## conf/machine/include/tune-cortexa8.inc
```bitbake
TARGET_CC_ARCH = "-march=armv7-a -mtune=cortex-a8 -mfpu=vfp -mfloat-abi=softfp"
FEED_ARCH = "armv7a"
PACKAGE_ARCH = "armv7a"
```

## conf/machine/include/tune-cortexa9tegra.inc
```bitbake
# tegra2 platform has no neon unit

TARGET_CC_ARCH = "-march=armv7-a -mtune=cortex-a9 -mfpu=vfpv3-d16 -mfloat-abi=soft"

BASE_PACKAGE_ARCH = "armv7a-vfp"
FEED_ARCH = "armv7a-vfp"

PACKAGE_EXTRA_ARCHS += "armv4 armv4t armv5te armv6 armv7 armv7a-vfp"
```

## conf/machine/include/tune-cortexm3.inc
```bitbake
# valid options for -march: `armv7', `armv7-m'
TARGET_CC_ARCH = "-mthumb -mcpu=cortex-m3 -mfpu=vfp -mfloat-abi=softfp"
FEED_ARCH = "armv7"
BASE_PACKAGE_ARCH = "armv7"
```

## conf/machine/include/tune-ep9312.inc
```bitbake
TARGET_CC_ARCH = "-mcpu=ep9312 -mfpu=maverick -mfloat-abi=softfp"

#set arch to ep9312 for all generated packages
PACKAGE_EXTRA_ARCHS += "armv4t ep9312"
BASE_PACKAGE_ARCH = "ep9312"
FEED_ARCH = "ep9312"

FULL_OPTIMIZATION = "-fexpensive-optimizations -fomit-frame-pointer -frename-registers -O -fno-signed-zeros"
DEBUG_OPTIMIZATION = "-O -fno-omit-frame-pointer -g"
SELECTED_OPTIMIZATION = "${@bb.data.getVar(['FULL_OPTIMIZATION', 'DEBUG_OPTIMIZATION'][bb.data.getVar('DEBUG_BUILD', d, 1) == '1'], d, 1)}"
BUILD_OPTIMIZATION = "-O"
```

## conf/machine/include/tune-geode.inc
```bitbake
TARGET_CC_ARCH = "-march=geode -mtune=geode"
BASE_PACKAGE_ARCH = "geode"
PACKAGE_EXTRA_ARCHS += "x86 i386 geode"

FEED_ARCH = "geode"
```

## conf/machine/include/tune-geodegx.inc
```bitbake
TARGET_CC_ARCH = "-march=geode"
BASE_PACKAGE_ARCH = "geode"
PACKAGE_EXTRA_ARCHS += "x86 i386 geode"

FEED_ARCH = "geode"
```

## conf/machine/include/tune-geodelx.inc
```bitbake
# Geode CPU has it's own target in GCC 4.3
# in older versions k6-2 is closest
#
TARGET_CC_ARCH = "-march=k6-2"
BASE_PACKAGE_ARCH = "geode"
PACKAGE_EXTRA_ARCHS += "x86 geode"

FEED_ARCH = "geode"
```

## conf/machine/include/tune-i486sx.inc
```bitbake
TARGET_ARCH = "i486"
TARGET_CC_ARCH = "-march=i486"
PACKAGE_EXTRA_ARCHS = "486sx"
BASE_PACKAGE_ARCH = "486sx"
FEED_ARCH = "${BASE_PACKAGE_ARCH}"

# gcc doesn't understand softfloat:
# "This target does not support --with-float"
```

## conf/machine/include/tune-iwmmxt.conf
```bitbake
# Configurations for the Intel PXA27x Appications Processor Family. 
# Please use tune-xscale for PXA255/PXA26x based processors.
TARGET_CC_ARCH = "-march=iwmmxt -mcpu=iwmmxt -mtune=iwmmxt"
PACKAGE_ARCH = "iwmmxt"
PACKAGE_EXTRA_ARCHS += "iwmmxt"

# HACK: don't build iwmmxt glibc because qemu doesn't support it
TARGET_CC_ARCH_pn-glibc = "-march=armv5te -mtune=xscale"
PACKAGE_ARCH_pn-glibc = "armv5te"
```

## conf/machine/include/tune-mips64.inc
```bitbake
# eglibc needs this flag to default to 64bit otherwise it chooses N32 ABI
TARGET_CC_ARCH = "-mabi=64"
```

## conf/machine/include/tune-pentium.inc
```bitbake
TARGET_CC_ARCH = "-march=pentium"
BASE_PACKAGE_ARCH = "i586"
FEED_ARCH = "i586"
PACKAGE_EXTRA_ARCHS += "i386 i486"
```

## conf/machine/include/tune-pentium4c.inc
```bitbake
TARGET_CC_ARCH = "-march=prescott"
BASE_PACKAGE_ARCH = "i686p4c"
PACKAGE_EXTRA_ARCHS += "x86 i386 i486 i586"
```

## conf/machine/include/tune-pentiummmx.inc
```bitbake
TARGET_CC_ARCH = "-march=pentium-mmx"
BASE_PACKAGE_ARCH = "i586"
FEED_ARCH = "i586"
PACKAGE_EXTRA_ARCHS += "i386 i486"
```

## conf/machine/include/tune-pentiumpro.inc
```bitbake
TARGET_CC_ARCH = "-march=pentiumpro"
BASE_PACKAGE_ARCH = "i686"
FEED_ARCH = "i686"
PACKAGE_EXTRA_ARCHS += "x86 i386 i486 i586"
```

## conf/machine/include/tune-ppc405.inc
```bitbake
#default to soft-floats if distro/machine/local.conf don't define anything else
TARGET_FPU   ?=  "soft"
TARGET_CC_ARCH = "-mcpu=405"
BASE_PACKAGE_ARCH = "ppc405"
FEED_ARCH = "ppc405"
PACKAGE_EXTRA_ARCHS += "ppc405"
```

## conf/machine/include/tune-ppc440.inc
```bitbake
TARGET_CC_ARCH = "-mcpu=440"
BASE_PACKAGE_ARCH = "ppc440"
FEED_ARCH = "ppc440"
PACKAGE_EXTRA_ARCHS += "${BASE_PACKAGE_ARCH} ppc440e"
```

## conf/machine/include/tune-ppc440e.inc
```bitbake
TARGET_CC_ARCH = "-mcpu=440fp -mhard-float"
BASE_PACKAGE_ARCH = "ppc440e"
FEED_ARCH = "ppc440e"
PACKAGE_EXTRA_ARCHS += "ppc440e"
```

## conf/machine/include/tune-ppc603e.inc
```bitbake
TARGET_CC_ARCH = "-mcpu=603e"
BASE_PACKAGE_ARCH = "ppc603e"
FEED_ARCH = "ppc603e"
PACKAGE_EXTRA_ARCHS += "ppc603e"
```

## conf/machine/include/tune-ppce300c2.inc
```bitbake
TARGET_CC_ARCH = "-mcpu=e300c2"
BASE_PACKAGE_ARCH = "ppce300c2"
FEED_ARCH = "ppce300c2"
PACKAGE_EXTRA_ARCHS += "ppce300c2"
```

## conf/machine/include/tune-ppce300c3.inc
```bitbake
TARGET_CC_ARCH = "-mcpu=e300c3"
BASE_PACKAGE_ARCH = "ppce300c3"
FEED_ARCH = "ppce300c3"
PACKAGE_EXTRA_ARCHS += "ppce300c3"
```
