## conf/machine/palmz72.conf
```bitbake
#@TYPE: Machine
#@NAME: Palm Zire 72
#@DESCRIPTION: Machine configuration for the Palm Zire 72

require conf/machine/include/palm.inc

ROOT_FLASH_SIZE = "100"
MACHINE_GUI_CLASS = "bigscreen"
MACHINE_DISPLAY_WIDTH_PIXELS = "320"
MACHINE_DISPLAY_HEIGHT_PIXELS = "320"

SERIAL_CONSOLE = "115200 ttyS0"

# Use tune-xscale per default. Machine independent feeds should be built with tune-strongarm.
require conf/machine/include/tune-thumb.inc

MACHINE_EXTRA_RRECOMMENDS += "kernel-module-i2c-pxa \
			     kernel-module-i2c-algo-pxa \
			     kernel-module-i2c-dev \
			     kernel-module-wm97xx-ts \		
			     kernel-module-palmz72-battery"

module_autoload_g_ether = "g_ether"
```

## conf/machine/pcm043.conf
```bitbake
#@TYPE: Machine
#@Name: Phytec phyCORE-i.MX35
#@DESCRIPTION: Machine configuration for Phytec phyCORE-i.MX35 

TARGET_ARCH = "arm"

MACHINE_FEATURES = "kernel26 apm alsa ext2 pcmcia usbhost usbgadget touchscreen"

GUI_MACHINE_CLASS = "smallscreen"

PREFERRED_PROVIDER_virtual/kernel = "linux"

require conf/machine/include/tune-arm1136jf-s.inc

# used by sysvinit_2
SERIAL_CONSOLE = "115200 ttymxc0"

# used by opie-collections.inc
ROOT_FLASH_SIZE = "32"

IMAGE_FSTYPES += "tar.gz"

KERNEL_IMAGETYPE = "uImage"

UBOOT_ENTRYPOINT = "0x80008000"
```

## conf/machine/picosam9.conf
```bitbake
#@TYPE: Machine
#@Name: pico-SAM9G45 (http://www.mini-box.com/pico-SAM9G45-X)
#@DESCRIPTION: Machine configuration for the picoSAM9G45 board with a at91sam9g45 processor

# More information can be found here:
# http://arm.mini-box.com/index.php?title=Compiling_Angstrom_for_pico-SAM9G45
# Images tested: base-image and x11-image

TARGET_ARCH = "arm"

PREFERRED_PROVIDER_virtual/kernel = "picosam9"

PREFERRED_PROVIDER_xserver = "xserver-kdrive"

MACHINE_FEATURES += "usbhost kernel26 apm vfat screen touchscreen ethernet wifi bluetooth"

require conf/machine/include/tune-arm926ejs.inc
```

## conf/machine/poodle-2.4.conf
```bitbake
PREFERRED_PROVIDER_virtual/kernel = "openzaurus-pxa"

BOOTSTRAP_EXTRA_DEPENDS = "virtual/kernel \
hostap-modules orinoco-modules sharp-sdmmc-support chkhinge \
hostap-utils prism3-firmware prism3-support"
BOOTSTRAP_EXTRA_RDEPENDS = "kernel hostap-modules-cs orinoco-modules sharp-sdmmc-support \
kernel-module-net-fd kernel-module-registers kernel-module-pxa-bi \
kernel-module-usbdcore kernel-module-usbdmonitor \
hostap-utils prism3-firmware prism3-support"
```

## conf/machine/poodle-2.6.conf
```bitbake
PREFERRED_PROVIDER_virtual/kernel = "linux-openzaurus"

BOOTSTRAP_EXTRA_DEPENDS = "virtual/kernel udev sysfsutils modutils-collateral \
			   alsa-utils alsa-settings"
BOOTSTRAP_EXTRA_RDEPENDS = "kernel udev sysfsutils udev-utils \
			    alsa-utils-alsactl alsa-utils-alsamixer alsa-conf alsa-settings"

# Sound Modules
BOOTSTRAP_EXTRA_RRECOMMENDS_append_poodle += " kernel-module-snd-soc-poodle "

PREFERRED_VERSION_linux-openzaurus = "2.6.17"
```

## conf/machine/poodle.conf
```bitbake
#@TYPE: Machine
#@NAME: Sharp Zaurus SL-B500, Sharp Zaurus SL-5600
#@DESCRIPTION: Machine configuration for the PXA250 based Sharp Zaurus SL-B500 and SHarp Zaurus SL-5600 devices

require conf/machine/include/zaurus-2.6.inc
require conf/machine/include/tune-xscale.inc

ROOT_FLASH_SIZE = "22"

MACHINE_GUI_CLASS = "smallscreen"
MACHINE_DISPLAY_WIDTH_PIXELS = "240"
MACHINE_DISPLAY_HEIGHT_PIXELS = "320"
MACHINE_DISPLAY_ORIENTATION = "270"
MACHINE_DISPLAY_PPI = "114"
```

## conf/machine/progear.conf
```bitbake
#@TYPE: Machine
#@NAME: Progear
#@DESCRIPTION: Machine configuration for Progear 1050HX+ webpad

# i386 doesn't work with NPTL, see http://ecos.sourceware.org/ml/libc-ports/2006-03/msg00030.html
TARGET_ARCH = "i586"

require conf/machine/include/tune-pentiummmx.inc

PREFERRED_PROVIDER_virtual/kernel = "linux"
PREFERRED_PROVIDER_virtual/xserver = "xserver-xorg"

KERNEL_IMAGETYPE = "bzImage"

OLDEST_KERNEL = "2.6.17"
GLIBC_ADDONS = "nptl"
GLIBC_EXTRA_OECONF = "--with-tls"

MACHINE_FEATURES = "kernel26 usbhost ext2 pci pcmcia screen alsa irda acpi screen touchscreen x86"

IMAGE_FSTYPES = "tar.gz"

MACHINE_EXTRA_RRECOMMENDS = "\
	kernel-modules \
	"
```

## conf/machine/qemumips64.conf
```bitbake
#@TYPE: Machine
#@NAME: qemu MIPS (big-endian) Emulator setup
#@DESCRIPTION: Machine configuration for running an MIPS64 platform system under qemu emulation 

TARGET_ARCH = "mips64"
FEED_ARCH = "${TARGET_ARCH}"
require conf/machine/include/qemu.inc
require conf/machine/include/tune-mips64.inc

KERNEL_IMAGETYPE = "vmlinux"
KERNEL_OUTPUT = "vmlinux"
SERIAL_CONSOLE = "115200 ttyS0"

PREFERRED_PROVIDER_virtual/kernel = "linux"
MACHINE_EXTRA_RRECOMMENDS = " kernel-modules"
```

## conf/machine/qemuppc.conf
```bitbake
#@TYPE: Machine
#@NAME: QEMU PowerPC Emulator setup
#@DESCRIPTION: Machine configuration for running a PowerPC system under qemu emulation

TARGET_ARCH = "powerpc"

require conf/machine/include/qemu.inc
require conf/machine/include/tune-ppc603e.inc

KERNEL_IMAGETYPE = "vmlinux"
KERNEL_OUTPUT = "vmlinux"

SERIAL_CONSOLE = "115200 ttyS0"

PREFERRED_PROVIDER_virtual/kernel = "linux"
MACHINE_EXTRA_RRECOMMENDS = " kernel-modules"
```

## conf/machine/qemush4.conf
```bitbake
#@TYPE: Machine
#@NAME: QEMU SH4 Emulator setup
#@DESCRIPTION: Machine configuration for running a SH4(rts7751r2dplus) system under qemu emulation

TARGET_ARCH = "sh4"

require conf/machine/include/qemu.inc
require conf/machine/include/tune-sh4.inc

KERNEL_IMAGETYPE = "zImage"

SERIAL_CONSOLE = "115200 ttySC1"

PREFERRED_PROVIDER_virtual/kernel = "linux"
MACHINE_EXTRA_RRECOMMENDS = " kernel-modules"
```

## conf/machine/qemux86.conf
```bitbake
#@TYPE: Machine
#@NAME: qemu x86 Emulator setup
#@DESCRIPTION: Machine configuration for running an x86 system under qemu emulation

require conf/machine/include/qemu.inc
require conf/machine/i686-generic.conf

MACHINE_EXTRA_RRECOMMENDS = "kernel-module-uvesafb v86d"

KERNEL_IMAGETYPE = "bzImage"

SERIAL_CONSOLE = "115200 ttyS0"

PREFERRED_PROVIDER_virtual/kernel = "linux"

GLIBC_ADDONS = "nptl"
GLIBC_EXTRA_OECONF = "--with-tls"
```

## conf/machine/ramses.conf
```bitbake
#@TYPE: Machine
#@NAME: M&N MNCI-RX
#@DESCRIPTION: Machine configuration for the PXA255 based M&N Solutions MNCI-RX

TARGET_ARCH = "arm"
TARGET_OS = "linux"
IPKG_ARCHS = "all arm ${MACHINE}"
PREFERRED_PROVIDER_virtual/kernel = "mnci-ramses"

EXTRA_IMAGECMD_jffs2 = "--pad=0x1ec0000 --eraseblock=0x40000"


USE_DEVFS = "1"
GUI_MACHINE_CLASS = "smallscreen"

# For sysvinit:
USE_VT = "0"
SERIAL_CONSOLE = "115200 tts/0"
```

## conf/machine/rb500.conf
```bitbake
#@TYPE: Machine
#@NAME: Mikrotik RB500
#@DESCRIPTION: Machine configuration for the MIPS based Routerboard

TARGET_ARCH = "mipsel"
PREFERRED_PROVIDER_virtual/kernel = "linux-rb500"

include conf/machine/include/tune-mips2.inc
```

## conf/machine/rokr-e2.conf
```bitbake
#@TYPE: Machine
#@NAME: Motorola EZX rokr e2 
#@DESCRIPTION: Machine configuration for the Motorola GSM phones rokr e2

require conf/machine/include/motorola-ezx-base.inc

#no touchscreen
MACHINE_FEATURES = "kernel26 touchscreen apm alsa bluetooth usbgadget usbhost keyboard screen"
```

## conf/machine/rokre2.conf
```bitbake
#@TYPE: Machine
#@NAME: Motorola EZX ROKR E2
#@DESCRIPTION: Machine configuration for the Motorola GSM Phone ROKR E2

require conf/machine/include/motorola-ezx-base.inc

# there is no touchscreen
MACHINE_FEATURES = "kernel26 apm alsa bluetooth usbgadget usbhost keyboard screen"
MACHINE_FEATURES += "iwmmxt"
```

## conf/machine/rokre6.conf
```bitbake
#@TYPE: Machine
#@NAME: Motorola EZX ROKR E6
#@DESCRIPTION: Machine configuration for the Motorola GSM Phone ROKR E6

require conf/machine/include/motorola-ezx-base.inc
```

## conf/machine/ronetix-pm9261.conf
```bitbake
#@TYPE: Machine
#@Name: Ronetix PM9261 CPU Module
#@DESCRIPTION: Machine.configuration for the Ronetix evaluation board with PM9261 CPU module
#@MAINTAINER: Marco Cavallini <m.cavallini@koansoftware.com>

TARGET_ARCH = "arm"

PREFERRED_PROVIDER_virtual/kernel = "linux"
PREFERRED_PROVIDER_xserver = "xserver-kdrive"

KERNEL_IMAGETYPE = "uImage"

#don't try to access tty1
USE_VT = "0"

MACHINE_FEATURES = "kernel26 ext2 usbhost usbgadget screen touchscreen"

# used by sysvinit_2
SERIAL_CONSOLE = "115200 ttyS0"
IMAGE_FSTYPES ?= "jffs2"
EXTRA_IMAGECMD_jffs2 = "--pad --little-endian --eraseblock=0x20000 -n"

require conf/machine/include/tune-arm926ejs.inc
```

## conf/machine/ronetix-pm9g45.conf
```bitbake
#@TYPE: Machine
#@Name: Ronetix SAM9G45
#@DESCRIPTION: Machine configuration for Ronetix module with AT91SAM9G45 processor

include conf/machine/include/at91-2.6.30.inc
include conf/machine/include/at91-lcd.inc

#PREFERRED_VERSION_linux = "2.6.30"

# Has linux config file in OpenEmbedded
#
LINUX26_DEFCONFIG = "at91sam9g45ek_defconfig"

# Supported u-boot machines
UBOOT_MACHINE = "at91sam9m10g45ek_dataflash_cs0_config"
#UBOOT_MACHINE = "icnova_arm9sodimm_config"
UBOOT_ENTRYPOINT = "0x70008000"

AT91BOOTSTRAP_BOARD = "at91sam9g45df at91sam9g45ek at91sam9g45nf"

MACHINE_FEATURES += "usbhost"
```

## conf/machine/rt3000.conf
```bitbake
#@TYPE: Machine
#@NAME: M&N RT3000/RT4000
#@DESCRIPTION: Machine configuration for the PXA255 based M&N Solutions Radio Terminal RT3000/RT4000

PREFERRED_PROVIDER_virtual/kernel = "rt3000"

USE_DEVFS = "1"
GUI_MACHINE_CLASS = "smallscreen"

# For sysvinit:
USE_VT = "0"
SERIAL_CONSOLE = "115200 tts/0"
```

## conf/machine/rx1950.conf
```bitbake
#@TYPE: Machine
#@NAME: HP iPAQ rx1950
#@DESCRIPTION: Machine configuration for the HP iPAQ rx1950

#
# Hardware-based properties
#
TARGET_ARCH = "arm"

# Samsung S3C2xxx CPU
require conf/machine/include/tune-arm920t.inc

ROOT_FLASH_SIZE = "64"
VOLATILE_STORAGE_SIZE = "64"
MACHINE_GUI_CLASS = "smallscreen"
MACHINE_DISPLAY_WIDTH_PIXELS = "240"
MACHINE_DISPLAY_HEIGHT_PIXELS = "320"
MACHINE_FEATURES = "kernel26 touchscreen apm alsa irda wifi usbgadget screen vfat"

#
# Software/packages selection
#
PREFERRED_PROVIDER_virtual/kernel = "linux"
PREFERRED_VERSION_linux = "2.6.35"
PCMCIA_MANAGER = "pcmciautils"

SERIAL_CONSOLE = "115200 ttyS0 vt100"
USE_VT = "0"
```

## conf/machine/rx3000.conf
```bitbake
#@TYPE: Machine
#@NAME: HP iPAQ rx3xxx
#@DESCRIPTION: Machine configuration for the HP iPAQ rx3xxx

#
# Hardware-based properties
#
TARGET_ARCH = "arm"
PACKAGE_EXTRA_ARCHS = "armv4 armv4t"

# Samsung S3C2xxx CPU
include conf/machine/include/tune-arm920t.conf

ROOT_FLASH_SIZE = "32"
VOLATILE_STORAGE_SIZE = "64"
GUI_MACHINE_CLASS = "smallscreen"
MACHINE_FEATURES = "kernel26 touchscreen apm alsa irda bluetooth wifi usbgadget screen"

#
# Software/packages selection
#
PREFERRED_PROVIDER_virtual/kernel = "linux-handhelds-2.6"
PCMCIA_MANAGER = "pcmciautils"
PREFERRED_PROVIDER_xserver = "xserver-kdrive"

#
# Modules autoload and other boot properties
#
module_autoload_snd-pcm-oss = "snd-pcm-oss"
module_autoload_g_ether = "g_ether"

SERIAL_CONSOLE = "115200 ttyS0 vt100"
USE_VT = "0"

require conf/machine/include/LAB-settings.conf
```

## conf/machine/sarge-at91.conf
```bitbake
#@TYPE: Machine
#@Name: Sarge AT91RM9200 blackmesaeast dev boards
#@DESCRIPTION: Machine configuration for sarge_at91 dev boards
#
#Homepage: http://blackmesaeast.com.pl/projects/electronics/sarge-single-board-computer/

TARGET_ARCH = "arm"
PACKAGE_EXTRA_ARCHS = "armv4t"

# used by sysvinit_2
SERIAL_CONSOLE = "115200 ttyS0"

IMAGE_FSTYPES = "tar.gz"

MACHINE_FEATURES = "kernel26"

require conf/machine/include/tune-arm920t.inc

PREFERRED_PROVIDER_virtual/kernel = "linux"

# device has own patchset for u-boot 1.1.6
PREFERRED_VERSION_u-boot = "1.1.6"
PREFERRED_VERSION_linux  = "2.6.21"

KERNEL_IMAGETYPE = "uImage"
```

## conf/machine/sarge_at91.conf
```bitbake
#@TYPE: Machine
#@Name: Sarge AT91RM9200 blackmesaeast dev boards
#@DESCRIPTION: Machine configuration for sarge_at91 dev boards
#
#Homepage: http://blackmesaeast.com.pl/projects/electronics/sarge-single-board-computer/

TARGET_ARCH = "arm"
PACKAGE_EXTRA_ARCHS = "armv4t"

# used by sysvinit_2
SERIAL_CONSOLE = "115200 ttyS0"

IMAGE_FSTYPES = "tar.gz"

MACHINE_FEATURES = "kernel26"

require conf/machine/include/tune-arm920t.conf

PREFERRED_PROVIDER_virtual/kernel = "linux-sarge"
```

## conf/machine/sciphone_g2.conf
```bitbake
#@TYPE: Machine
#@Name: Sicphone G2 based on Mediatek's MT6235 Development Platform
#@DESCRIPTION: Machine configuration for the Sciphone G2 mobile phone

TARGET_ARCH = "arm"

UBOOT_ENTRYPOINT = "8000"
PREFERRED_PROVIDER_virtual/kernel = "linux-mtk"
PREFERRED_PROVIDER_xserver = "xserver-kdrive"

KERNEL_IMAGETYPE = "uImage"
UBOOT_MACHINE = "sciphone_g2_config"

#don't try to access tty1
USE_VT = "0"

MACHINE_FEATURES = "kernel26 screen touchscreen"
EXTRA_IMAGEDEPENDS += "u-boot-mtk"

# used by sysvinit_2
SERIAL_CONSOLE = "115200 ttyMTK0"
IMAGE_FSTYPES += "tar ext3"

require conf/machine/include/tune-arm926ejs.inc
```

## conf/machine/sequoia.conf
```bitbake
# Copyright (C) 2007, Stelios Koroneos - Digital OPSiS, All Rights Reserved
# Released under the MIT license (see packages/COPYING)
#@TYPE: Machine
#@Name: AMCC Sequoia Development Platform
#@DESCRIPTION: Machine configuration for the AMCC Sequoia development platform http://www.amcc.com/Embedded/Downloads/440EPx/


TARGET_ARCH = "powerpc"

PREFERRED_PROVIDER_virtual/kernel = "linux"
KERNEL_IMAGETYPE = "uImage"

MACHINE_FEATURES = "kernel26 usbhost"

PREFERRED_VERSION_u-boot = "1.3.2"
UBOOT_MACHINE = "sequoia_config"
UBOOT_ENTRYPOINT = "0"
UBOOT_LOADADDRESS = "0"



#don't try to access tty1
USE_VT = "0"
SERIAL_CONSOLE = "115200 ttyS0"

EXTRA_IMAGECMD = "--big-endian"
ERASEBLOCK_SIZE = "0x10000"
IMAGE_FSTYPES = "jffs2"

#tune for the AMCC440 cpu
require conf/machine/include/tune-ppc440e.inc
```
