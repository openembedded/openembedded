## conf/machine/htcdream.conf
```bitbake
#@TYPE: Machine
#@NAME: HTC Dream
#@DESCRIPTION: Machine configuration for the HTC Dream phone (aka T-Mobile G1 and Google ADP-1)

require conf/machine/include/htc-msm7.inc

MACHINE_DISPLAY_WIDTH_PIXELS = "320"
MACHINE_DISPLAY_HEIGHT_PIXELS = "480"
MACHINE_DISPLAY_ORIENTATION = "0"
MACHINE_DISPLAY_PPI = "185"

MACHINE_FEATURES = "kernel26 touchscreen screen phone gps usbgadget bluetooth wifi keyboard ext2"

module_autoload_wl1251_sdio = "wl1251_sdio"

MACHINE_EXTRA_RRECOMMENDS = "\
  kernel-module-wl1251 \
  kernel-module-wl1251-sdio \
  kernel-module-msm-wifi \
  firmware-ti-wl1251 \
"

PREFERRED_PROVIDER_virtual/kernel = "linux-leviathan"

XSERVER = " \
        xserver-xorg \
        xserver-xorg-extension-glx \
        xserver-xorg-extension-dri \
        xf86-input-tslib \
        xf86-input-evdev \
        xf86-input-mouse \
        xf86-input-keyboard \
        xf86-video-fbdev \
"
```

## conf/machine/htckaiser.conf
```bitbake
#@TYPE: Machine
#@NAME: HTC Kaiser
#@DESCRIPTION: Machine configuration for the HTC Kaiser smartphone (aka HTC TyTN II)

require conf/machine/include/htc-msm7.inc

MACHINE_DISPLAY_WIDTH_PIXELS = "240"
MACHINE_DISPLAY_HEIGHT_PIXELS = "320"

MACHINE_FEATURES = "kernel26 touchscreen screen keyboard phone gps"
```

## conf/machine/htcleo.conf
```bitbake
#@TYPE: Machine
#@NAME: HTC Leo
#@DESCRIPTION: Machine configuration for HTC Leo smartphone (aka HTC HD2)

require conf/machine/include/htc-qsd8.inc

MACHINE_DISPLAY_WIDTH_PIXELS = "480"
MACHINE_DISPLAY_HEIGHT_PIXELS = "800"

MACHINE_FEATURES = "kernel26 mmc mmcroot screen serial touchscreen keyboard usbgadget usbhost bluetooth wifi phone compass gsensor lightsensor"
```

## conf/machine/htcnike.conf
```bitbake
#@TYPE: Machine
#@NAME: HTC Nike
#@DESCRIPTION: Machine configuration for the HTC Nike smartphone

require conf/machine/include/htc-msm7.inc

MACHINE_DISPLAY_WIDTH_PIXELS = "240"
MACHINE_DISPLAY_HEIGHT_PIXELS = "320"

MACHINE_FEATURES = "kernel26 touchscreen screen phone gps"
```

## conf/machine/htcraphael.conf
```bitbake
#@TYPE: Machine
#@NAME: HTC Raphael
#@DESCRIPTION: Machine configuration for HTC Raphael smartphone (aka HTC Touch Pro)

require conf/machine/include/htc-msm7.inc

MACHINE_DISPLAY_WIDTH_PIXELS = "480"
MACHINE_DISPLAY_HEIGHT_PIXELS = "640"

MACHINE_FEATURES = "kernel26 touchscreen screen phone gps usb keyboard"
```

## conf/machine/htctitan.conf
```bitbake
#@TYPE: Machine
#@NAME: HTC Titan phone
#@DESCRIPTION: Machine configuration for HTC Titan phone
require conf/machine/include/tune-arm1136-novfp.inc

PREFERRED_PROVIDER_virtual/kernel = "linux-msm7xxxx"

PREFERRED_PROVIDER_virtual/xserver = "xserver-kdrive"
XSERVER = "xserver-kdrive-fbdev"
MACHINE_DISPLAY_WIDTH_PIXELS = "240"
MACHINE_DISPLAY_HEIGHT_PIXELS = "320"

MACHINE_FEATURES = "kernel26 touchscreen screen phone gps camera keyboard"

IMAGE_FSTYPES += "tar.gz cpio.gz"
```

## conf/machine/htctornado.conf
```bitbake
#-----------------------------------------------------------------------------
#@TYPE: Machine
#@NAME: HTC Typhoon, HTC Tornado, HTC Hurricane
#@DESCRIPTION: Machine configuration for the HTC Typhoon/Tornado/Hurricane GSM phones
#-----------------------------------------------------------------------------

TARGET_ARCH = "arm"
PACKAGE_EXTRA_ARCHS = "armv4t armv5te"

PREFERRED_PROVIDER_virtual/kernel = "linux-tornado-omap2"

MACHINE_FEATURES = "kernel26 apm alsa bluetooth usbgadget vfat"

MACHINE_EXTRA_RDEPENDS = "alsa-state"

# package gta01 specific modules
MACHINE_EXTRA_RRECOMMENDS = "\
  kernel-module-ext2 \
  alsa-state"

# used by some images
ROOT_FLASH_SIZE = "30"

# extra jffs2 tweaks, not yet used
EXTRA_IMAGECMD_jffs2 = "--eraseblock=0x4000 -n"

# cpu tuning
include conf/machine/include/tune-arm926ejs.inc
```

## conf/machine/htcuniversal.conf
```bitbake
#@TYPE: Machine
#@NAME: HTC Universal
#@DESCRIPTION: Machine configuration for the HTC Universal

#
# Hardware-based properties
#
TARGET_ARCH = "arm"
PACKAGE_EXTRA_ARCHS = " armv4t armv5te iwmmxt"

# Use tune-xscale per default. Machine independent feeds should be built with tune-strongarm.
require conf/machine/include/tune-xscale.inc

# Uncomment this to use iwmmxt optimizations. Remove the above xscale stuff first
#require conf/machine/include/tune-iwmmxt.inc

MACHINE_GUI_CLASS = "bigscreen"
MACHINE_DISPLAY_WIDTH_PIXELS = "480"
MACHINE_DISPLAY_HEIGHT_PIXELS = "640"
MACHINE_FEATURES = "kernel26 apm alsa irda usbgadget usbhost keyboard touchscreen screen wifi bluetooth phone vfat"
MACHINE_FEATURES += "iwmmxt"

#
# Software/packages selection
#
PREFERRED_PROVIDER_virtual/kernel = "linux-handhelds-2.6"
PREFERRED_PROVIDER_xserver = "xserver-kdrive"
XSERVER = "xserver-kdrive-fbdev"

MACHINE_EXTRA_RDEPENDS = "tiinit acx-firmware"
MACHINE_EXTRA_RRECOMMENDS = "\
				kernel-module-i2c-pxa \
				kernel-module-snd-htcuniversal-audio \
				kernel-module-htcuniversal-acx \
				kernel-module-acx \
                                kernel-module-i2c-algo-bit \
                                kernel-module-htcuniversal-ts2 \
                                kernel-module-htcuniversal-phone \
                                kernel-module-ts-adc-debounce \
                                kernel-module-htcuniversal-bt \
				"

#
# Modules autoload and other boot properties
#
#module_autoload_acx = "acx"
module_autoload_htcuniversal_acx = "htcuniversal_acx"
module_autoload_snd-pcm-oss = "snd-pcm-oss"
module_autoload_snd-mixer-oss = "snd-mixer-oss"
module_autoload_snd-htcuniversal_audio = "snd-htcuniversal_audio"
module_autoload_htcuniversal-ts2 = "htcuniversal-ts2"

#FIXME: this should be controlled by a userspace utility later.
module_autoload_g_ether = "g_ether"
```

## conf/machine/htcvogue.conf
```bitbake
#@TYPE: Machine
#@NAME: HTC Vogue
#@DESCRIPTION: Machine configuration for HTC Vogue smartphone

require conf/machine/include/htc-msm7.inc

MACHINE_DISPLAY_WIDTH_PIXELS = "240"
MACHINE_DISPLAY_HEIGHT_PIXELS = "320"

MACHINE_FEATURES = "kernel26 touchscreen screen phone gps camera"
```

## conf/machine/htcwallaby.conf
```bitbake
#@TYPE: Machine
#@NAME: HTC Wallaby
#@DESCRIPTION: Machine configuration for the HTC Wallaby aka XDA aka many other names

#
# Hardware-based properties
#
TARGET_ARCH = "arm"
PACKAGE_EXTRA_ARCHS = "armv4 "

require conf/machine/include/tune-strongarm.inc

ROOT_FLASH_SIZE = "16" 
VOLATILE_STORAGE_SIZE = "32"
MACHINE_GUI_CLASS = "smallscreen"
MACHINE_DISPLAY_WIDTH_PIXELS = "240"
MACHINE_DISPLAY_HEIGHT_PIXELS = "320"
MACHINE_FEATURES = "kernel26 touchscreen apm alsa irda usbgadget screen phone vfat"

#
# Software/packages selection
#
PREFERRED_PROVIDER_virtual/kernel = "linux-handhelds-2.6"
PCMCIA_MANAGER = "pcmciautils"
PREFERRED_PROVIDER_xserver = "xserver-kdrive"



#
# Modules autoload and other boot properties
#
SERIAL_CONSOLE = "115200 ttySA0 vt100"
USE_VT = "0"
```

## conf/machine/hx2000.conf
```bitbake
#@TYPE: Machine
#@NAME: iPAQ hx2xxx
#@DESCRIPTION: Machine configuration for the hx2000 iPAQs with a pxa27x CPU 

TARGET_ARCH = "arm"
IPKG_EXTRA_ARCHS = "armv4 armv4t armv5te iwmmxt ipaqpxa ipaq-pxa270"

#PREFERRED_PROVIDER_virtual/kernel = "linux-openzaurus"

PREFERRED_VERSION_orinoco-modules = "0.15rc1"

ROOT_FLASH_SIZE = "80"

EXTRA_IMAGECMD_jffs2 = "; sumtool -i ${DEPLOY_DIR_IMAGE}/${IMAGE_NAME}.rootfs.jffs2 \
			  -o ${DEPLOY_DIR_IMAGE}/${IMAGE_NAME}.rootfs-summary.jffs2 \
			  -e 256KiB -p"

IMAGE_FSTYPES ?= "jffs2"

MODUTILS = "26"	

MACHINE_FEATURES = "kernel26 touchscreen apm alsa pcmcia bluetooth irda wifi usbgadget"

PCMCIA_MANAGER = "pcmciautils"
BOOTMODULES_RRECOMMENDS = "${@linux_module_packages('${PXA270_MODULES}', d)}"
BOOTSTRAP_EXTRA_RRECOMMENDS += " ${BOOTMODULES_RRECOMMENDS}"
BOOTSTRAP_EXTRA_RDEPENDS = "tiinit acx-firmware"

PXA270_MODULES = "snd_pcm_oss snd_mixer_oss hidp \
		  nls_cp437 nls_iso8859-1 nls_utf8 af_key"

SERIAL_CONSOLE = "115200 ttyS0"

GUI_MACHINE_CLASS = "smallscreen"

# Use tune-xscale per default. Machine independent feeds should be built with tune-strongarm.
include conf/machine/include/tune-xscale.conf

# Uncomment this to use iwmmxt optimizations. Remove the above xscale stuff first
#include conf/machine/include/tune-iwmmxt.conf

module_autoload_evdev = "evdev"
module_autoload_pcmcia = "pcmcia"
module_autoload_mmc_block = "mmc_block"
module_autoload_snd-pcm-oss = "snd-pcm-oss"
module_autoload_snd-mixer-oss = "snd-mixer-oss"
module_autoload_pxa27x_udc = "pxa27x_udc"

#FIXME: this should be controlled by a userspace utility later.
module_autoload_g_ether = "g_ether"
```

## conf/machine/hx4700.conf
```bitbake
#@TYPE: Machine
#@NAME: HP iPAQ hx47xx
#@DESCRIPTION: Machine configuration for the hx4700 iPAQ with a pxa27x CPU

#
# Hardware-based properties
#
TARGET_ARCH = "arm"
PACKAGE_EXTRA_ARCHS = " iwmmxt  "

IMAGE_FSTYPES += "jffs2"

# Use tune-xscale per default. Machine independent feeds should be built with tune-strongarm.
require conf/machine/include/tune-xscale.inc

# Uncomment this to use iwmmxt optimizations. Remove the above xscale stuff first
#require conf/machine/include/tune-iwmmxt.inc

ROOT_FLASH_SIZE = "80"
VOLATILE_STORAGE_SIZE = "64"
MACHINE_GUI_CLASS = "bigscreen"
MACHINE_DISPLAY_WIDTH_PIXELS = "480"
MACHINE_DISPLAY_HEIGHT_PIXELS = "640"
MACHINE_DISPLAY_ORIENTATION = "0"
MACHINE_DISPLAY_PPI = "200"
MACHINE_FEATURES = "alsa apm bluetooth irda kernel26 pcmcia screen touchscreen usbgadget wifi vfat"
MACHINE_FEATURES += "iwmmxt"

#
# Software/packages selection
#
PREFERRED_PROVIDER_virtual/kernel = "linux-handhelds-2.6"
PCMCIA_MANAGER = "pcmciautils"
MODUTILS = "26"	

XSERVER = "xserver-kdrive-w100"

PREFERRED_VERSION_orinoco-modules = "0.15rc1"

MACHINE_EXTRA_RDEPENDS = "tiinit acx-firmware"
MACHINE_EXTRA_RRECOMMENDS = "\
	kernel-module-i2c-pxa \
	kernel-module-pxa27x-voltage \
	kernel-module-pxa27x-voltage-max158xx \
	kernel-module-acx \
	kernel-module-hx4700-acx \
	kernel-module-hx4700-bt \
	kernel-module-snd-hx4700-audio"

#write out a reflash.ctl with the appriate entries for the rootfs, the ones for the kernel should already be there
EXTRA_IMAGECMD_jffs2 = "; sumtool -i ${DEPLOY_DIR_IMAGE}/${IMAGE_NAME}.rootfs.jffs2 \
			  -o ${DEPLOY_DIR_IMAGE}/${IMAGE_NAME}.rootfs-summary.jffs2 \
			  -e 256KiB -p ; echo '${IMAGE_NAME}  ${IMAGE_NAME}.rootfs.jffs2 - root' >> ${DEPLOY_DIR_IMAGE}/reflash.ctl"


#
# Modules autoload and other boot properties
#
module_autoload_evdev = "evdev"
module_autoload_hx4700_power = "hx4700_power"
module_autoload_pcmcia = "pcmcia"
module_autoload_hx4700_pcmcia = "hx4700_pcmcia"
module_autoload_asic3_mmc = "asic3_mmc"
module_autoload_mmc_block = "mmc_block"
module_autoload_hx4700_ts = "hx4700_ts"
module_autoload_hx4700_navpt = "hx4700_navpt"
module_autoload_hx4700_bt = "hx4700_bt"
module_autoload_snd-hx4700_audio = "snd-hx4700_audio"
module_autoload_snd-pcm-oss = "snd-pcm-oss"
module_autoload_snd-mixer-oss = "snd-mixer-oss"
module_autoload_pxa27x_udc = "pxa27x_udc"

#FIXME: this should be controlled by a userspace utility later.
module_autoload_g_ether = "g_ether"

SERIAL_CONSOLE = "115200 ttyS0"
```

## conf/machine/i586-generic.conf
```bitbake
# Copyright (C) 2007, Stelios Koroneos - Digital OPSiS, All Rights Reserved
# Released under the MIT license (see packages/COPYING)
#@TYPE: Machine
#@NAME: i586-generic
#@DESCRIPTION: Machine configuration for a generic i586 machine


TARGET_ARCH = "i586"
PACKAGE_EXTRA_ARCHS = "x86"


PREFERRED_PROVIDER_virtual/kernel = "linux"
PREFERRED_PROVIDER_virtual/xserver = "xserver-kdrive"
XSERVER="xserver-kdrive-vesa"

KERNEL_IMAGETYPE = "bzImage"

GLIBC_ADDONS = "nptl"
GLIBC_EXTRA_OECONF = "--with-tls"

IMAGE_FSTYPES ?= "ext2.gz"

MACHINE_FEATURES = "kernel26 screen keyboard pci usbhost acpi ext2 x86"
MACHINE_EXTRA_RRECOMMENDS = " kernel-modules"


#tune for pentium cpu
require conf/machine/include/tune-pentium.inc
```

## conf/machine/i686-generic.conf
```bitbake
# Copyright (C) 2007, Stelios Koroneos - Digital OPSiS, All Rights Reserved
# Released under the MIT license (see packages/COPYING)
#@TYPE: Machine
#@NAME: i686-generic
#@DESCRIPTION: Machine configuration for a generic i686 machine


TARGET_ARCH = "i686"
PACKAGE_EXTRA_ARCHS = "x86"

PREFERRED_PROVIDER_virtual/kernel = "linux"
PREFERRED_PROVIDER_virtual/xserver = "xserver-kdrive"
XSERVER="xserver-kdrive-vesa"

KERNEL_IMAGETYPE = "bzImage"

GLIBC_ADDONS = "nptl"
GLIBC_EXTRA_OECONF = "--with-tls"

IMAGE_FSTYPES ?= "ext2.gz"

MACHINE_FEATURES = "kernel26 screen keyboard pci usbhost acpi ext2 x86"
MACHINE_EXTRA_RRECOMMENDS = " kernel-modules"

#tune for pentium pro cpu
require conf/machine/include/tune-pentiumpro.inc
```

## conf/machine/iei-nanogx-466.conf
```bitbake
# Copyright (C) 2009, Petr Stetiar
# Released under the MIT license (see packages/COPYING)
#@TYPE: Machine
#@NAME: IEI Nano GX-466
#@DESCRIPTION: Machine configuration for IEI Nano GX-466 - http://bit.ly/t9TOj

TARGET_ARCH =  "i586"

require conf/machine/include/tune-geode.inc

MACHINE_FEATURES = "kernel26 pci vfat ext2 keyboard usbhost sound touchscreen screen serial ethernet"

KERNEL_IMAGETYPE = "bzImage"
IMAGE_FSTYPES ?= "ext2 tar.bz2"

PREFERRED_PROVIDER_virtual/kernel = "linux"
PREFERRED_PROVIDER_virtual/xserver = "xserver-xorg"
XSERVER = "xserver-xorg \
           xf86-input-evdev \
           xf86-input-mouse \
           xf86-input-tslib \
           xf86-video-geode \
           xerver-xorg-module-libint10 \
           xserver-xorg-module-xaa \
           xf86-input-keyboard"

GUI_MACHINE_CLASS = "bigscreen"

GLIBC_ADDONS = "nptl"
GLIBC_EXTRA_OECONF = "--with-tls --with-cpu=i586"
```

## conf/machine/imote2.conf
```bitbake
#@TYPE: Machine
#@Name: Crossbow iMote2
#@DESCRIPTION: Machine configuration for Crossbow iMote 2
TARGET_ARCH = "arm"

PREFERRED_PROVIDER_virtual/kernel = "linux"

PACKAGE_EXTRA_ARCHS = " iwmmxt"

KERNEL_IMAGETYPE = "zImage"
IMAGE_FSTYPE += "jffs2"
EXTRA_IMAGECMD_jffs2 = "--little-endian -e 0x40000 --pad=0x01DC0000 --eraseblock=0x20000"

CMDLINE="root=/dev/mtdblock2 rootfstype=jffs2 console=ttyS2,115200 mem=32M"

SERIAL_CONSOLE = "115200 ttyS2"

require conf/machine/include/tune-xscale.inc

ROOT_FLASH_SIZE ?= "30"

MACHINE_FEATURES = "kernel26 usbgadget alsa iwmmxt"
```

## conf/machine/include/AT91-LCD.inc
```bitbake
# Common description for Atmel ARM processors with LCD controller

include conf/machine/include/AT91.inc

MACHINE_FEATURES += "screen touchscreen keyboard"

# Some options we disable for now
# MACHINE_FEATURES += "apm"
# MACHINE_FEATURES += "lcd"
# MACHINE_FEATURES += "bluetooth wifi irda phone gps"
# MACHINE_FEATURES += "mmc mmcroot fat"
# MACHINE_FEATURES += "i2c spi serial"
# MACHINE_FEATURES += "sound libogg libvorbis"
```
