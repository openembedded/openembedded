## conf/machine/include/AT91.inc
```bitbake
# Common description for Atmel ARM processors

TARGET_ARCH = "arm"
#PACKAGE_EXTRA_ARCHS = "armv4t armv5te"
CPU_FAMILY = "at91"

PREFERRED_PROVIDER_virtual/kernel = "linux"
PREFERRED_VERSION_linux = "2.6.32"

#PREFERRED_PROVIDER_virtual/xserver = "xserver-kdrive"
#PREFERRED_PROVIDER_virtual/xserver = "xserver-kdrive-1300"
#PREFERRED_PROVIDER_virtual/xserver = "xserver-xorg"
#PREFERRED_PROVIDER_xserver = "xserver-xorg"
#PREFERRED_PROVIDER_xserver = "xserver-kdrive"
#XSERVER = "xserver-kdrive-fbdev"
# Angstrom defines:
#PREFERRED_VERSION_xserver-kdrive = "1.4.0.90"
#PREFERRED_VERSION_xserver-kdrive = "1.6.1"

PREFERRED_PROVIDER_at91bootstrap = "at91bootstrap_2.13"
PREFERRED_VERSION_at91bootstrap = "2.13"

PREFERRED_PROVIDER_u-boot = "u-boot_2009.08"
PREFERRED_VERSION_u-boot = "2009.08"

KERNEL_IMAGETYPE = "uImage"

# PREFERRED_VERSION_mplayer = "svn"

#don't try to access tty1
USE_VT = "0"

MACHINE_FEATURES = " kernel26 alsa ext2 usbgadget vfat uboot "
EXTRA_IMAGEDEPENDS += "u-boot"
EXTRA_IMAGEDEPENDS += "at91bootstrap"

MACHINE_EXTRA_RDEPENDS += " kernel-modules "
#MACHINE_EXTRA_RDEPENDS += " atmel-fixes "

# used by sysvinit_2
SERIAL_CONSOLE = "115200 ttyS0"
IMAGE_FSTYPES ?= "jffs2"
EXTRA_IMAGECMD_jffs2 = "--pad --little-endian --eraseblock=0x20000 -n"
#
# Uncomment or add kernel modules that should be autoloaded
#module_autoload_g_file_storage = ${@base_contains('MACHINE_FEATURES', 'usbgadget',  'g_file_storage', '',d)}
#module_autoload_g_ether        = ${@base_contains('MACHINE_FEATURES', 'usbgadget',  'g_ether', '',d)}
module_autoload_g_serial       = ${@base_contains('MACHINE_FEATURES', 'usbgadget',  'g_serial', '',d)}

require conf/machine/include/tune-arm926ejs.inc
```

## conf/machine/include/afeb9260.inc
```bitbake
#@TYPE: Machine
#@Name: AFEB9260 development board http://www.oshw.ru/

TARGET_ARCH = "arm"
#PACKAGE_EXTRA_ARCHS = "armv4t armv5te"

PREFERRED_PROVIDER_virtual/kernel = "linux"
PREFERRED_PROVIDER_xserver = "xserver-kdrive"
XSERVER = "xserver-kdrive-fbdev"

KERNEL_IMAGETYPE = "uImage"

#don't try to access tty1
USE_VT = "0"

MACHINE_FEATURES = "kernel26 ext2 usbhost usbgadget"
EXTRA_IMAGEDEPENDS += "at91bootstrap u-boot"

# used by sysvinit_2
SERIAL_CONSOLE = "115200 ttyS0"
IMAGE_FSTYPES ?= "jffs2"
EXTRA_IMAGECMD_jffs2 = "--pad --little-endian --eraseblock=0x20000 -n"

require conf/machine/include/tune-arm926ejs.inc
```

## conf/machine/include/at91-2.6.39.inc
```bitbake
# Common description for Atmel ARM processors running 2.6.39

TARGET_ARCH = "arm"
#PACKAGE_EXTRA_ARCHS = "armv4t armv5te"
SOC_FAMILY = "at91"

require conf/machine/include/tune-arm926ejs.inc

PREFERRED_PROVIDER_virtual/kernel = "linux"
PREFERRED_VERSION_linux = "2.6.39.2"
PREFERRED_VERSION_webkit-gtk = "1.2.3"
PREFERRED_VERSION_tslib = "1.0+git%"
PREFERRED_PROVIDER_bash = "bash"


PREFERRED_PROVIDER_at91bootstrap = "at91bootstrap"
PREFERRED_VERSION_at91bootstrap = "3.1.2"

PREFERRED_PROVIDER_u-boot = "u-boot"
PREFERRED_VERSION_u-boot = "2010.06"

KERNEL_IMAGETYPE = "uImage"

#don't try to access tty1
USE_VT = "0"

MACHINE_FEATURES = " kernel26 alsa ext2 usbgadget vfat uboot "

# Some options we disable for now
# MACHINE_FEATURES += "apm"
# MACHINE_FEATURES += "lcd"
# MACHINE_FEATURES += "bluetooth wifi irda phone gps"
# MACHINE_FEATURES += "mmc mmcroot fat"
# MACHINE_FEATURES += "i2c spi serial"
# MACHINE_FEATURES += "sound libogg libvorbis"

EXTRA_IMAGEDEPENDS += "u-boot"
EXTRA_IMAGEDEPENDS += "at91bootstrap"

MACHINE_EXTRA_RDEPENDS += " kernel-modules "
#MACHINE_EXTRA_RDEPENDS += " atmel-fixes "

# used by sysvinit_2
SERIAL_CONSOLE = "115200 ttyS0"

IMAGE_FSTYPES ?= "jffs2 ubi ubifs"
EXTRA_IMAGECMD_jffs2 = "--pad --little-endian --eraseblock=0x20000 --pagesize=0x800 -n"
UBI_VOLNAME = "rootfs"
MKUBIFS_ARGS = "-m 2KiB -e 124KiB -c 1984"
UBINIZE_ARGS = "-m 2KiB -p 128KiB -s 2048"

#
# Uncomment or add kernel modules that should be autoloaded
#module_autoload_g_file_storage = ${@base_contains('MACHINE_FEATURES', 'usbgadget',  'g_file_storage', '',d)}
#module_autoload_g_ether        = ${@base_contains('MACHINE_FEATURES', 'usbgadget',  'g_ether', '',d)}
module_autoload_g_serial       = ${@base_contains('MACHINE_FEATURES', 'usbgadget',  'g_serial', '',d)}
```

## conf/machine/include/at91-lcd-noX.inc
```bitbake
# Common description for Atmel ARM processors with LCD controller

MACHINE_FEATURES += "screen touchscreen keyboard"
```

## conf/machine/include/at91-lcd.inc
```bitbake
# Common description for Atmel ARM processors with LCD controller

#PREFERRED_PROVIDER_virtual/xserver = "xserver-kdrive"
#PREFERRED_PROVIDER_virtual/xserver = "xserver-kdrive-1300"
#PREFERRED_PROVIDER_virtual/xserver = "xserver-xorg"
#PREFERRED_PROVIDER_xserver = "xserver-xorg"
PREFERRED_PROVIDER_xserver = "xserver-kdrive"
#XSERVER = "xserver-kdrive-fbdev"
#XSERVER = "xserver-xorg \
#           xf86-input-evdev \
#           xf86-input-mouse \
#           xf86-input-tslib \
#           xf86-video-fbdev \
#           xf86-input-keyboard"

# Angstrom defines:
#PREFERRED_VERSION_xserver-kdrive = "1.4.0.90"
#PREFERRED_VERSION_xserver-kdrive = "1.6.1"

MACHINE_FEATURES += "screen touchscreen keyboard"

# Some options we disable for now
# MACHINE_FEATURES += "apm"
# MACHINE_FEATURES += "lcd"
# MACHINE_FEATURES += "bluetooth wifi irda phone gps"
# MACHINE_FEATURES += "mmc mmcroot fat"
# MACHINE_FEATURES += "i2c spi serial"
# MACHINE_FEATURES += "sound libogg libvorbis"
```

## conf/machine/include/at91-server-xorg.inc
```bitbake
# Common description for Atmel ARM processors with LCD controller
# xserver-xorg version

PREFERRED_VERSION_xserver-common = "1.34"
PREFERRED_PROVIDER_virtual/xserver = "xserver-xorg"
XSERVER = "xserver-xorg \
           xf86-input-evdev \
           xf86-input-mouse \
           xf86-input-tslib \
           xf86-video-fbdev \
           xf86-input-keyboard"

include conf/machine/include/at91-lcd.inc
```

## conf/machine/include/at91-xserver-kdrive.inc
```bitbake
# Common description for Atmel ARM processors with LCD controller
# xserver-kdrive version

#PREFERRED_PROVIDER_virtual/xserver = "xserver-kdrive"
#PREFERRED_PROVIDER_virtual/xserver = "xserver-kdrive-1300"

PREFERRED_PROVIDER_xserver = "xserver-kdrive"
#XSERVER = "xserver-kdrive-fbdev"

# Angstrom defines:
#PREFERRED_VERSION_xserver-kdrive = "1.4.0.90"
#PREFERRED_VERSION_xserver-kdrive = "1.6.1"

include conf/machine/include/at91-lcd-noX.inc
```
