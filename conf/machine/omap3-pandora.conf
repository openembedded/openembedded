## conf/machine/omap3-pandora.conf
```bitbake
#@TYPE: Machine
#@NAME: OMAP3 based Pandora Handheld Console
#@DESCRIPTION: Machine configuration for the Pandora http://www.openpandora.org/ Handheld Console
#@MAINTAINER: John Willis

TARGET_ARCH = "arm"


PREFERRED_PROVIDER_u-boot = "u-boot-omap3pandora"

PREFERRED_PROVIDER_virtual/xserver = "xserver-xorg"

XSERVER = " \
	xserver-xorg \
	xserver-xorg-extension-glx \
	xserver-xorg-extension-dri \
	xf86-input-evtouch \	
	xf86-input-evdev \
	xf86-input-mouse \
	xf86-input-keyboard \
	xf86-video-omapfb \
"

#800 * 480 Widescreen
GUI_MACHINE_CLASS = "bigscreen"
MACHINE_GUI_CLASS = "bigscreen"
MACHINE_DISPLAY_WIDTH_PIXELS = "800"
MACHINE_DISPLAY_HEIGHT_PIXELS = "480"

#IMAGE_FSTYPES += "tar.bz2 ubi"
IMAGE_FSTYPES = "tar.bz2"

SERIAL_CONSOLE = "115200 ttyS0"

require conf/machine/include/omap3.inc

# Put it below omap3.inc as we override the kernel and PR here
PREFERRED_PROVIDER_virtual/kernel = "${MACHINE}-kernel"
MACHINE_KERNEL_PR = "r2"

# Use our 'Powered by Angstrom' splash for the images.
PREFERRED_PROVIDER_virtual/psplash = "psplash-omap3pandora"

KERNEL_IMAGETYPE = "uImage"

# do ubiattach /dev/ubi_ctrl -m 4
# From dmesg:
# UBI: smallest flash I/O unit:    2048
# UBI: logical eraseblock size:    129024 bytes
# from ubiattach stdout:
# UBI device number 0, total 1996 LEBs
MKUBIFS_ARGS = "-m 2048 -e 129024 -c 1996"

# do ubiattach /dev/ubi_ctrl -m 4
# from dmesg:
# UBI: smallest flash I/O unit:    2048
# UBI: physical eraseblock size:   131072 bytes (128 KiB)
# UBI: sub-page size:              512
UBINIZE_ARGS = "-m 2048 -p 128KiB -s 512"

UBOOT_ENTRYPOINT = "0x80008000"
UBOOT_LOADADDRESS = "0x80008000"
UBOOT_ARCH = "arm"
UBOOT_MACHINE = "omap3_pandora_config"

PREFERRED_PROVIDER_u-boot = "u-boot-omap3pandora"
PREFERRED_PROVIDER_x-load = "x-load-omap3pandora"
PREFERRED_VERSION_u-boot-omap3pandora = "git"
PREFERRED_VERSION_x-load-omap3pandora = "git"
EXTRA_IMAGEDEPENDS += "u-boot x-load"

MACHINE_FEATURES = "kernel26 apm usbgadget usbhost keyboard vfat ext2 screen touchscreen alsa bluetooth wifi sdio"
```

## conf/machine/omap3517-evm.conf
```bitbake
#@TYPE: Machine
#@NAME: omap3 EVM
#@DESCRIPTION: Machine configuration for the TI omap3517 EVM
TARGET_ARCH = "arm"

PREFERRED_PROVIDER_virtual/xserver = "xserver-xorg"
XSERVER = "xserver-xorg \
           xf86-input-evdev \
           xf86-input-mouse \
           xf86-input-tslib \
           xf86-video-omapfb \
           xf86-input-keyboard"

GUI_MACHINE_CLASS = "smallscreen"

require conf/machine/include/omap3.inc

# Ship all kernel modules
MACHINE_EXTRA_RRECOMMENDS = " omap3-sgx-modules kernel-modules"

IMAGE_FSTYPES ?= "jffs2 tar.bz2"
EXTRA_IMAGECMD_jffs2 = "-lnp -e 0x20000 -s 2048"

SERIAL_CONSOLE = "115200 ttyS2"

PREFERRED_PROVIDER_virtual/kernel = "linux-omap-psp"

UBOOT_ARCH = "arm"
UBOOT_MACHINE = "omap3517_evm_config"
XLOAD_MACHINE = "omap3517evm_config"

MACHINE_FEATURES = "kernel26 apm usbgadget usbhost vfat ext2 screen touchscreen ethernet"

# NOTE: there are NAND and OneNAND versions of this board...

# do ubiattach /dev/ubi_ctrl -m 4
# From dmesg:
# UBI: smallest flash I/O unit:    2048
# UBI: logical eraseblock size:    129024 bytes
# from ubiattach stdout:
# UBI device number 0, total 1996 LEBs
MKUBIFS_ARGS = "-m 2048 -e 129024 -c 1996"

# do ubiattach /dev/ubi_ctrl -m 4
# from dmesg:
# UBI: smallest flash I/O unit:    2048
# UBI: physical eraseblock size:   131072 bytes (128 KiB)
# UBI: sub-page size:              512
UBINIZE_ARGS = "-m 2048 -p 128KiB -s 512"
```

## conf/machine/omap3evm.conf
```bitbake
#@TYPE: Machine
#@NAME: omap3 EVM
#@DESCRIPTION: Machine configuration for the TI omap3 EVM
TARGET_ARCH = "arm"

PREFERRED_PROVIDER_virtual/xserver = "xserver-kdrive"
XSERVER = "xserver-kdrive-fbdev"
GUI_MACHINE_CLASS = "smallscreen"

#include conf/machine/include/tune-arm1136jf-s.inc
# requires gcc 4.3.0:
include conf/machine/include/tune-cortexa8.inc

# Ship all kernel modules
MACHINE_EXTRA_RRECOMMENDS = " kernel-modules"

IMAGE_FSTYPES ?= "jffs2 tar.bz2"
EXTRA_IMAGECMD_jffs2 = "-lnp "

SERIAL_CONSOLE = "115200 ttyS0"

PREFERRED_PROVIDER_virtual/kernel ?= "linux-omap"

KERNEL_IMAGETYPE = "uImage"

UBOOT_ENTRYPOINT = "0x80008000"
UBOOT_LOADADDRESS = "0x80008000"
UBOOT_ARCH = "arm"
UBOOT_MACHINE = "omap3_evm_config"

MACHINE_FEATURES = "kernel26 apm usbgadget usbhost vfat ext2 screen touchscreen"
```

## conf/machine/omap4430-panda.conf
```bitbake
#@TYPE: Machine
#@NAME: OMAP4430 Panda
#@DESCRIPTION: Machine configuration for the OMAP4430 Panda

require conf/machine/include/omap4.inc

XLOAD_MACHINE = "omap4430panda_config"
XLOAD_LOAD_ADDRESS = 0x40304350

PREFERRED_PROVIDER_virtual/bootloader = "u-boot"
UBOOT_MACHINE = "omap4_panda_config"

PREFERRED_PROVIDER_virtual/kernel = "linux-omap4"

PREFERRED_PROVIDER_virtual/xserver = "xserver-xorg"
XSERVER = "xserver-xorg \
           xserver-xorg-extension-dri \
           xserver-xorg-extension-dri2 \
           xserver-xorg-extension-glx \
           xf86-input-evdev \
           xf86-input-mouse \
           xf86-input-tslib \
           xf86-video-fbdev \
           xf86-input-keyboard"

GUI_MACHINE_CLASS = "bigscreen"

IMAGE_FSTYPES += "tar.bz2"

SERIAL_CONSOLE = "115200 ttyO2"

MACHINE_EXTRA_RRECOMMENDS = " kernel-modules"
MACHINE_FEATURES = "kernel26 alsa apm ext2 screen touchscreen usbgadget usbhost vfat"
```

## conf/machine/omap5912osk.conf
```bitbake
#@TYPE: Machine
#@NAME: OMAP5912 cpu on an OSK board
#@DESCRIPTION: Machine configuration for the OMAP Starter Kit with a 5912 processor

TARGET_ARCH = "arm"

PREFERRED_PROVIDER_xserver = "xserver-kdrive"
PREFERRED_PROVIDER_virtual/kernel = "linux-omap1"

UBOOT_ENTRYPOINT="0x10c08000"

# PREFERRED_VERSION_u-boot = "1.1.6"

SERIAL_CONSOLE ?= "115200 ttyS0"
IMAGE_FSTYPES ?= "jffs2"
EXTRA_IMAGECMD_jffs2 = "--pad --little-endian --eraseblock=0x20000 -n"

ROOT_FLASH_SIZE = "29"

MACHINE_FEATURES = "kernel26 pcmcia usbhost alsa"

MACHINE_EXTRA_RRECOMMENDS = "kernel-module-ide-cs \
                          kernel-module-ide-disk \
                          kernel-module-ide-core \
                          kernel-module-nls-iso8859-1 \
                          kernel-module-nls-cp437 \
                          kernel-module-nls-base \
                          kernel-module-vfat \
                          kernel-module-ohci-hcd \
                          kernel-module-tlv320aic23 \
                          kernel-module-snd-omap-alsa-aic23 \
                          "

RDEPENDS_kernel-base = ""

require conf/machine/include/tune-arm926ejs.inc
```

## conf/machine/omapzoom.conf
```bitbake
#@TYPE: Machine
#@NAME: omapzoom machine
#@DESCRIPTION: Machine configuration for the http://omapzoom.org board
TARGET_ARCH = "arm"

PREFERRED_PROVIDER_virtual/xserver = "xserver-xorg"
XSERVER = "xserver-xorg \
           xf86-input-evdev \
           xf86-input-tslib \
           xf86-input-mouse \
           xf86-video-omapfb \
           xf86-input-keyboard"

# Only has DVI connector for external screen
GUI_MACHINE_CLASS = "bigscreen"

require conf/machine/include/omap3.inc

IMAGE_FSTYPES += "tar.bz2 jffs2"
EXTRA_IMAGECMD_jffs2 = "-lnp "

# Guesswork
SERIAL_CONSOLE = "115200 ttyS2"

PREFERRED_PROVIDER_virtual/kernel = "linux-omap"

KERNEL_IMAGETYPE = "uImage"

UBOOT_ENTRYPOINT = "0x80008000"
UBOOT_LOADADDRESS = "0x80008000"
UBOOT_MACHINE = "omap3_zoom1_config"

# do ubiattach /dev/ubi_ctrl -m 4
# From dmesg:
# UBI: smallest flash I/O unit:    2048
# UBI: logical eraseblock size:    129024 bytes
# from ubiattach stdout:
# UBI device number 0, total 1996 LEBs
MKUBIFS_ARGS = "-m 2048 -e 129024 -c 1996"

# do ubiattach /dev/ubi_ctrl -m 4
# from dmesg:
# UBI: smallest flash I/O unit:    2048
# UBI: physical eraseblock size:   131072 bytes (128 KiB)
# UBI: sub-page size:              512
UBINIZE_ARGS = "-m 2048 -p 128KiB -s 512"


PREFERRED_VERSION_u-boot = "git"
#EXTRA_IMAGEDEPENDS += "u-boot x-load"

# and sdio
MACHINE_FEATURES = "kernel26 touchscreen phone screen apm usbgadget usbhost vfat alsa"
```

## conf/machine/omapzoom36x.conf
```bitbake
#@TYPE: Machine
#@NAME: omapzoom36x machine
#@DESCRIPTION: Machine configuration for the OMAP Zoom36x at http://omapzoom.org
TARGET_ARCH = "arm"

PREFERRED_PROVIDER_virtual/xserver = "xserver-xorg"
XSERVER = "xserver-xorg \
           xf86-input-evdev \
           xf86-input-tslib \
           xf86-input-mouse \
           xf86-video-omapfb \
           xf86-video-fbdev \
           xf86-input-keyboard"

# Has HDMI connector for external screen
GUI_MACHINE_CLASS = "bigscreen"

require conf/machine/include/omap3.inc

IMAGE_FSTYPES += "tar.bz2"

SERIAL_CONSOLE = "115200 ttyS3"

PREFERRED_PROVIDER_virtual/kernel = "linux-omap-zoomsync"

KERNEL_IMAGETYPE = "uImage"

UBOOT_ENTRYPOINT = "0x80008000"
UBOOT_LOADADDRESS = "0x80008000"
UBOOT_MACHINE = "omap3630zoom3_config"
XLOAD_MACHINE = "omap3630zoom3_config"

PREFERRED_VERSION_u-boot = "git"
PREFERRED_VERSION_x-load = "git"
EXTRA_IMAGEDEPENDS += "u-boot x-load"

MACHINE_EXTRA_RRECOMMENDS = ""
MACHINE_FEATURES = "kernel26 touchscreen phone screen apm usbgadget usbhost vfat alsa"
```

## conf/machine/openzaurus-pxa-2.6.conf
```bitbake
#@TYPE: Machine
#@NAME: Sharp Zaurus SL-C700,Sharp Zaurus SL-C750,Sharp Zaurus SL-C760
#@DESCRIPTION: Machine configuration for the Sharp Zaurus PXA devices running a 2.6 kernel

include conf/machine/zaurus-clamshell.conf

PREFERRED_PROVIDER_virtual/kernel = "openzaurus"
PREFERRED_VERSION_orinoco-modules = "20050101"

BOOTSTRAP_EXTRA_DEPENDS = "virtual/kernel udev sysfsutils hostap-modules    orinoco-modules \
pcmcia-cs apmd ppp wireless-tools irda-utils openswan hostap-wpa-supplicant-nossl lrzsz ppp-dialin"
BOOTSTRAP_EXTRA_RDEPENDS = "kernel        udev sysfsutils hostap-modules-cs orinoco-modules-cs \
pcmcia-cs apm  ppp wireless-tools irda-utils udev-utils"
# kernel-module-net-fd kernel-module-registers kernel-module-pxa-bi \
# kernel-module-usbdcore kernel-module-usbdmonitor chkhinge"

ROOT_FLASH_SIZE = "64"
```

## conf/machine/overo.conf
```bitbake
#@TYPE: Machine
#@NAME: overo machine
#@DESCRIPTION: Machine configuration for the Gumstix Overo

require conf/machine/include/omap3.inc
PREFERRED_PROVIDER_virtual/kernel = "linux-omap-psp"

TARGET_ARCH = "arm"
MACHINE_FEATURES = "kernel26 screen apm usbgadget usbhost vfat alsa touchscreen"

UBOOT_MACHINE_overo = "omap3_overo_config"

SERIAL_CONSOLE = "115200 ttyS2"

IMAGE_FSTYPES += "tar.bz2"

PREFERRED_PROVIDER_virtual/xserver = "xserver-xorg"
XSERVER = "xserver-xorg \
           xf86-input-evdev \
           xf86-input-mouse \
           xf86-input-tslib \
           xf86-video-omapfb \
           xf86-input-keyboard"

GUI_MACHINE_CLASS = "bigscreen"

# do ubiattach /dev/ubi_ctrl -m 4
# From dmesg:
# UBI: smallest flash I/O unit:    2048
# UBI: logical eraseblock size:    129024 bytes
# from ubiattach stdout:
# UBI device number 0, total 1996 LEBs
MKUBIFS_ARGS = "-m 2048 -e 129024 -c 1996"

# do ubiattach /dev/ubi_ctrl -m 4
# from dmesg:
# UBI: smallest flash I/O unit:    2048
# UBI: physical eraseblock size:   131072 bytes (128 KiB)
# UBI: sub-page size:              512
UBINIZE_ARGS = "-m 2048 -p 128KiB -s 512"
```

## conf/machine/oxnas.conf
```bitbake
#@TYPE: Machine
#@NAME: OXE810(D)SE NAS devices
#@DESCRIPTION: Machine configuration for Oxford OXE810(D)SE NAS devices http://www.oxsemi.com/products/storage/nas.html

TARGET_ARCH = "arm"

MACHINE_FEATURES = "kernel26 ext2 pci usbhost ethernet serial raid uboot"

SERIAL_CONSOLE = "115200 ttyS0"

PREFERRED_PROVIDER_virtual/kernel = "linux"

KERNEL_IMAGETYPE = "uImage"

PREFERRED_VERSION_u-boot = "1.1.2"
UBOOT_LOADADDRESS = "0x48008000"
UBOOT_ENTRYPOINT = "0x48008000"
UBOOT_ARCH = "arm"

require conf/machine/include/tune-arm926ejs.inc
```

## conf/machine/p2020ds.conf
```bitbake
#@TYPE: Machine
#@Name: P2020ds
#@DESCRIPTION: Machine configuration for the freescale p2020ds development board

TARGET_ARCH = "powerpc"

PREFERRED_PROVIDER_virtual/kernel ?= "linux"

MACHINE_FEATURES = "kernel26 usbhost pci ext2 vfat nfs uboot"

KERNEL_IMAGETYPE = "uImage"
UBOOT_ENTRYPOINT = "0"

UBOOT_MACHINE = "P2020DS_config"

# Need to create jffs2 images with the correct endianess
EXTRA_IMAGECMD_jffs2 = " --big-endian -e 0x20000"

#don't try to access tty1
USE_VT = "0"

#setup serial console on Com1
SERIAL_CONSOLE = "-L 115200 ttyS0"

#tune for the e500v2 core
require conf/machine/include/tune-ppce500v2.inc

PREFERRED_PROVIDER_virtual/xserver = "xserver-xorg"
XSERVER = "xserver-xorg \
           xf86-input-evdev \
           xf86-input-mouse \
           xf86-video-fbdev \
           xf86-input-keyboard"
GUI_MACHINE_CLASS = "bigscreen"
```

## conf/machine/p2020rdb.conf
```bitbake
#@TYPE: Machine
#@Name: Freescale P2020RDB
#@DESCRIPTION: Machine configuration for the Freescale P2020RDB Reference Design Board

# Development board with a PowerPC SoC with MMU/FPU and PCI, PCI Express, SATA, etc.

TARGET_ARCH = "powerpc"

PREFERRED_PROVIDER_virtual/kernel ?= "linux"

MACHINE_FEATURES = "kernel26 usbhost pci ext2 uboot"

KERNEL_IMAGETYPE = "uImage"

PREFERRED_VERSION_u-boot ?= "git"
UBOOT_MACHINE = "P2020RDB_config"
UBOOT_ENTRYPOINT = "0"
UBOOT_LOADADDRESS = "0"

# rootfs on NAND flash -- possibly incorrect, not tested yet, for this machine
EXTRA_IMAGECMD_jffs2 = "--pad --big-endian --eraseblock=0x4000 --no-cleanmarkers"

#don't try to access tty1
USE_VT = "0"

SERIAL_CONSOLE = "115200 ttyS0"

#tune for the e500v2 core
require conf/machine/include/tune-ppce500v2.inc

PREFERRED_PROVIDER_virtual/xserver = "xserver-xorg"
XSERVER = "xserver-xorg \
           xf86-input-evdev \
           xf86-input-mouse \
           xf86-video-fbdev \
           xf86-input-keyboard"
GUI_MACHINE_CLASS = "bigscreen"
```

## conf/machine/palmld.conf
```bitbake
#@TYPE: Machine
#@NAME: Palm LifeDrive
#@DESCRIPTION: Machine configuration for the Palm LifeDrive

require conf/machine/include/palm.inc

ROOT_FLASH_SIZE = "100"

MACHINE_GUI_CLASS = "bigscreen"
MACHINE_DISPLAY_WIDTH_PIXELS = "320"
MACHINE_DISPLAY_HEIGHT_PIXELS = "480"
MACHINE_FEATURES += "pcmcia wifi"
MACHINE_FEATURES += "iwmmxt"


MACHINE_EXTRA_RRECOMMENDS += "\
	kernel-module-bcm2035-uart \
	kernel-module-leds-palmld \
	kernel-module-ledtrig-heartbeat \
	kernel-module-ledtrig-hwtimer \
	kernel-module-ledtrig-timer \
	kernel-module-palmld-battery \
	kernel-module-palmld-ide \
	kernel-module-palmld-pcmcia \
	kernel-module-pcmcia-core \
	kernel-module-pda-power \
	kernel-module-pxa2xx-core \
	kernel-module-snd-pxa2xx-ac97 \
	kernel-module-snd-pxa2xx-pcm \
	"

#
# Modules autoload and other boot properties
#

module_conf_wm97xx-ts = "options wm97xx-ts pil=2"
```

## conf/machine/palmpre.conf
```bitbake
#@TYPE: Machine
#@NAME: Palm Pre machine
#@DESCRIPTION: Machine configuration for the Palm Pre handset

require conf/machine/include/palmpre.inc
```

## conf/machine/palmpre2.conf
```bitbake
#@TYPE: Machine
#@NAME: Palm Pre 2 machine
#@DESCRIPTION: Machine configuration for the Palm Pre 2 handset

require conf/machine/include/palmpre.inc
```

## conf/machine/palmt650.conf
```bitbake
#@TYPE: Machine
#@NAME: Palm Treo 650
#@DESCRIPTION: Machine configuration for the Palm Treo 650

require conf/machine/include/palm.inc

ROOT_FLASH_SIZE = "100"

SERIAL_CONSOLE = "115200 ttyS1"

GUI_MACHINE_CLASS = "bigscreen"

MACHINE_EXTRA_RRECOMMENDS += "kernel-module-snd-pxa2xx-ac97 \
                           kernel-module-pxa27x-keyboard \
                           kernel-module-wm97xx-ts"

module_autoload_g_ether = "g_ether"
```

## conf/machine/palmt680.conf
```bitbake
#@TYPE: Machine
#@NAME: Palm Treo 680
#@DESCRIPTION: Machine configuration for the Palm Treo 680

require conf/machine/include/palm.inc

ROOT_FLASH_SIZE = "100"

SERIAL_CONSOLE = "115200 ttyS0"

GUI_MACHINE_CLASS = "bigscreen"

MACHINE_EXTRA_RRECOMMENDS += "kernel-module-pxa27x-keyboard \
                           kernel-module-wm97xx-ts"
```
