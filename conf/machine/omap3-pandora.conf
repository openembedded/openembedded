## conf/machine/palmtc.conf
```bitbake
#@TYPE: Machine
#@NAME: Palm TC
#@DESCRIPTION: Machine configuration for the Palm Tungsten C

require conf/machine/include/palm.inc

MACHINE_FEATURES += "wifi"

ROOT_FLASH_SIZE = "100"

SERIAL_CONSOLE = "115200 ttyS0"

GUI_MACHINE_CLASS = "bigscreen"
```

## conf/machine/palmtt.conf
```bitbake
#@TYPE: Machine
#@NAME: Palm Tungsten T
#@DESCRIPTION: Machine configuration for Palm Tungsten T/T2

TARGET_ARCH = "arm"
PACKAGE_EXTRA_ARCHS = "armv5te"

MACHINE_GUI_CLASS = "bigscreen"
MACHINE_DISPLAY_WIDTH_PIXELS = "320"
MACHINE_DISPLAY_HEIGHT_PIXELS = "320"

PREFERRED_PROVIDER_xserver = "xserver-kdrive"
PREFERRED_PROVIDER_virtual/kernel = "linux-palm-omap1"

SERIAL_CONSOLE ?= "115200 ttyS0"
EXTRA_IMAGECMD_jffs2 = "--pad --little-endian --eraseblock=0x40000"

require conf/machine/include/tune-arm926ejs.inc
```

## conf/machine/palmtt2.conf
```bitbake
WARNING:="${@bb.fatal('\n*\n*\n*    Sorry, There is no dedicated configuration for the Palm Tungsten T2,\n*    because \
its very similar to the Palm Tungsten T. Use MACHINE = \"palmtt\".\n*\n*\n')}"
```

## conf/machine/palmtt3.conf
```bitbake
#@TYPE: Machine
#@NAME: Palm Tungsten|T3
#@DESCRIPTION: Machine configuration for the Palm Tungsten|T3

require conf/machine/include/palm.inc

ROOT_FLASH_SIZE = "100"

SERIAL_CONSOLE = "115200 ttyS3"
```

## conf/machine/palmtt5.conf
```bitbake
#@TYPE: Machine
#@NAME: Palm Tungsten T5
#@DESCRIPTION: Machine configuration for the Palm Tungsten T5

require conf/machine/include/palm.inc

ROOT_FLASH_SIZE = "100"

SERIAL_CONSOLE = "115200 ttyS0"

GUI_MACHINE_CLASS = "bigscreen"

MACHINE_EXTRA_RRECOMMENDS += "kernel-module-pxa27x-keyboard \
                           kernel-module-wm97xx-ts \
			   kernel-module-palmt5-battery"
```

## conf/machine/palmtx.conf
```bitbake
#@TYPE: Machine
#@NAME: Palm TX
#@DESCRIPTION: Machine configuration for the Palm TX

require conf/machine/include/palm.inc

MACHINE_GUI_CLASS = "bigscreen"
MACHINE_DISPLAY_WIDTH_PIXELS = "320"
MACHINE_DISPLAY_HEIGHT_PIXELS = "480"
MACHINE_FEATURES += "pcmcia wifi"

ROOT_FLASH_SIZE = "100"

SERIAL_CONSOLE = "115200 ttyS0"

MACHINE_EXTRA_RRECOMMENDS += "kernel-module-pxa27x-keyboard \
                           kernel-module-wm97xx-ts \
                           kernel-module-palmtx-battery \
                           kernel-module-palmtx-border \
                           kernel-module-bcm2035-uart \
                           kernel-module-palmtx-pcmcia \
                           kernel-module-pcmcia-core \
                           kernel-module-pda-power \
                           kernel-module-pxa2xx-core \
                           kernel-module-snd-pxa2xx-ac97 \
                           kernel-module-snd-pxa2xx-pcm"


module_autoload_g_ether = "g_ether"
```

## conf/machine/palmz31.conf
```bitbake
#@TYPE: Machine
#@NAME: Palm Zire 31
#@DESCRIPTION: Machine configuration for the Palm Zire 31

require conf/machine/include/palm.inc

ROOT_FLASH_SIZE = "16"
MACHINE_GUI_CLASS = "smallscreen"
MACHINE_DISPLAY_WIDTH_PIXELS = "160"
MACHINE_DISPLAY_HEIGHT_PIXELS = "160"

SERIAL_CONSOLE = "115200 ttyS0"

# Use tune-xscale per default. Machine independent feeds should be built with tune-strongarm.
require conf/machine/include/tune-thumb.inc

MACHINE_EXTRA_RRECOMMENDS += "kernel-module-i2c-pxa \
			     kernel-module-i2c-algo-pxa \
			     kernel-module-i2c-dev \
			     kernel-module-wm97xx-ts \		
			     kernel-module-palmz31-battery"

module_autoload_g_ether = "g_ether"
```

## conf/machine/palmz71.conf
```bitbake
#@TYPE: Machine
#@NAME: Palm Zire 71
#@DESCRIPTION: Machine configuration for Palm Zire 71

TARGET_ARCH = "arm"
PACKAGE_EXTRA_ARCHS = "armv5te"

PREFERRED_PROVIDER_xserver = "xserver-kdrive"
PREFERRED_PROVIDER_virtual/kernel = "linux-palm-omap1"
PREFERRED_PROVIDERS += "virtual/${TARGET_PREFIX}depmod:module-init-tools-cross"

SERIAL_CONSOLE ?= "115200 ttyS0"
EXTRA_IMAGECMD_jffs2 = "--pad --little-endian --eraseblock=0x40000"

require conf/machine/include/tune-arm926ejs.inc
```
