## conf/machine/om-3d7k.conf
```bitbake
#-----------------------------------------------------------------------------
#@TYPE: Machine
#@NAME: Openmoko 3D7K
#@DESCRIPTION: Machine configuration for the Openmoko 3D7K GSM phone
#-----------------------------------------------------------------------------

TARGET_ARCH = "arm"

PREFERRED_PROVIDER_virtual/kernel ?= "linux-openmoko-devel"
PREFERRED_PROVIDER_virtual/xserver = "xserver-xorg"

MACHINE_FEATURES = "kernel26 apm alsa bluetooth usbgadget usbhost phone vfat ext2"
MACHINE_DISPLAY_WIDTH_PIXELS = "480"
MACHINE_DISPLAY_HEIGHT_PIXELS = "640"
MACHINE_DISPLAY_ORIENTATION = "0"
MACHINE_DISPLAY_PPI = "285"
XSERVER = "xserver-xorg"

# package machine specific modules
MACHINE_EXTRA_RRECOMMENDS = "\
  kernel-modules \
"

SERIAL_CONSOLE = "115200 ttySAC2"
USE_VT = "0"

# used by some images
ROOT_FLASH_SIZE = "256"

# boots only from SD
IMAGE_FSTYPES = "tar.bz2"

# tune for S3C6410
include conf/machine/include/tune-arm1176jzf-s.inc
```

## conf/machine/om-gta01.conf
```bitbake
#-----------------------------------------------------------------------------
#@TYPE: Machine
#@NAME: OM GTA01 (Neo1973)
#@DESCRIPTION: Machine configuration for the OM Neo1973 GSM phone
#-----------------------------------------------------------------------------

TARGET_ARCH = "arm"

PREFERRED_PROVIDER_virtual/kernel ?= "linux-openmoko"
PREFERRED_PROVIDER_virtual/xserver = "xserver-xorg"
PREFERRED_PROVIDER_virtual/libgl = "mesa-dri"

KERNEL_IMAGETYPE = "uImage"
UBOOT_ENTRYPOINT = "30008000"

OLDEST_KERNEL_linux-gnueabi = "2.6.24"

MACHINE_FEATURES = "kernel26 apm alsa bluetooth gps usbgadget usbhost phone wifi vfat ext2"
MACHINE_DISPLAY_WIDTH_PIXELS = "480"
MACHINE_DISPLAY_HEIGHT_PIXELS = "640"
MACHINE_DISPLAY_ORIENTATION = "0"
MACHINE_DISPLAY_PPI = "285"
XSERVER ?= "xserver-xorg \
           xf86-input-tslib \
           xf86-input-evdev \
           xf86-video-fbdev \
           xf86-input-keyboard \
           xf86-input-mouse"

# fbreader specific
READER_RESOLUTION = "480x640"
READER_ARCH       = "desktop"
READER_UI         = "gtk"

# package machine specific modules
MACHINE_EXTRA_RRECOMMENDS = "\
  kernel-module-gta01-pm-bt  \
  kernel-module-gta01-pm-gps \
  kernel-module-gta01-pm-gsm \
  kernel-module-gta01kbd \
  kernel-module-s3cmci \
  kernel-module-snd-soc-neo1973-wm8753 \
  kernel-module-g-ether \
  kernel-module-leds-s3c24xx \
  kernel-module-leds-pwm \
  kernel-module-leds-gpio \
"

# do not outcomment, we bypass the sysvinit.bb logic here -- see FIC GTA01 inittab
#SERIAL_CONSOLE = "115200 ttySAC0"

# used by some images
ROOT_FLASH_SIZE = "60"

IMAGE_FSTYPES += "tar.gz jffs2 ubi"

# extra jffs2 tweaks
EXTRA_IMAGECMD_jffs2 = "--little-endian --eraseblock=0x4000 --pad -n"

# do ubiattach /dev/ubi_ctrl -m 4
# From dmesg:
# UBI: smallest flash I/O unit:    512
# UBI: logical eraseblock size:    15360 bytes
# from ubiattach stdout:
# UBI device number 0, total 3907  LEBs
MKUBIFS_ARGS = "-m 512 -e 15360 -c 2376"

# do ubiattach /dev/ubi_ctrl -m 4
# from dmesg:
# UBI: smallest flash I/O unit:    512
# UBI: physical eraseblock size:   16384 bytes (16 KiB)
# UBI: sub-page size:              512
UBINIZE_ARGS = "-m 512 -p 16KiB -s 512 -O 512"

# build / upload tools
EXTRA_IMAGEDEPENDS += "dfu-util-native qi qi-ubi"

module_autoload_snd-soc-neo1973-wm8753 = "snd-soc-neo1973-wm8753"

module_autoload_btusb = "btusb"
module_autoload_leds-s3c24xx = "leds-s3c24xx"
module_autoload_leds-pwm = "leds-pwm"
module_autoload_leds-gpio = "leds-gpio"

# tune for S3C24x0
include conf/machine/include/tune-arm920t.inc
```

## conf/machine/om-gta02.conf
```bitbake
#-----------------------------------------------------------------------------
#@TYPE: Machine
#@NAME: Openmoko GTA02 (NeoFreerunner)
#@DESCRIPTION: Machine configuration for the Openmoko NeoFreerunner GSM phone
#-----------------------------------------------------------------------------

TARGET_ARCH = "arm"

PREFERRED_PROVIDER_virtual/kernel ?= "linux-openmoko-2.6.28"
PREFERRED_PROVIDER_virtual/xserver = "xserver-xorg"

# If you want to have KMS enabled in default kernel, uncomment linux-openmoko-shr-drm-devel
PREFERRED_PROVIDER_virtual/kernel_shr = "linux-openmoko-shr-devel"
#PREFERRED_PROVIDER_virtual/kernel_shr = "linux-openmoko-shr-drm-devel"
#PREFERRED_PROVIDER_virtual/kernel_shr = "linux-openmoko-2.6.31"

PREFERRED_PROVIDER_virtual/libgl_shr = "mesa-dri"
# Override only for shr as it needs mesa-dri_git and ie angstrom has preferred_version set to 7.6
MACHINE_DRI_MODULES_shr = "glamo"

UBOOT_ENTRYPOINT = "30008000"

OLDEST_KERNEL_linux-gnueabi = "2.6.24"

MACHINE_FEATURES = "kernel26 apm alsa bluetooth gps usbgadget usbhost phone wifi vfat ext2"
MACHINE_DISPLAY_WIDTH_PIXELS = "480"
MACHINE_DISPLAY_HEIGHT_PIXELS = "640"
MACHINE_DISPLAY_ORIENTATION = "0"
MACHINE_DISPLAY_PPI = "285"
XSERVER ?= "xserver-xorg \
           xf86-input-tslib \
           xf86-input-evdev \
           xf86-video-glamo \
           xf86-input-keyboard \
           xf86-input-mouse"

# fbreader specific
READER_RESOLUTION = "480x640"
READER_ARCH       = "desktop"
READER_UI         = "gtk"

# package machine specific modules
MACHINE_EXTRA_RRECOMMENDS = "\
  kernel-module-s3cmci \
  kernel-module-snd-soc-neo1973-wm8753 \
  kernel-module-snd-soc-neo1973-gta02-wm8753 \
  kernel-module-g-ether \
  kernel-module-ar6000 \
"

# no need to bypass this as in om-gta01, since this model is not using a multiplexed ttySAC0
SERIAL_CONSOLE = "115200 ttySAC2"
USE_VT = "0"

# used by some images
ROOT_FLASH_SIZE = "256"

IMAGE_FSTYPES += "tar.gz jffs2 ubi"

# extra jffs2 tweaks
EXTRA_IMAGECMD_jffs2 = "--little-endian --eraseblock=0x20000 --pagesize=0x800 \
  --no-cleanmarkers --pad -n ; sumtool --eraseblock=0x20000 --no-cleanmarkers \
  --littleendian --pad \
  -i ${DEPLOY_DIR_IMAGE}/${IMAGE_NAME}.rootfs.jffs2 \
  -o ${DEPLOY_DIR_IMAGE}/${IMAGE_NAME}.rootfs.jffs2.summary ; \
  mv ${DEPLOY_DIR_IMAGE}/${IMAGE_NAME}.rootfs.jffs2 \
  ${DEPLOY_DIR_IMAGE}/${IMAGE_NAME}.rootfs.jffs2.nosummary ; \
  mv ${DEPLOY_DIR_IMAGE}/${IMAGE_NAME}.rootfs.jffs2.summary \
  ${DEPLOY_DIR_IMAGE}/${IMAGE_NAME}.rootfs.jffs2"

# do ubiattach /dev/ubi_ctrl -m 4
# From dmesg:
# UBI: smallest flash I/O unit:    2048
# UBI: logical eraseblock size:    129024 bytes
# from ubiattach stdout:
# UBI device number 0, total 1996 LEBs
MKUBIFS_ARGS = "-m 2048 -e 126976 -c 2047"

# do ubiattach /dev/ubi_ctrl -m 4
# from dmesg:
# UBI: smallest flash I/O unit:    2048
# UBI: physical eraseblock size:   131072 bytes (128 KiB)
# UBI: sub-page size:              512
UBINIZE_ARGS = "-m 2048 -p 128KiB -s 2048 -O 2048"

# build / upload tools
EXTRA_IMAGEDEPENDS += "sjf2410-linux-native dfu-util-native"

module_autoload_snd-soc-neo1973-gta02-wm8753 = "snd-soc-neo1973-gta02-wm8753"
#2.6.31 is using the same name as it was in gta01
module_autoload_snd-soc-neo1973-wm8753 = "snd-soc-neo1973-wm8753"

# tune for S3C24x0
include conf/machine/include/tune-arm920t.inc
```

## conf/machine/om-gta03.conf
```bitbake
#-----------------------------------------------------------------------------
#@TYPE: Machine
#@NAME: Openmoko GTA03 (XXX)
#@DESCRIPTION: Machine configuration for the Openmoko XXX GSM phone
#-----------------------------------------------------------------------------

TARGET_ARCH = "arm"

PREFERRED_PROVIDER_virtual/kernel ?= "linux-openmoko-devel"
PREFERRED_PROVIDER_virtual/xserver = "xserver-kdrive"

MACHINE_FEATURES = "kernel26 apm alsa bluetooth usbgadget usbhost phone vfat ext2"
MACHINE_DISPLAY_WIDTH_PIXELS = "480"
MACHINE_DISPLAY_HEIGHT_PIXELS = "640"
MACHINE_DISPLAY_ORIENTATION = "0"
MACHINE_DISPLAY_PPI = "285"
XSERVER = "xserver-kdrive-glamo xserver-kdrive-fbdev"

# package machine specific modules
MACHINE_EXTRA_RRECOMMENDS = "\
  kernel-modules \
"

# no need to bypass this as in om-gta01, since this model is not using a multiplexed ttySAC0
SERIAL_CONSOLE = "115200 ttySAC2"
USE_VT = "0"

# used by some images
ROOT_FLASH_SIZE = "256"

# boots only from SD
IMAGE_FSTYPES = "tar.bz2"

# tune for S3C6410
include conf/machine/include/tune-arm1176jzf-s.inc
```

## conf/machine/omap1510inn.conf
```bitbake
#@TYPE: Machine
#@NAME: OMAP1610 cpu on an H2 board
#@DESCRIPTION: Machine configuration for the OMAP H2 development board with a 1610 processor

TARGET_ARCH = "arm"
IPKG_ARCHS = "all arm armv5te ${MACHINE}"

PREFERRED_PROVIDER_xserver = "xserver-kdrive"
PREFERRED_PROVIDER_virtual/kernel = "linux-omap-2.6"
PREFERRED_PROVIDERS += "virtual/${TARGET_PREFIX}depmod:module-init-tools-cross"

BOOTSTRAP_EXTRA_RDEPENDS += "modutils-collateral"

SERIAL_CONSOLE ?= "115200 ttyS0"
EXTRA_IMAGECMD_jffs2 = "--pad --little-endian --eraseblock=0x40000"

include conf/machine/include/tune-arm926ejs.conf
```

## conf/machine/omap1610h2.conf
```bitbake
#@TYPE: Machine
#@NAME: OMAP1610 cpu on an H2 board
#@DESCRIPTION: Machine configuration for the OMAP H2 development board with a 1610 processor

TARGET_ARCH = "arm"
IPKG_ARCHS = "all arm armv5te ${MACHINE}"
PREFERRED_PROVIDER_xserver = "xserver-kdrive"
PREFERRED_PROVIDER_virtual/kernel = "linux-omap-2.6"
BOOTSTRAP_EXTRA_DEPENDS = "virtual/kernel modutils-collateral"
BOOTSTRAP_EXTRA_RDEPENDS = "modutils-collateral"

EXTRA_IMAGECMD_jffs2 = "--pad --little-endian --eraseblock=0x40000"

include conf/machine/tune-arm926ejs.conf
```

## conf/machine/omap2420h4.conf
```bitbake
#@TYPE: Machine
#@NAME: OMAP2420 cpu on an H4 board
#@DESCRIPTION: Machine configuration for the OMAP H4 development board with a 2420 processor

TARGET_ARCH = "arm"
PACKAGE_EXTRA_ARCHS = "armv4t armv5te armv6"
PREFERRED_PROVIDER_xserver = "xserver-kdrive"
PREFERRED_PROVIDER_virtual/kernel = "linux-omap2"
PREFERRED_VERSION_u-boot = "1.1.4"

SERIAL_CONSOLE ?= "115200 ttyS0"
EXTRA_IMAGECMD_jffs2 = "--pad --little-endian --eraseblock=0x40000"

MACHINE_FEATURES = "kernel26"

require conf/machine/include/tune-arm1136jf-s.inc
```

## conf/machine/omap2430sdp.conf
```bitbake
#@TYPE: Machine
#@NAME: ARM 1136 cpu on OMAP2430 SDP board
#@DESCRIPTION: Machine configuration for the OMAP 2430 SDP development board with a arm1136 processor.

TARGET_ARCH = "arm"
PREFERRED_PROVIDER_xserver = "xserver-kdrive"
PREFERRED_PROVIDER_virtual/kernel = "linux-omap2"

SERIAL_CONSOLE ?= "115200 ttyS0"
IMAGE_FSTYPES ?= "jffs2"
EXTRA_IMAGECMD_jffs2 = "--pad --little-endian --eraseblock=0x40000"

MACHINE_FEATURES = "kernel26"

require conf/machine/include/tune-arm1136jf-s.inc
```
