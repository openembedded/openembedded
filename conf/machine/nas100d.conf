## conf/machine/nas100d.conf
```bitbake
#@TYPE: Machine
#@NAME: Iomega NAS 100d
#@DESCRIPTION: Machine configuration for the Iomega NAS 100d product

include conf/machine/include/ixp4xx.conf

# TEMPORARY: fixup the command line for nas100d builds
CMDLINE_ROOT = "root=/dev/mtdblock2 rw rootfstype=jffs2 mem=64M@0x00000000 init=/linuxrc"
```

## conf/machine/native.conf
```bitbake
#@TYPE: Machine
#@NAME: Build Station
#@DESCRIPTION: Machine configuration for your build station

TARGET_ARCH = "${BUILD_ARCH}"
TARGET_PREFIX = ""
VENDOR = "-oe"

PREFERRED_PROVIDER_virtual/kernel = "native-kernel"
ASSUME_PROVIDED += "virtual/gcc-initial virtual/gcc virtual/g++"
ASSUME_PROVIDED += "binutils-cross"
ASSUME_PROVIDED += "virtual/libiconv virtual/libintl virtual/libc"
```

## conf/machine/navman-icn330.conf
```bitbake
#@TYPE: Machine
#@NAME: Navman iCN 300
#@DESCRIPTION: Machine configuration for the navman iCN 330 gps devicesx

# see http://www.duff.dk/navman/ for more details

#
# Hardware-based properties
#
TARGET_ARCH = "arm"
PACKAGE_EXTRA_ARCHS = "armv4 armv4t armv5e armv5te"

#Compile with armv5te optimizations, incompatible with armv4(t) cpus
require conf/machine/include/tune-xscale.inc

#Set some hints for metadata  
VOLATILE_STORAGE_SIZE = "32"
GUI_MACHINE_CLASS = "smallscreen"
UBOOT_MACHINE = ""

#Set features for task-base 
# touchscreen is not confirmed
MACHINE_FEATURES = "kernel26 touchscreen apm alsa usbgadget screen"

#
# Software/packages selection
#
PREFERRED_PROVIDER_xserver = "xserver-kdrive"
PREFERRED_PROVIDER_virtual/kernel = "linux-navman"


#
# Modules autoload and other boot properties
#
module_autoload_snd-pcm-oss 	= "snd-pcm-oss"

SERIAL_CONSOLE = "115200 ttyS0 vt100"
USE_VT = "0"
```

## conf/machine/neek.conf
```bitbake
#@TYPE: Machine
#@NAME: NEEK machine
TARGET_ARCH = "nios2"

# This is a machine configuration file for the 
# NEEK (NIOS2 Embedded Evaluation Kit)
# the sof file used to develop/tst this is from
# http://www.nioswiki.com/@api/deki/files/487/=cycloneIII_embedded_evaluation_kit_standard.sof

PREFERRED_PROVIDER_virtual/kernel = "linux-nios2"

EXTRA_IMAGECMD_jffs2 = "-lnp "

# Guesswork
SERIAL_CONSOLE = "115200 ttyS2"


# do ubiattach /dev/ubi_ctrl -m 4
# From dmesg:
# UBI: smallest flash I/O unit:    2048
# UBI: logical eraseblock size:    129024 bytes
# from ubiattach stdout:
# UBI device number 0, total 1996 LEBs
MKUBIFS_ARGS = "-m 2048 -e 129024 -c 1996"

# do ubiattach /dev/ubi_ctrl -m 4
# from dmesg:
# UBI: smallest flash I/O unit:    2048
# UBI: physical eraseblock size:   131072 bytes (128 KiB)
# UBI: sub-page size:              512
UBINIZE_ARGS = "-m 2048 -p 128KiB -s 512"

require conf/machine/include/nios2.inc
```

## conf/machine/netbook-pro.conf
```bitbake
#@TYPE: Machine
#@Name: Psion teklogix netbookpro Platform
#@DESCRIPTION: Machine configuration for Psion teklogix netbookpro Platformm

INHERIT += "linux-kernel-base"

TARGET_ARCH = "arm"
PACKAGE_EXTRA_ARCHS = "arm armv4 armv4t armv5te"

PREFERRED_PROVIDER_virtual/kernel = "${MACHINE}-kernel"

#don't try to access tty1
USE_VT = "0"

#use the epson xserver
XSERVER = "xserver-kdrive-epson"

MACHINE_FEATURES = "kernel26 touchscreen keyboard apm alsa pcmcia bluetooth irda usbhost screen vfat"

# used by sysvinit_2
SERIAL_CONSOLE = "115200 ttySA0 vt100"

# used by some images
ROOT_FLASH_SIZE = "32"
#extra jffs2 tweaks
EXTRA_IMAGECMD_jffs2 = "-e 16384 -p 512 -n --little-endian"
udevdir = "/dev"

GUI_MACHINE_CLASS = "bigscreen"

#The initrd needs /initrd present to be able to do pivot_root 
ROOTFS_POSTPROCESS_COMMAND += " mkdir -p ${IMAGE_ROOTFS}/initrd; "

require conf/machine/include/tune-xscale.inc
```

## conf/machine/netvista.conf
```bitbake
#@TYPE: Machine
#@NAME: Netvista J320 Internet Applicance
#@DESCRIPTION: Machine configuration for a Linux IBM 8365 / J320 PC-based internet terminals

TARGET_ARCH = "i486"
PREFERRED_PROVIDER_virtual/kernel = "linux"
PREFERRED_VERSION_linux = "2.6.23"

XSERVER = "xserver-kdrive-fbdev"

KERNEL_IMAGETYPE = "bzImage"

# todo: convert to task-base
# BOOTSTRAP_EXTRA_RDEPENDS = "kernel pciutils udev kernel-modules"
MACHINE_EXTRA_RRECOMMENDS = " kernel-modules"

MACHINE_FEATURES = "kernel26 pci usbhost ext2 screen keyboard irda apm alsa x86"
ROOT_FLASH_SIZE = "64"
GUI_MACHINE_CLASS = "bigscreen"

udevdir = "/dev"
OLDEST_KERNEL = "2.6.17"
GLIBC_ADDONS = "nptl"
GLIBC_EXTRA_OECONF = "--with-tls"

require conf/machine/include/tune-x86.inc
```

## conf/machine/neuros-osd.conf
```bitbake
#@TYPE: Machine
#@NAME: neuros OSD
#@DESCRIPTION: neuros OSD

TARGET_ARCH = "arm"

PREFERRED_PROVIDER_xserver = "xserver-kdrive"
PREFERRED_PROVIDER_virtual/kernel = "linux-neuros"

KERNEL_IMAGETYPE = "uImage"

UBOOT_ENTRYPOINT = "0x80008000"
UBOOT_LOADADDRESS = "0x80008000"

PREFERRED_VERSION_u-boot = "git"
#UBOOT_MACHINE = "davinci_dvevm_config"

SERIAL_CONSOLE ?= "115200 ttyS0"
EXTRA_IMAGECMD_jffs2 = "--pad --little-endian --eraseblock=0x20000 -n"

ROOT_FLASH_SIZE = "29"

MACHINE_FEATURES = "kernel26 pcmcia usbhost "

require conf/machine/include/tune-arm926ejs.inc
```

## conf/machine/neuros-osd2.conf
```bitbake
#@TYPE: Machine
#@NAME: neuros OSD2
#@DESCRIPTION: neuros OSD2

TARGET_ARCH = "arm"

PREFERRED_PROVIDER_xserver = "xserver-kdrive"
PREFERRED_PROVIDER_virtual/kernel = "linux-neuros"

KERNEL_IMAGETYPE = "uImage"

UBOOT_ENTRYPOINT = "0x80008000"
UBOOT_LOADADDRESS = "0x80008000"

PREFERRED_VERSION_u-boot = "git"
UBOOT_MACHINE = "davinci_ntosd_644xA_config"

SERIAL_CONSOLE ?= "115200 ttyS0"
EXTRA_IMAGECMD_jffs2 = "--pad --little-endian --eraseblock=0x20000 -n"

IMAGE_FSTYPES += "jffs2 yaffs2"

ROOT_FLASH_SIZE = "29"

MACHINE_FEATURES = "kernel26 pcmcia usbhost screen"

require conf/machine/include/tune-arm926ejs.inc
require conf/machine/include/neuros.inc
require conf/machine/include/dm6446.inc
```

## conf/machine/nexusone.conf
```bitbake
#@TYPE: Machine
#@NAME: Nexus One
#@DESCRIPTION: Machine configuration for Nexus One smartphone

require conf/machine/include/htc-qsd8.inc

XSERVER = " \
        xserver-xorg \
        xserver-xorg-extension-glx \
        xserver-xorg-extension-dri \
        xf86-input-evdev \
        xf86-video-fbdev \
"

MACHINE_DISPLAY_WIDTH_PIXELS = "480"
MACHINE_DISPLAY_HEIGHT_PIXELS = "800"

PREFERRED_PROVIDER_virtual/kernel = "linux-nexusone"

KERNEL_IMAGETYPE = "zImage"

MACHINE_FEATURES = "kernel26 mmc mmcroot screen touchscreen usbgadget wifi phone"
```

## conf/machine/nhk15.conf
```bitbake
#@TYPE: Machine
#@NAME: ST Nomadik

#@DESCRIPTION: Machine configuration for the ST Nomadik developmnt board
TARGET_ARCH = "arm"

EXTRA_IMAGECMD_jffs2 = "--little-endian --eraseblock=0x20000 -n -x lzo"

IMAGE_FSTYPES ?= "tar.bz2 ext2.gz jffs2"

SERIAL_CONSOLE = "115200 ttyAMA1"

PREFERRED_PROVIDER_virtual/kernel = "linux"
KERNEL_IMAGETYPE = "uImage"
UBOOT_ENTRYPOINT = "00008000"

PREFERRED_PROVIDER_virtual/xserver = "xserver-kdrive-nomadik"
XSERVER = "xserver-kdrive-nomadikfb"

MACHINE_FEATURES = "kernel26 apm usbgadget"
#MACHINE_EXTRA_RRECOMMENDS="kernel-module-nomadik-saa kernel-module-nomadik-sva"
#MACHINE_EXTRA_RRECOMMENDS="kernel-module-nmdkmod-saa kernel-module-nmdkmod-sva kernel-module-nmdkmod-alsa kernel-module-nmdkmod-v4l2"

require conf/machine/include/tune-arm926ejs.inc
```

## conf/machine/nokia770.conf
```bitbake
#@TYPE: Machine
#@NAME: Nokia 770 internet tablet
#@DESCRIPTION: Machine configuration for the Nokia 770, an omap 1710 based tablet
TARGET_ARCH = "arm"
IPKG_ARCHS = "all arm armv4 armv5te"

PREFERRED_PROVIDER_xserver = "xserver-kdrive"

# 800x480 is big enough for me
GUI_MACHINE_CLASS = "bigscreen"
GPE_EXTRA_DEPENDS += "gaim sylpheed"
GPE_EXTRA_INSTALL += "gaim sylpheed"

include conf/machine/handheld-common.conf

# Use tune-arm926 per default. Machine independent feeds should be built with tune-strongarm.
include conf/machine/tune-arm926ejs.conf


#size of the root partition (yes, it is 123 MB)
ROOT_FLASH_SIZE = "123"

#build omap1 till nokia releases the patches
PREFERRED_PROVIDER_virtual/kernel = "linux-omap1"
PREFERRED_VERSION_orinoco-modules = "0.15rc1"

BOOTSTRAP_EXTRA_DEPENDS = "virtual/kernel udev sysfsutils  \
pcmcia-cs apmd ppp wireless-tools console-tools irda-utils openswan wpa-supplicant-nossl lrzsz ppp-dialin"

BOOTSTRAP_EXTRA_RDEPENDS = "kernel        udev sysfsutils  \
pcmcia-cs apm  ppp wireless-tools irda-utils udev-utils console-tools"

# NFS Modules
BOOTSTRAP_EXTRA_RDEPENDS += "kernel-module-nfs kernel-module-lockd kernel-module-sunrpc"
# Crypto Modules
BOOTSTRAP_EXTRA_RDEPENDS += "kernel-module-des kernel-module-md5"
# SMB and CRAMFS
BOOTSTRAP_EXTRA_RDEPENDS += "kernel-module-smbfs kernel-module-cramfs"
# Serial Modules
BOOTSTRAP_EXTRA_RDEPENDS += "kernel-module-8250 "
# Bluetooth Modules
BOOTSTRAP_EXTRA_RDEPENDS += "kernel-module-bluetooth kernel-module-l2cap kernel-module-rfcomm kernel-module-hci-vhci \
                             kernel-module-bnep kernel-module-hidp kernel-module-hci-uart kernel-module-sco"
# Infrared Modules
BOOTSTRAP_EXTRA_RDEPENDS += "kernel-module-irda kernel-module-ircomm kernel-module-ircomm-tty \
                             kernel-module-irlan kernel-module-irnet kernel-module-ir-usb"
# PPP Modules
BOOTSTRAP_EXTRA_RDEPENDS += "kernel-module-ppp-generic kernel-module-ppp-async"

#USB Gadget Modules
BOOTSTRAP_EXTRA_RDEPENDS += "kernel-module-gadgetfs kernel-module-g-file-storage kernel-module-g-serial \
							 kernel-module-g-ether"
```

## conf/machine/nokia800.conf
```bitbake
#@TYPE: Machine
#@NAME: Nokia 800 internet tablet
#@DESCRIPTION: Machine configuration for the Nokia 800
TARGET_ARCH = "arm"

PREFERRED_PROVIDER_virtual/xserver = "xserver-kdrive-xomap"
XSERVER = "xserver-kdrive-xomap"

GUI_MACHINE_CLASS = "bigscreen"
MACHINE_DISPLAY_WIDTH_PIXELS = "800"
MACHINE_DISPLAY_HEIGHT_PIXELS = "480"

include conf/machine/include/tune-arm1136jf-s.inc

ROOT_FLASH_SIZE = "174"
EXTRA_IMAGECMD_jffs2_nokia800 = "--pad --little-endian --eraseblock=0x20000 -n"

IMAGE_FSTYPES ?= "jffs2"

SERIAL_CONSOLE = "115200 ttyS0"

PREFERRED_PROVIDER_virtual/kernel = "linux-nokia800"

#use this if you are using the nokia initfs
ROOTFS_POSTPROCESS_COMMAND += " remove_init_link; "

MACHINE_FEATURES = "kernel26 apm alsa bluetooth usbgadget usbhost vfat"
MACHINE_ESSENTIAL_EXTRA_RDEPENDS = "nokia770-init"

# build tools
EXTRA_IMAGEDEPENDS += "0xffff-native"
```

## conf/machine/nokia900.conf
```bitbake
#@TYPE: Machine
#@NAME: Nokia 900 internet tablet
#@DESCRIPTION: Machine configuration for the Nokia 900

TARGET_ARCH = "arm"
SOC_FAMILY = "omap3"
require conf/machine/include/tune-cortexa8.inc


PREFERRED_PROVIDER_virtual/xserver = "xserver-xorg"
XSERVER = "xserver-xorg \
           xf86-input-evdev \
           xf86-video-fbdev \
           xf86-input-keyboard \
           xf86-video-omapfb "

MACHINE_EXTRA_RRECOMMENDS = "\
  watchdog \
  kernel-module-g-nokia \
  kernel-module-tsl2563 \
  kernel-module-smc91x \
  kernel-module-leds-lp5523 \
  kernel-module-adp1653 \
  kernel-module-ad5820 \
  kernel-module-et8ek8 \
  kernel-module-fmtx-si4713 \
  kernel-module-leds-twl4030-vibra \
  kernel-module-lis302dl \
  kernel-module-nokia-av \
  kernel-module-omap-ssi \
  kernel-module-omap-wdt \
  kernel-module-phonet \
  kernel-module-radio-bcm2048 \
  kernel-module-rtc-twl4030 \
  kernel-module-smia-sensor \
  kernel-module-ssi-mcsaab-imp \
  kernel-module-tsc2005 \
  kernel-module-twl4030-wdt \
  kernel-module-wl12xx \
  kernel-module-cmt-speech \
  kernel-module-gpio-keys \
  kernel-module-hci-h4p \
  kernel-module-hsi-char \
  kernel-module-isp1704-charger \
  kernel-module-lis3lv02d-i2c \
  kernel-module-mailbox-mach \
  kernel-module-rtc-twl \
  kernel-module-twl4030-pwrbutton \
  kernel-module-wl1251-spi \
  kernel-module-ubifs \
  kernel-module-af-packet \
  kernel-module-snd-soc-rx51 \
  kernel-module-snd-soc-tlv320aic3x \
  kernel-module-snd-soc-omap \
  kernel-module-musb-hdrc \
  kernel-module-twl4030-usb \
  kernel-module-bq27x00-battery \
  kernel-module-cmt-speech \
  kernel-module-hsi-char \
"

GUI_MACHINE_CLASS = "bigscreen"
MACHINE_DISPLAY_WIDTH_PIXELS = "800"
MACHINE_DISPLAY_HEIGHT_PIXELS = "480"

KERNEL_IMAGETYPE = "uImage"

UBOOT_ENTRYPOINT = "0x80008000"
UBOOT_LOADADDRESS = "0x80008000"
EXTRA_IMAGEDEPENDS += "u-boot"

ROOT_FLASH_SIZE = "100"
EXTRA_IMAGECMD_jffs2_nokia900 = "--pad --little-endian --eraseblock=0x20000 -n"

# Add "rootfstype=ubifs ubi.mtd=5,2048 root=ubi0:nokia900-rootfs"
# to the kernel cmdline to boot an ubifs image flashed on /dev/mtd5
# Here are the arguments with the corresponding dmesg messages :
# -m: UBI: smallest flash I/O unit:    2048
# -e: UBI: logical eraseblock size:    126976 bytes
# -c: UBI: number of good PEBs:        2009
# -p: UBI: physical eraseblock size:   131072 bytes (128 KiB)
# -x: best compression ratio
# -s and -O : set to the smallest flash I/O unit to bypass the subpages
# See http://www.linux-mtd.infradead.org/faq/ubi.html#L_vid_offset_mismatch for more details
# else you have some errors like theses in dmesg with ubiattach:
# onenand_write_ops_nolock: verify failed -74
# UBI error: ubi_io_write: error -74 while writing 512 bytes to PEB 961:512, written 512 bytes
# UBI warning: ubi_eba_write_leb: failed to write VID header to LEB 2147479551:0, PEB 961
# UBI warning: ubi_ro_mode: switch to read-only mode
MKUBIFS_ARGS = "-m 2048 -e 126976 -c 2009 -x zlib"
UBINIZE_ARGS = "-m 2048 -p 131072 -s 2048 -O 2048"

IMAGE_FSTYPES ?= "jffs2 tar.gz"

PREFERRED_PROVIDER_virtual/kernel = "linux-nokia900-meego"

#use this if you are using the nokia initfs
ROOTFS_POSTPROCESS_COMMAND += " remove_init_link; "

MACHINE_FEATURES = "kernel26 apm alsa bluetooth usbgadget vfat keyboard"

module_autoload_rtc-twl = "rtc-twl"
module_autoload_g-nokia = "g-nokia"
module_autoload_musb-hdrc = "musb-hdrc"
module_autoload_twl4030-usb = "twl4030-usb"
module_autoload_omap-ssi = "omap-ssi"
module_autoload_isp1704-charger = "isp1704-charger"
module_autoload_bq27x00-battery = "bq27x00-battery"
module_autoload_af-packet = "af-packet"
module_autoload_snd-soc-rx51 = "snd-soc-rx51"
module_autoload_snd-soc-tlv320aic3x = "snd-soc-tlv320aic3x"
module_autoload_wl1251-spi = "wl1251-spi"
module_autoload_snd-soc-omap = "snd-soc-omap"
module_autoload_cmt-speech = "cmt-speech"
module_autoload_hsi-char = "hsi-char"
# Copied from include/omap3.inc (as we do not use linux-omap recipes):
#
# Increase this everytime you change something in the kernel
MACHINE_KERNEL_PR = "r64"
```

## conf/machine/nonworking/geodegx.conf
```bitbake
# Machine file for devices with the AMD Geode GX processor 
# Copyright (C) 2005, Advanced Micro Devices, Inc.  All Rights Reserved
# Released under the MIT license (see packages/COPYING)

TARGET_ARCH =  "i486"

require conf/machine/include/tune-geode.inc

PREFERRED_PROVIDER_virtual/kernel = "linux-geodegx"
BOOTSTRAP_EXTRA_RDEPENDS = "kernel pciutils udev kernel-modules"

udevdir = "/dev"

KERNEL_IMAGETYPE = "bzImage"

GLIBC_ADDONS = "nptl"
GLIBC_EXTRA_OECONF = "--with-tls --with-cpu=geode"
```

## conf/machine/nslu2be.conf
```bitbake
#@TYPE: Machine
#@NAME: Linksys NSLU2 (big-endian)
#@DESCRIPTION: Machine configuration for an NSLU2 in big-endian mode

TARGET_ARCH = "armeb"

# Note: armv4b armv4tb armv5teb will be added by tune-xscale.inc automatically.
PACKAGE_EXTRA_ARCHS = "armv5eb ixp4xxbe"

MACHINE_OVERRIDES += "ixp4xx nslu2"

ROOT_FLASH_SIZE ?= "6"

require conf/machine/include/ixp4xx.inc

EXTRA_IMAGECMD_jffs2 += "--big-endian"
```

## conf/machine/nslu2le.conf
```bitbake
#@TYPE: Machine
#@NAME: Linksys NSLU2 (little-endian)
#@DESCRIPTION: Machine configuration for an NSLU2 in little-endian mode

TARGET_ARCH = "arm"

# Note: armv4 armv4t armv5te will be added by tune-xscale.inc automatically.
PACKAGE_EXTRA_ARCHS = "armv5e ixp4xxle"

MACHINE_OVERRIDES += "ixp4xx nslu2"

ROOT_FLASH_SIZE ?= "6"

require conf/machine/include/ixp4xx.inc

EXTRA_IMAGECMD_jffs2 += "--little-endian"
```
