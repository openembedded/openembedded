## conf/machine/mx21ads.conf
```bitbake
#@TYPE: Machine
#@Name: Freescale MX21ADS
#@DESCRIPTION: Machine configuration for Freescale MX21ADS 

TARGET_ARCH = "arm"

MACHINE_FEATURES = "kernel26 apm alsa ext2 pcmcia usbhost usbgadget"

GUI_MACHINE_CLASS = "smallscreen"
PACKAGE_EXTRA_ARCHS = "arm armv4t armv5te"

PREFERRED_PROVIDER_virtual/kernel = "${MACHINE}-kernel"

require conf/machine/include/tune-arm926ejs.inc

# used by sysvinit_2
SERIAL_CONSOLE = "115200 ttymxc0"

# used by opie-collections.inc
ROOT_FLASH_SIZE = "32"
```

## conf/machine/mx25-3stack.conf
```bitbake
#@TYPE: Machine
#@Name: Freescale i.MX25_3stack
#@DESCRIPTION: Machine configuration for Freescale i.MX25_3stack
#@Homepage: http://www.freescale.com/webapp/sps/site/prod_summary.jsp?code=IMX25PDK&fsrch=1

TARGET_ARCH = "arm"

MACHINE_FEATURES = "kernel26 apm alsa ext2 usbhost usbgadget touchscreen"

GUI_MACHINE_CLASS = "smallscreen"

PREFERRED_PROVIDER_virtual/kernel = "linux"
PREFERRED_PROVIDER_virtual/bootloader = "u-boot"
UBOOT_MACHINE="mx25_3stack_config"

UBOOT_ENTRYPOINT = "0x80008000"
UBOOT_LOADADDRESS = "0x80008000"
KERNEL_IMAGETYPE = "uImage"

require conf/machine/include/tune-arm926ejs.inc

SERIAL_CONSOLE = "115200 ttymxc0"
```

## conf/machine/mx28evk.conf
```bitbake
#@Name: Freescale i.MX28 Evaluation Kit
#@DESCRIPTION: Machine configuration for Freescale i.MX28 Evaluation Kit
#@Homepage: http://www.freescale.com/webapp/sps/site/prod_summary.jsp?code=MCIMX28EVKJ&fr=g

UBOOT_MACHINE = "mx28_evk_config"

PREFERRED_PROVIDER_virtual/kernel = "linux-imx"

MACHINE_FEATURES = "kernel26 apm alsa ext2 usbhost usbgadget screen"

MACHINE_GUI_CLASS = "bigscreen"
LOGO_SIZE = "vga"

PREFERRED_PROVIDER_virtual/xserver = "xserver-kdrive"
XSERVER = "xserver-kdrive-fbdev"

require conf/machine/include/imx28.inc

# used by sysvinit_2
SERIAL_CONSOLE = "115200 ttyAM0"

ROOT_FLASH_SIZE = "128"
```

## conf/machine/mx31ads.conf
```bitbake
#@TYPE: Machine
#@Name: Freescale MX31ADS
#@DESCRIPTION: Machine configuration for Freescale MX31ADS 

TARGET_ARCH = "arm"

MACHINE_FEATURES = "kernel26 apm alsa ext2 pcmcia usbhost usbgadget"

GUI_MACHINE_CLASS = "smallscreen"

PREFERRED_PROVIDER_virtual/kernel = "${MACHINE}-kernel"

require conf/machine/include/tune-arm1136jf-s.inc

# used by sysvinit_2
SERIAL_CONSOLE = "115200 ttymxc0"

# used by opie-collections.inc
ROOT_FLASH_SIZE = "32"

IMAGE_FSTYPES += "tar.gz"
```

## conf/machine/mx31moboard.conf
```bitbake
#@TYPE: Machine
#@Name: EPFL mx31moboard
#@DESCRIPTION: Machine configuration for EPFL mx31moboard
#@Website: http://mobots.epfl.ch/mx31moboard.html

TARGET_ARCH = "arm"

MACHINE_FEATURES = "kernel26 alsa ext2 usbhost usbgadget"

GUI_MACHINE_CLASS = "smallscreen"

PREFERRED_PROVIDER_virtual/kernel = "linux"

require conf/machine/include/tune-arm1136jf-s.inc

# usb networking
module_conf_g_ether = "alias usb0 g_ether"

# wifi module
module_conf_rt2570-k2wrlz = "alias rausb0 rt2570"

# tinylogin is broken for our speeds
IMAGE_LOGIN_MANAGER = "busybox"

# used by sysvinit_2
SERIAL_CONSOLE = "-Lh 921600 ttymxc0 vt100"

# used by opie-collections.inc
ROOT_FLASH_SIZE = "29"

# to avoid annoying jffs2 messages
EXTRA_IMAGECMD_jffs2 = "--pad=0x1d00000 --little-endian --eraseblock=0x20000"

IMAGE_FSTYPES += "tar.gz"
```

## conf/machine/n1200.conf
```bitbake
#@TYPE: Machine
#@NAME: Thecus n1200
#@DESCRIPTION: Machine configuration for the Thecus n1200, an MPC8347 based NAS

TARGET_ARCH = "powerpc"
PACKAGE_EXTRA_ARCHS = "ppc"

MACHINE_FEATURES                = "kernel26 usbhost ext2"
MACHINE_TASK_PROVIDER           = "task-base"
MACHINE_EXTRA_RRECOMMENDS       = "temper u-boot-utils"

USE_DEVFS = "0"

PREFERRED_PROVIDER_virtual/kernel = "linux-n1200"
PREFERRED_VERSION_linux-n1200 = "2.6.27-rc9+git"

#don't try to access tty1
USE_VT = "0"

IMAGE_DEVICE_TABLES = "files/device_table-slugos.txt"
IMAGE_FSTYPES = "tar.gz"
SERIAL_CONSOLE = "ttyS0 115200"

KERNEL_IMAGETYPE = "zImage"
UBOOT_LOADADDRESS = "00400000"
UBOOT_ENTRYPOINT = "004005a4"

require conf/machine/include/tune-ppc603e.inc
```

## conf/machine/n2100.conf
```bitbake
#@TYPE: Machine
#@NAME: Thecus N2100
#@DESCRIPTION: Machine configuration for a Thecus N2100, an Intel IOP based NAS

TARGET_ARCH = "arm"
TARGET_OS = "linux"
INHERIT += "n2100-image"

SERIAL_CONSOLE="115200 console"
USE_VT="0"

MODUTILS=26
MACHINE_FEATURES = "kernel26 usbhost ext2 redboot"
MACHINE_EXTRA_RDEPENDS = "temper"
PREFERRED_PROVIDER_virtual/kernel = "linux"
PREFERRED_VERSION_linux = "2.6.20"

# We want udev support in the image
udevdir = "/dev"

ERASEBLOCK_SIZE = "0x20000"
IMAGE_FSTYPES = "jffs2"
EXTRA_IMAGECMD = "--little-endian"

# Creating an image that works with the webinterface required encrypting it
# So we'll need openssl
EXTRA_IMAGEDEPENDS = "openssl-native"
IMAGE_DEVICE_TABLES = "files/device_table-slugos.txt"

require conf/machine/include/tune-xscale.inc
```
