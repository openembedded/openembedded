## conf/machine/magician.conf
```bitbake
#@TYPE: Machine
#@NAME: HTC Magician
#@DESCRIPTION: Machine configuration for the HTC Magician PDA/Phone

#
# Hardware-based properties
#
TARGET_ARCH = "arm"

# Use tune-xscale per default. Machine independent feeds should be built with tune-strongarm.
require conf/machine/include/tune-xscale.inc

# Uncomment this to use iwmmxt optimizations. Remove the above xscale stuff first
#require conf/machine/include/tune-iwmmxt.inc

ROOT_FLASH_SIZE = "60"
VOLATILE_STORAGE_SIZE = "64"
MACHINE_GUI_CLASS = "smallscreen"
MACHINE_DISPLAY_WIDTH_PIXELS = "240"
MACHINE_DISPLAY_HEIGHT_PIXELS = "320"
MACHINE_DISPLAY_ORIENTATION = "0"
MACHINE_DISPLAY_PPI = "142"
MACHINE_FEATURES = "alsa apm bluetooth irda kernel26 phone screen touchscreen usbgadget usbhost vfat"
MACHINE_FEATURES += "iwmmxt"

#
# Software/packages selection
#
PREFERRED_PROVIDER_virtual/kernel = "linux-handhelds-2.6"
MODUTILS = "26"	
XSERVER = "xserver-kdrive-fbdev"
PREFERRED_PROVIDER_virtual/xserver = "xserver-kdrive"

PREFERRED_VERSION_orinoco-modules = "0.15rc1"

MACHINE_EXTRA_RRECOMMENDS = " \
	kernel-module-i2c-pxa \
	kernel-module-pxa27x-voltage \
	kernel-module-pxa27x-voltage-max158xx \
	kernel-module-magician-ts \
	kernel-module-magician-phone \
	kernel-module-magician-pm \
	kernel-module-n-tihtc \
	kernel-module-snd-soc-magician"

#write out a reflash.ctl with the appriate entries for the rootfs, the ones for the kernel should already be there
EXTRA_IMAGECMD_jffs2 = "; sumtool -i ${DEPLOY_DIR_IMAGE}/${IMAGE_NAME}.rootfs.jffs2 \
			  -o ${DEPLOY_DIR_IMAGE}/${IMAGE_NAME}.rootfs-summary.jffs2 \
			  -e 256KiB -p ; echo '${IMAGE_NAME}  ${IMAGE_NAME}.rootfs.jffs2 - root' >> ${DEPLOY_DIR_IMAGE}/reflash.ctl"


#
# Modules autoload and other boot properties
#
module_autoload_snd-pcm-oss = "snd-pcm-oss"
module_autoload_snd-mixer-oss = "snd-mixer-oss"
module_autoload_hci_usb = "hci_usb"
module_autoload_pxa27x_udc = "pxa27x_udc"
module_autoload_magician_ts = "magician_ts"
module_autoload_leds-magician = "leds-magician"
module_autoload_magician_phone = "magician_phone"
module_autoload_magician_pm = "magician_pm"
module_autoload_n_tihtc = "n_tihtc"
module_autoload_snd-soc-magician = "snd-soc-magician"

#FIXME: this should be controlled by a userspace utility later.
module_autoload_g_ether = "g_ether"
```

## conf/machine/mainstone.conf
```bitbake
#@TYPE: Machine
#@Name: Mainstone PXA270 Development Platform
#@DESCRIPTION: Machine configuration for Intel Mainstone PXA270 Development Platform 

TARGET_ARCH = "arm"

GUI_MACHINE_CLASS = "smallscreen"

PREFERRED_PROVIDER_virtual/kernel = "linux-${MACHINE}"

require conf/machine/include/tune-xscale.inc

# used by sysvinit_2
SERIAL_CONSOLE = "115200 ttyS0"

ROOT_FLASH_SIZE = "16"

MACHINE_FEATURES = "kernel26 pcmcia usbhost usbgadget pcmcia touchscreen keyboard alsa irda"
EXTRA_IMAGECMD_jffs2 = "--little-endian -e 0x40000 --pad=0x02000000"
```

## conf/machine/mh355.conf
```bitbake
#@TYPE: Machine
#@Name: Microhard MH355 CPU Module based on AT91SAM9263 processor <http://www.microhard.biz>
#@DESCRIPTION: Machine.configuration for the Microhard board with MH355 module
#@MAINTAINER: Marco Cavallini <m.cavallini@koansoftware.com>

TARGET_ARCH = "arm"

PREFERRED_PROVIDER_virtual/kernel = "linux"
PREFERRED_PROVIDER_xserver = "xserver-xorg"

KERNEL_IMAGETYPE = "uImage"

#don't try to access tty1
USE_VT = "0"

MACHINE_FEATURES = "kernel26 ext2 usbhost usbgadget screen touchscreen"

# used by sysvinit_2
SERIAL_CONSOLE = "115200 ttyS0"
IMAGE_FSTYPES ?= "jffs2"
EXTRA_IMAGECMD_jffs2 = "--pad --little-endian --eraseblock=0x20000 -n"

require conf/machine/include/tune-arm926ejs.inc
```

## conf/machine/micro2440.conf
```bitbake
#@TYPE: Machine
#@Name: FriendlyARM micro2440
#@DESCRIPTION: Machine configuration for FriendlyARM micro2440 Samsung 2440 based board

TARGET_ARCH = "arm"

IMAGE_DEVICE_TABLES = "files/device_table-minimal.txt \
                       files/device_table_add-s3c_serial.txt"

PREFERRED_VERSION_u-boot = "git"
UBOOT_MACHINE = "mini2440_config"
UBOOT_ENTRYPOINT = "30008000"

PREFERRED_PROVIDER_virtual/kernel = "linux-mini2440"

# This can be used as alternative, stable kernel
# PREFERRED_PROVIDER_virtual/kernel = "linux"
# PREFERRED_VERSION_linux = "2.6.29"


# This is not necessarily true, there is a 800x480 display as well
MACHINE_DISPLAY_WIDTH_PIXELS = "240"
MACHINE_DISPLAY_HEIGHT_PIXELS = "320"
MACHINE_DISPLAY_ORIENTATION = "0"
MACHINE_DISPLAY_PPI = "110"
# used by matchbox-panel large icons look ok on both displays
GUI_MACHINE_CLASS = "bigscreen"

# used by sysvinit
SERIAL_CONSOLE = "115200 ttySAC0"

IMAGE_FSTYPES = "jffs2 tar.gz"

MACHINE_FEATURES = "kernel26 touchscreen screen usbhost usbgadget sound alsa ethernet mmc mmcroot i2c spi"
MACHINE_EXTRA_RDEPENDS = "rt73-firmware"

require conf/machine/include/tune-arm920t.inc

KERNEL_IMAGETYPE = "uImage"
EXTRA_IMAGECMD_jffs2 = "--pad --little-endian -e16KiB -n \
        ; sumtool -e16KiB --no-cleanmarkers \
        --littleendian --pad \
        -i ${DEPLOY_DIR_IMAGE}/${IMAGE_NAME}.rootfs.jffs2 \
        -o ${DEPLOY_DIR_IMAGE}/${IMAGE_NAME}.rootfs.jffs2.summary"
```

## conf/machine/mini2440.conf
```bitbake
#@TYPE: Machine
#@Name: Samsung MINI2440 Dev Board
#@DESCRIPTION: Machine configuration for MINI2440 Dev Board


TARGET_ARCH = "arm"

PREFERRED_VERSION_u-boot = "git"
UBOOT_ENTRYPOINT = "30008000"
PREFERRED_PROVIDER_virtual/kernel = "linux-mini2440"

# used by sysvinit_2
SERIAL_CONSOLE = "115200 ttySAC0"

IMAGE_DEVICE_TABLES = "files/device_table-minimal.txt \
                       files/device_table_add-s3c_serial.txt"

IMAGE_FSTYPES = "jffs2 ext3 tar.gz"

MACHINE_FEATURES = "kernel26 uboot touchscreen screen lcd rgb16"
MACHINE_FEATURES += "usbhost usbgadget"
MACHINE_FEATURES += "i2c spi"
MACHINE_FEATURES += "mmc mmcroot vfat"
MACHINE_FEATURES += "ethernet"
MACHINE_FEATURES += "sound alsa"

KERNEL_IMAGETYPE = "uImage"

require conf/machine/include/tune-arm920t.inc

MACHINE_EXTRA_RDEPENDS = "rt73-firmware"
EXTRA_IMAGEDEPENDS += "u-boot"
EXTRA_IMAGECMD_jffs2 = "--pad --little-endian --squash -s 0x200 -n -e 16KiB"
```

## conf/machine/mini6410.conf
```bitbake
#@TYPE: Machine
#@Name: FriendlyARM Mini6410
#@DESCRIPTION: Machine configuration for FriendlyARM Mini6410 Dev Board

TARGET_ARCH = "arm"

# Definitions matching the default kit display
MACHINE_DISPLAY_WIDTH_PIXELS ?= "480"
MACHINE_DISPLAY_HEIGHT_PIXELS ?= "272"
MACHINE_DISPLAY_ORIENTATION ?= "0"
MACHINE_DISPLAY_PPI ?= "120"
GUI_MACHINE_CLASS = "bigscreen"

SERIAL_CONSOLE ?= "115200 ttySAC0"
UBOOT_ENTRYPOINT = "50008000"

# Software selections
PREFERRED_PROVIDER_virtual/xserver = "xserver-xorg"
XSERVER = "xserver-xorg \
           xf86-input-evdev \
           xf86-input-tslib \
           xf86-video-fbdev \
           xf86-input-keyboard \
           xf86-input-mouse \
"

PREFERRED_PROVIDER_virtual/kernel = "linux"

# Filesystem parameter
ROOT_FLASH_SIZE ?= "128"

MKUBIFS_ARGS = "-m 2048 -e 129024 -c 512"
UBINIZE_ARGS = "-m 2048 -p 128KiB -s 512"

EXTRA_IMAGECMD_jffs2 = " -e 128KiB -l -p ; sumtool -i ${DEPLOY_DIR_IMAGE}/${IMAGE_NAME}.rootfs.jffs2 \
                         -o ${DEPLOY_DIR_IMAGE}/${IMAGE_NAME}.rootfs-summary.jffs2 \
                         -e 128KiB -p -l "

MACHINE_EXTRA_RRECOMMENDS = "kernel-modules"
MACHINE_FEATURES = "kernel26 alsa ext2 keyboard screen touchscreen usbgadget usbhost vfat"

# Output files
KERNEL_IMAGETYPE = "uImage"
IMAGE_FSTYPES = "tar.bz2 ubi"


require conf/machine/include/tune-arm1176jzf-s.inc
```

## conf/machine/mnci.conf
```bitbake
#@TYPE: Machine
#@NAME: M&N MNCI-RX
#@DESCRIPTION: Machine configuration for the PXA255 based M&N Solutions MNCI-RX

PREFERRED_PROVIDER_virtual/kernel = "mnci-ramses"

USE_DEVFS = "1"
GUI_MACHINE_CLASS = "smallscreen"

# For sysvinit:
USE_VT = "0"
```

## conf/machine/mp900c.conf
```bitbake
#@TYPE: Machine
#@NAME: NEC Mobile Pro 900/900c 
#@DESCRIPTION: Machine configuration for the PXA255 based Mobile Pro 9xx palmtop computer

TARGET_ARCH = "arm"

require conf/machine/include/tune-xscale.inc

PREFERRED_PROVIDER_virtual/kernel = "linux-jlime-mobilepro900"
PCMCIA_MANAGER = "pcmciautils"
MACHINE_FEATURES = "kernel26 apm alsa pcmcia irda keyboard touchscreen screen"
MACHINE_EXTRA_RDEPENDS = "kernel-modules"

SYSVINIT_ENABLED_GETTYS = "1 2 3 4 5 6"
```

## conf/machine/mpc8313e-rdb.conf
```bitbake
#@TYPE: Machine
#@Name: Freescale MPC8313E-RDB
#@DESCRIPTION: Machine configuration for the Freescale MPC8313E-RDB

TARGET_ARCH = "powerpc"
PACKAGE_EXTRA_ARCHS = "all ${MACHINE} ppc ppce300c3"

PREFERRED_PROVIDER_virtual/kernel = "linux"
PREFERRED_VERSION_u-boot = "git"

MACHINE_FEATURES = "kernel26 usbhost ext2"

PREFERRED_VERSION_u-boot = "1.3.0"
UBOOT_MACHINE = "MPC8313ERDB_33_config"

#rootfs on NAND flash
EXTRA_IMAGECMD_jffs2 = "--pad --big-endian --eraseblock=0x4000 --no-cleanmarkers"

#don't try to access tty1
USE_VT = "0"

SERIAL_CONSOLE = "115200 ttyS0"

#tune for the e300c3 core
require conf/machine/include/tune-ppce300c3.inc
```

## conf/machine/mpc8315e-rdb.conf
```bitbake
#@TYPE: Machine
#@Name: Freescale MPC8315E-RDB
#@DESCRIPTION: Machine configuration for the Freescale MPC8315E-RDB

# Development board with low-power PowerPC SoC with MMU/FPU and PCI,
# 2x PCI Express x1, 2x SATA.

TARGET_ARCH = "powerpc"

PREFERRED_PROVIDER_virtual/kernel ?= "linux"

MACHINE_FEATURES = "kernel26 usbhost pci ext2 uboot"

KERNEL_IMAGETYPE = "uImage"

PREFERRED_VERSION_u-boot ?= "2009.06"
UBOOT_MACHINE = "MPC8315ERDB_config"
UBOOT_ENTRYPOINT = "0"
UBOOT_LOADADDRESS = "0"

#rootfs on NAND flash
EXTRA_IMAGECMD_jffs2 = "--pad --big-endian --eraseblock=0x4000 --no-cleanmarkers"

#don't try to access tty1
USE_VT = "0"

SERIAL_CONSOLE = "115200 ttyS0"

#tune for the e300c3 core
require conf/machine/include/tune-ppce300c3.inc

PREFERRED_PROVIDER_virtual/xserver = "xserver-xorg"
XSERVER = "xserver-xorg \
           xf86-input-evdev \
           xf86-input-mouse \
           xf86-video-fbdev \
           xf86-input-keyboard"
GUI_MACHINE_CLASS = "bigscreen"
```

## conf/machine/mpc8323e-rdb.conf
```bitbake
#@TYPE: Machine
#@Name: Freescale MPC8323E-RDB
#@DESCRIPTION: Machine configuration for the Freescale MPC8323E-RDB

TARGET_ARCH = "powerpc"

PREFERRED_PROVIDER_virtual/kernel ?= "linux"

MACHINE_FEATURES = "kernel26 usbhost pci ext2 uboot"

KERNEL_IMAGETYPE = "uImage"

PREFERRED_VERSION_u-boot = "1.1.6"
UBOOT_MACHINE = "MPC8323ERDB_config"

EXTRA_IMAGECMD_jffs2 = "--pad --big-endian --eraseblock=0x20000"

#don't try to access tty1
USE_VT = "0"

SERIAL_CONSOLE = "115200 ttyS0"

#tune for the e300c2 core
require conf/machine/include/tune-ppce300c2.inc
```

## conf/machine/mpc8544ds.conf
```bitbake
#@TYPE: Machine
#@Name: P2020ds
#@DESCRIPTION: Machine configuration for the Freescale MPC8544DS development board

TARGET_ARCH = "powerpc"

PREFERRED_PROVIDER_virtual/kernel ?= "linux"

MACHINE_FEATURES = "kernel26 usbhost pci ext2 vfat nfs uboot"

KERNEL_IMAGETYPE = "uImage"
UBOOT_ENTRYPOINT = "0"

UBOOT_MACHINE = "MPC8536DS_config"

# Need to create jffs2 images with the correct endianess
EXTRA_IMAGECMD_jffs2 = " --big-endian -e 0x20000"

#don't try to access tty1
USE_VT = "0"

#setup serial console on Com1
SERIAL_CONSOLE = "-L 115200 ttyS0"

#tune for the e500v2 core
require conf/machine/include/tune-ppce500v2.inc
```

## conf/machine/mpc8641-hpcn.conf
```bitbake
#@TYPE: Machine
#@Name: MPC8641-hpcn
#@DESCRIPTION: Machine configuration for the freescale mpc8641_hpcn development board

TARGET_ARCH = "powerpc"

PREFERRED_PROVIDER_virtual/kernel ?= "linux"

MACHINE_FEATURES = "kernel26 usbhost pci ext2 vfat nfs uboot"

KERNEL_IMAGETYPE = "uImage"
UBOOT_ENTRYPOINT = "0"

UBOOT_MACHINE = "MPC8641HPCN_config"

# Need to create jffs2 images with the correct endianess
EXTRA_IMAGECMD_jffs2 = " --big-endian -e 0x10000"

#don't try to access tty1
USE_VT = "0"

#setup serial console on Com1
SERIAL_CONSOLE = "-L 115200 ttyS0"

# Tune for e600 core
require conf/machine/include/tune-ppce600.inc
```

## conf/machine/mtx-1.conf
```bitbake
#@TYPE: Machine
#@NAME: 4G Systems mtx-1
#@DESCRIPTION: Machine configuration for the mtx-1 (aka MeshCube)

TARGET_ARCH = "mipsel"
IPKG_ARCHS = "all mipsel ${MACHINE}"

PREFERRED_PROVIDER_virtual/kernel = "linux-mtx-1"
#PREFERRED_VERSION_linux-mtx-1 = "2.4.24"

EXTRA_IMAGECMD_jffs2 = "--pad=0x1c00000 --little-endian --eraseblock=0x20000 -n"  

# does not gain any speed and just creates problems:
# TARGET_CC_ARCH = "-march=mips32" 

USE_DEVFS = "1"
USE_VT = "0"
SERIAL_CONSOLE = "115200 tts/0 vt100"

BOOTSTRAP_EXTRA_RDEPENDS += "kernel-module-usb-storage kernel-module-scsi-mod kernel-module-sd-mod kernel-module-fat kernel-module-vfat kernel-module-usbnet kernel-module-mii"

# also create a srec file
IMAGE_POSTPROCESS_COMMAND = "${TARGET_PREFIX}objcopy -O srec -I binary --adjust-vma 0xbe000000 ${DEPLOY_DIR_IMAGE}/${IMAGE_NAME}.rootfs.${type} ${DEPLOY_DIR_IMAGE}/${IMAGE_NAME}.rootfs.srec"
```

## conf/machine/mtx-2.conf
```bitbake
#@TYPE: Machine
#@NAME: 4G Systems mtx-2
#@DESCRIPTION: Machine configuration for the mtx-2 (aka SurfBox 2nd generation)

TARGET_ARCH = "mipsel"
IPKG_ARCHS = "all mipsel ${MACHINE}"

PREFERRED_PROVIDER_virtual/kernel = "linux-mtx-2"

EXTRA_IMAGECMD_jffs2 = "--little-endian --eraseblock=0x20000 -n"  

# does not gain any speed and just creates problems:
# TARGET_CC_ARCH = "-march=mips32" 

USE_DEVFS = "1"
USE_VT = "0"
SERIAL_CONSOLE = "115200 tts/0 vt100"

BOOTSTRAP_EXTRA_RDEPENDS += "kernel-module-usb-storage kernel-module-scsi-mod kernel-module-sd-mod kernel-module-fat kernel-module-vfat kernel-module-usbnet kernel-module-mii"

PREFERRED_VERSION_yamon = "2.24"

# create srec files
IMAGE_POSTPROCESS_COMMAND += "\
	${TARGET_PREFIX}objcopy -O srec -I binary --adjust-vma 0xbe000000 ${DEPLOY_DIR_IMAGE}/${IMAGE_NAME}.rootfs.${type} ${DEPLOY_DIR_IMAGE}/${IMAGE_NAME}.rootfs.srec; \
	grep -v S7 ${DEPLOY_DIR_IMAGE}/${IMAGE_NAME}.rootfs.srec > ${DEPLOY_DIR_IMAGE}/${IMAGE_NAME}.srec; \
	grep -v S0 ${DEPLOY_DIR_IMAGE}/${KERNEL_IMAGE_NAME}.flash.srec >> ${DEPLOY_DIR_IMAGE}/${IMAGE_NAME}.srec; "
```

## conf/machine/mtx-3.conf
```bitbake
#@TYPE: Machine
#@NAME: 4G Systems mtx-3
#@DESCRIPTION: Machine configuration for the mtx-3 (aka SurfBox 3rd generation)

# hint: the mtx-3 architecture is still in experimental state, no hardware
# is yet available for it

# TARGET_ARCH should be set here in the machine configuration.
# For compiling the kernel, ARCH will be derived form it by kernel-arch.bbclass 
TARGET_ARCH = "arm"
PACKAGE_EXTRA_ARCHS = "armv4 armv4t armv5e armv5te "
require conf/machine/include/tune-arm926ejs.inc


PREFERRED_PROVIDER_virtual/kernel = "linux-mtx-3"

EXTRA_IMAGECMD_jffs2 = "--little-endian --eraseblock=0x20000 -n"  

USE_DEVFS = "1"
USE_VT = "0"
SERIAL_CONSOLE = "115200 ttyS0 vt100"

BOOTSTRAP_EXTRA_RDEPENDS += ""

# FIXME: old srec files as mtx-2 used to do it ... this may need to get adapted sometime!

# create srec files
#IMAGE_POSTPROCESS_COMMAND += "\
#	${TARGET_PREFIX}objcopy -O srec -I binary --adjust-vma 0xbe000000 ${DEPLOY_DIR_IMAGE}/${IMAGE_NAME}.rootfs.${type} ${DEPLOY_DIR_IMAGE}/${IMAGE_NAME}.rootfs.srec; \
#	grep -v S7 ${DEPLOY_DIR_IMAGE}/${IMAGE_NAME}.rootfs.srec > ${DEPLOY_DIR_IMAGE}/${IMAGE_NAME}.srec; \
#	grep -v S0 ${DEPLOY_DIR_IMAGE}/${KERNEL_IMAGE_NAME}.flash.srec >> ${DEPLOY_DIR_IMAGE}/${IMAGE_NAME}.srec; "
```

## conf/machine/mtx-3a.conf
```bitbake
#@TYPE: Machine - the orange marvell box
#@NAME: 4G Systems mtx-3a
#@DESCRIPTION: Machine configuration for the mtx-3a 

include conf/machine/mtx-3.conf

TARGET_ARCH = "arm"
PREFERRED_PROVIDER_virtual/kernel = "linux-mtx-3a"
EXTRA_IMAGECMD_jffs2 = "--little-endian --eraseblock=0x20000 -n"  
USE_VT = "0"
SERIAL_CONSOLE = "115200 ttyS0 vt100"
```

## conf/machine/mv2120.conf
```bitbake
#@NAME: ARM/Orion based HP mv2120

MACHINE_EXTRA_RDEPENDS          = "u-boot-utils"

require conf/machine/include/orion.inc
```
