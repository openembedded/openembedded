## conf/machine/xilinx-ml403.conf
```bitbake
# Copyright (C) 2007, Stelios Koroneos - Digital OPSiS, All Rights Reserved
# Released under the MIT license (see packages/COPYING)
#@TYPE: Machine
#@Name: Xilinx ML403 FPGA Development Platform
#@DESCRIPTION: Machine configuration for Xilinx ML403 (softcore ppc) development platform http://www.xilinx.com/ml403

TARGET_ARCH = "powerpc"
PACKAGE_EXTRA_ARCHS = "ppc405"

PREFERRED_PROVIDER_virtual/kernel = "linux-ml403-slab-2.6.x"

MACHINE_FEATURES = "kernel26 ext2"

TARGET_CPU = "405"
#OLDEST_KERNEL = "2.6.20"

SERIAL_CONSOLE = "115200 ttyS0"

#tune for the 405 cpu
require conf/machine/include/tune-ppc405.inc
```

## conf/machine/xilinx-ml410.conf
```bitbake
# Copyright (C) 2007, Stelios Koroneos - Digital OPSiS, All Rights Reserved
# Released under the MIT license (see packages/COPYING)
#@TYPE: Machine
#@Name: Xilinx ML410 FPGA Development Platform
#@DESCRIPTION: Machine configuration for Xilinx ML410 Virtex-4 FX Embedded Development Platform  \ 
(softcore ppc) development platform http://www.xilinx.com/ml410

TARGET_ARCH = "powerpc"
PACKAGE_EXTRA_ARCHS = "ppc405"

PREFERRED_PROVIDER_virtual/kernel = "linux-${MACHINE}"

MACHINE_FEATURES = "kernel26 ext2"

TARGET_CPU = "405"
OLDEST_KERNEL = "2.6.12"

SERIAL_CONSOLE = "115200 ttyS0"

#tune for the 405 cpu
require conf/machine/include/tune-ppc405.inc
```

## conf/machine/xilinx-ml507.conf
```bitbake
# Copyright (C) 2010, Adrian Alonso <aalonso00@gmail.com>
# Released under the MIT license (see packages/COPYING)
#@TYPE: Machine
#@Name: Xilinx ML507 FPGA Development Platform
#@DESCRIPTION: Machine configuration for Xilinx ML507

TARGET_ARCH = "powerpc"
TARGET_CPU = "440"
TARGET_FPU = "soft"
#tune for the 440 cpu
require conf/machine/include/tune-ppc440.inc

#ASSUME_PROVIDED += "virtual/kernel"
PREFERRED_PROVIDER_virtual/kernel = "linux-xilinx-ml507"

KERNEL_IMAGETYPE = "uImage"

MACHINE_FEATURES = "kernel26 apm ext2 vfat ethernet"
MACHINE_EXTRA_RECOMMENDS = "kernel-modules"

UBOOT_ARCH = "ppc"
UBOOT_MACHINE = "ml507_config"
UBOOT_ENTRYPOINT ?= "0x00000000"
UBOOT_LOADADDRESS ?= "0x00000000"
PREFERRED_VERSION_u-boot_xilinx-ml507 = "git"

# Xilinx EDK override hardware  definitions for xilinx-bsp
# Include in your local.conf
# XILINX_BSP_PATH = "complete path for Xilinx XPS project"
# XILINX_BOARD = "ml507"

# Don't use tty1
USE_VT = "0"
SERIAL_CONSOLE = "9600 ttyS0"

# Device nodes add xsa for (system ace)
IMAGE_DEVICE_TABLES = "files/device_table-minimal.txt \
                       files/device_table_add-xsa.txt"
```

## conf/machine/xilinx-virtex4.conf
```bitbake
# Copyright (C) 2010, Adrian Alonso <aalonso00@gmail.com>
# Released under the MIT license (see packages/COPYING)
#@TYPE: Machine
#@Name: Xilinx Virtex4 FPGA Development Platform
#@DESCRIPTION: Machine configuration for Xilinx Virtex4 family
# Supported targets
# ML403, ML405, ML410

TARGET_ARCH = "powerpc"
TARGET_CPU  = "405"
TARGET_FPU  = "soft"
#tune for the selected cpu
require conf/machine/include/tune-ppc405.inc

PREFERRED_PROVIDER_virtual/kernel = "linux-xilinx"
PREFERRED_VERSION_u-boot_xilinx-virtex4 = "u-boot-xilinx"

KERNEL_IMAGETYPE = "uImage"

MACHINE_FEATURES = "kernel26 apm ext2 vfat ethernet"
MACHINE_EXTRA_RECOMMENDS = "kernel-modules"

UBOOT_ENTRYPOINT ?= "0x00000000"
UBOOT_LOADADDRESS ?= "0x00000000"

# Xilinx EDK override hardware definitions for xilinx-bsp
# Include in your local.conf
# XILINX_BSP_PATH = "complete path for Xilinx XPS project"
# XILINX_BOARD = "ml410"

# Don't use tty1
USE_VT = "0"
SERIAL_CONSOLE = "9600 ttyS0"

# Device nodes add xsa for (system ace)
IMAGE_DEVICE_TABLES = "files/device_table-minimal.txt \
                       files/device_table_add-xsa.txt"
```

## conf/machine/xilinx-virtex5.conf
```bitbake
# Copyright (C) 2010, Adrian Alonso <aalonso00@gmail.com>
# Released under the MIT license (see packages/COPYING)
#@TYPE: Machine
#@Name: Xilinx Virtex5 FPGA Development Platforms
#@DESCRIPTION: Machine configuration for Xilinx Virtex5 boards
# Supported boards ML506, ML507, ML510

TARGET_ARCH = "powerpc"
TARGET_CPU  = "440"
TARGET_FPU  = "soft"
#tune for the 440 cpu
require conf/machine/include/tune-ppc440.inc

PREFERRED_PROVIDER_virtual/kernel = "linux-xilinx"
PREFERRED_VERSION_u-boot_xilinx-virtex5 = "u-boot-xilinx"

KERNEL_IMAGETYPE = "uImage"

MACHINE_FEATURES = "kernel26 apm ext2 vfat ethernet screen"
MACHINE_EXTRA_RECOMMENDS = "kernel-modules"

UBOOT_ENTRYPOINT ?= "0x00000000"
UBOOT_LOADADDRESS ?= "0x00000000"

# Xilinx EDK override hardware  definitions for xilinx-bsp
# Include in your local.conf
# XILINX_BSP_PATH = "complete path for Xilinx XPS project"
# XILINX_BOARD = "ml507"

# Don't use tty1
# USE_VT = "0"
SERIAL_CONSOLE = "9600 ttyS0"

# Device nodes add xsa for (system ace)
IMAGE_DEVICE_TABLES = "files/device_table-minimal.txt \
                       files/device_table_add-xsa.txt"
```

## conf/machine/xo.conf
```bitbake
# Copyright (C) 2008, Stefan Schmidt, All Rights Reserved
# Released under the MIT license (see packages/COPYING)
#@TYPE: Machine
#@NAME: XO
#@DESCRIPTION: Machine configuration for a the XO laptop (aka OLPC)


TARGET_ARCH = "i586"

PREFERRED_PROVIDER_virtual/kernel = "linux-xo"
PREFERRED_PROVIDER_virtual/xserver = "xserver-kdrive"
# X.org with a special graphic driver needed?
XSERVER="xserver-kdrive-vesa"

GUI_MACHINE_CLASS = "bigscreen"
MACHINE_DISPLAY_WIDTH_PIXELS = "1200"
MACHINE_DISPLAY_HEIGHT_PIXELS = "900"

KERNEL_IMAGETYPE = "bzImage"

IMAGE_FSTYPES ?= "jffs2"

# This helped a lot: http://laptop.org/laptop/hardware/specs.shtml
# ACPI is right for the battery class stuff?
MACHINE_FEATURES = "kernel26 screen keyboard ushbost acpi x86 wifi alsa mmc vfat pci"
MACHINE_EXTRA_RRECOMMENDS = " kernel-modules"

require conf/machine/include/tune-geodelx.inc
```

## conf/machine/xxs1500.conf
```bitbake
#@TYPE: Machine
#@NAME: mycable xxs1500
#@DESCRIPTION: Machine configuration for the xxs1500 revision A.

# pad size and SREC_VMAADDR would need to be changed for the xxs1500 rev B.

TARGET_ARCH = "mipsel"

PREFERRED_PROVIDER_virtual/kernel = "linux-xxs1500"

EXTRA_IMAGECMD_jffs2 = "--pad=0xa00000 --little-endian --eraseblock=0x20000 -n"

# does not gain any speed and just creates problems:
# TARGET_CC_ARCH = "-march=mips32" 

USE_DEVFS = "1"
USE_VT = "0"
SERIAL_CONSOLE = "115200 tts/0 vt100"

SREC_VMAADDR = "0xbf200000"
```

## conf/machine/zaurus-clamshell-2.4.conf
```bitbake
PREFERRED_PROVIDERS_append_c7x0  = " virtual/kernel:c7x0-kernels-2.4-embedix"
PREFERRED_PROVIDERS_append_akita = " virtual/kernel:openzaurus-pxa27x"
PREFERRED_PROVIDERS_append_spitz = " virtual/kernel:openzaurus-pxa27x"

# Later versions are broken on kernel 2.4
PREFERRED_VERSION_orinoco-modules = "0.13e"

BOOTSTRAP_EXTRA_DEPENDS = "virtual/kernel hostap-modules orinoco-modules sharp-sdmmc-support \
pcmcia-cs apmd ppp wireless-tools console-tools irda-utils openswan wpa-supplicant-nossl lrzsz ppp-dialin \
hostap-utils prism3-firmware prism3-support"

BOOTSTRAP_EXTRA_RDEPENDS = "kernel hostap-modules-cs orinoco-modules-cs sharp-sdmmc-support \
pcmcia-cs apm apmd ppp wireless-tools irda-utils console-tools \
hostap-utils prism3-firmware prism3-support"

# Spitz needs minimal bootstrap
BOOTSTRAP_EXTRA_DEPENDS_spitz = "virtual/kernel hostap-modules orinoco-modules sharp-sdmmc-support \
pcmcia-cs apmd wireless-tools irda-utils wpa-supplicant-nossl lrzsz hostap-utils prism3-firmware prism3-support"
BOOTSTRAP_EXTRA_RDEPENDS_spitz = "kernel hostap-modules-cs orinoco-modules-cs sharp-sdmmc-support \
pcmcia-cs apmd apm wireless-tools irda-utils hostap-utils prism3-firmware prism3-support"

# Misc Modules
BOOTSTRAP_EXTRA_RDEPENDS += kernel-module-net-fd kernel-module-registers

# USB Client Modules
BOOTSTRAP_EXTRA_RDEPENDS += "kernel-module-usbdcore kernel-module-usbdmonitor"

# Bluetooth Modules
BOOTSTRAP_EXTRA_RDEPENDS += "kernel-module-bluez kernel-module-l2cap kernel-module-rfcomm kernel-module-hci-vhci \
                             kernel-module-bnep kernel-module-hidp kernel-module-hci-uart kernel-module-sco \
                             kernel-module-bluecard-cs kernel-module-btuart-cs kernel-module-dtl1-cs \
                             kernel-module-firmware-class kernel-module-bt3c-cs"

# BI Module
BOOTSTRAP_EXTRA_RDEPENDS_append_c7x0  = " kernel-module-pxa-bi"
BOOTSTRAP_EXTRA_RDEPENDS_append_spitz = " kernel-module-pxa27x-bi"
BOOTSTRAP_EXTRA_RDEPENDS_append_akita = " kernel-module-pxa27x-bi"

# USB Host Modules
BOOTSTRAP_EXTRA_RDEPENDS_append_spitz += "kernel-module-usbcore kernel-module-usbmouse kernel-module-usb-monitor \
                                          kernel-module-usbkbd kernel-module-usb-storage kernel-module-hci-usb kernel-module-bfusb"
BOOTSTRAP_EXTRA_RDEPENDS_append_akita += "kernel-module-usbcore kernel-module-usbmouse kernel-module-usb-monitor \
                                          kernel-module-usbkbd kernel-module-usb-storage kernel-module-hci-usb kernel-module-bfusb"
```

## conf/machine/zaurus-clamshell-2.6.conf
```bitbake
# Zaurus Clamshell specific configuration for kernel 2.6
# Don't forget to include zaurus-clamshell.conf as well

PREFERRED_PROVIDER_virtual/kernel = "linux-openzaurus"

BOOTSTRAP_EXTRA_DEPENDS  += "virtual/kernel udev sysfsutils spectrum-fw orinoco-conf \
hostap-utils prism3-firmware prism3-support zaurusd alsa-lib alsa-utils \
hostap-conf orinoco-conf module-init-tools altboot"

BOOTSTRAP_EXTRA_RDEPENDS += "kernel udev sysfsutils spectrum-fw \
udev-utils hostap-utils prism3-firmware prism3-support zaurusd \
alsa-conf alsa-utils-alsamixer alsa-utils-alsactl hostap-conf orinoco-conf \
module-init-tools altboot"

#BOOTSTRAP_EXTRA_RDEPENDS += " \
#pcmcia-cs apm  wireless-tools irda-utils console-tools \
#ppp ppp-dialin openswan wpa-supplicant-nossl"

BOOTSTRAP_EXTRA_RDEPENDS_append_c7x0  += " ${BOOTSTRAP_EXTRA_SOUND} kernel-module-snd-soc-corgi kernel-module-snd-soc-wm8731 "
BOOTSTRAP_EXTRA_RDEPENDS_append_akita += " ${BOOTSTRAP_EXTRA_SOUND} kernel-module-snd-soc-spitz kernel-module-snd-soc-wm8750 "
BOOTSTRAP_EXTRA_RDEPENDS_append_spitz += " ${BOOTSTRAP_EXTRA_SOUND} kernel-module-snd-soc-spitz kernel-module-snd-soc-wm8750 "
```

## conf/machine/zaurus-clamshell.conf
```bitbake
TARGET_ARCH = "arm"

# The machine specific PACKAGE_ARCH is set to zaurus-clamshell because
# machine specific packages (other than the kernel) are common across
# all the clamshell devices.
MACHINE_ARCH = "${@['zaurus-clamshell', oe.data.getVar('MACHINE', d, 1)][oe.data.inherits_class('kernel', d) or oe.data.inherits_class('module-base', d) or oe.data.inherits_class('module', d)]}"

IPKG_ARCHS = "all arm armv4 armv5te zaurus-clamshell ${MACHINE}"
PREFERRED_PROVIDER_xserver = "xserver-kdrive"
PREFERRED_PROVIDER_virtual/kernel = "openzaurus-pxa"
BOOTSTRAP_EXTRA_DEPENDS = "virtual/kernel hostap-modules orinoco-modules sharp-sdmmc-support chkhinge"
BOOTSTRAP_EXTRA_RDEPENDS = "kernel hostap-modules-cs orinoco-modules sharp-sdmmc-support \
kernel-module-net-fd kernel-module-registers kernel-module-pxa-bi \
kernel-module-usbdcore kernel-module-usbdmonitor chkhinge"

EXTRA_IMAGECMD_jffs2 = "--pad --little-endian --eraseblock=0x4000 -n"
EXTRA_IMAGEDEPENDS = "sharp-flash-header-c700"

IMAGE_CMD_jffs2 = "mkfs.jffs2 --root=${IMAGE_ROOTFS} --faketime \
		   --output=${T}/${IMAGE_NAME}.rootfs.jffs2 \
		   ${EXTRA_IMAGECMD}; \
		   cat ${STAGING_LIBDIR}/sharp-flash-header/header-c700.bin \
		   ${T}/${IMAGE_NAME}.rootfs.jffs2 > \
	           ${DEPLOY_DIR_IMAGE}/${IMAGE_NAME}.rootfs.img"

GUI_MACHINE_CLASS = "bigscreen"
GPE_EXTRA_DEPENDS += "gaim sylpheed"
GPE_EXTRA_INSTALL += "gaim sylpheed"

include conf/machine/handheld-common.conf
# not using tune-xscale.conf so as to retain backwards compatibility
include conf/machine/tune-strongarm.conf

SERIAL_CONSOLE = "115200 ttyS0"
```

## conf/machine/zaurus-pxa.conf
```bitbake
TARGET_ARCH = "arm"
IPKG_ARCHS = "all arm ${MACHINE}"
PREFERRED_PROVIDER_xserver = "xserver-kdrive"
PREFERRED_PROVIDER_virtual/kernel = "openzaurus-pxa"
BOOTSTRAP_EXTRA_DEPENDS = "virtual/kernel hostap-modules orinoco-modules sharp-sdmmc-support chkhinge"
BOOTSTRAP_EXTRA_RDEPENDS = "kernel hostap-modules-cs orinoco-modules sharp-sdmmc-support \
kernel-module-net-fd kernel-module-registers kernel-module-pxa-bi \
kernel-module-usbdcore kernel-module-usbdmonitor modutils chkhinge"

EXTRA_IMAGECMD_jffs2 = "--pad --little-endian --eraseblock=0x4000 -n"
EXTRA_IMAGEDEPENDS = "sharp-flash-header-c700"

IMAGE_CMD_jffs2 = "mkfs.jffs2 --root=${IMAGE_ROOTFS} --faketime \
		   --output=${T}/${IMAGE_NAME}.rootfs.jffs2 \
		   ${EXTRA_IMAGECMD}; \
		   cat ${STAGING_LIBDIR}/sharp-flash-header/header-c700.bin \
		   ${T}/${IMAGE_NAME}.rootfs.jffs2 > \
	           ${DEPLOY_DIR_IMAGE}/${IMAGE_NAME}.rootfs.img"

GPE_MACHINE_CLASS = "bigscreen"
GPE_EXTRA_DEPENDS = "gaim sylpheed"
GPE_EXTRA_INSTALL = "gaim sylpheed"

include conf/machine/handheld-common.conf
# not using tune-xscale.conf so as to retain backwards compatibility
include conf/machine/tune-strongarm.conf

SERIAL_CONSOLE = "115200 ttyS0"
```
