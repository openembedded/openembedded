## conf/machine/dm800.conf
```bitbake
#@TYPE: Machine
#@NAME: Dreambox DM800
#@DESCRIPTION: Machine configuration for the Dreambox DM800

TARGET_ARCH = "mipsel"
IPKG_ARCHS = "all mipsel ${MACHINE}"
PREFERRED_PROVIDER_xserver = "xserver-kdrive"
PREFERRED_PROVIDER_virtual/kernel = "linux-dm800"
BOOTSTRAP_EXTRA_DEPENDS = "virtual/kernel dreambox-dvb-modules gst-plugin-dvbmediasink \
	gst-plugin-fluendo-mpegdemux"
BOOTSTRAP_EXTRA_RDEPENDS = "kernel dreambox-dvb-modules kernel-module-stv0299 \
	kernel-module-cdrom	kernel-module-cifs	kernel-module-exportfs \
	kernel-module-ide-cd	kernel-module-isofs	kernel-module-ohci-hcd \
	kernel-module-reiserfs 	kernel-module-scsi-mod	kernel-module-sd-mod \
	kernel-module-sg	kernel-module-sr-mod	kernel-module-usb-storage \
	kernel-module-usbcore	kernel-module-usbhid	kernel-module-usbmon \
	kernel-module-xfs gst-plugin-dvbmediasink kernel-module-ehci-hcd"

BOOTSTRAP_EXTRA_RDEPENDS = "kernel dreambox-dvb-modules kernel-module-stv0299 \
  kernel-module-exportfs \
  kernel-module-isofs \
  kernel-module-scsi-mod  kernel-module-sd-mod \
  kernel-module-sg  kernel-module-sr-mod  kernel-module-usb-storage \
  gst-plugin-dvbmediasink"


TARGET_FPU = "soft"
#OLDEST_KERNEL = "2.6.9"

PREFERRED_PROVIDERS += " virtual/${TARGET_PREFIX}gcc-initial:gcc-cross-initial"
PREFERRED_PROVIDERS += " virtual/${TARGET_PREFIX}gcc:gcc-cross"
PREFERRED_PROVIDERS += " virtual/${TARGET_PREFIX}g++:gcc-cross"
PREFERRED_PROVIDERS += " virtual/${TARGET_PREFIX}libc-for-gcc:glibc"

PREFERRED_VERSION_glibc = "2.3.5+cvs20051107"
PREFERRED_VERSION_gcc-cross-initial = "3.4.5"
PREFERRED_VERSION_gcc-cross = "4.1.1"
PREFERRED_VERSION_gcc-cross-sdk = "4.1.1" 
PREFERRED_VERSION_gcc = "4.1.1"
PREFERRED_VERSION_binutils-cross = "2.16.1"
PREFERRED_VERSION_binutils-cross-sdk = "2.16.1"
PREFERRED_VERSION_binutils = "2.16.1"
PREFERRED_VERSION_linux-libc-headers = "2.6.12.0"
GLIBC_ADDONS = "nptl"
GLIBC_EXTRA_OECONF = "--disable-profile --with-tls --without-fp --with-__thread"

EXTRA_IMAGEDEPENDS += "dreambox-secondstage dreambox-buildimage-native"
EXTRA_IMAGECMD_jffs2 = " --eraseblock=0x4000 -n -l "
IMAGE_CMD_jffs2 = "mkfs.jffs2 --root=${IMAGE_ROOTFS}/boot --faketime \
       --output=${DEPLOY_DIR_IMAGE}/${IMAGE_NAME}.boot.jffs2 \
       ${EXTRA_IMAGECMD}; rm -rf ${IMAGE_ROOTFS}/boot/*; \
				mkfs.jffs2 --root=${IMAGE_ROOTFS} --faketime \
       --output=${DEPLOY_DIR_IMAGE}/${IMAGE_NAME}.rootfs.jffs2 \
       ${EXTRA_IMAGECMD}; \
       buildimage ${STAGING_LIBDIR}/dreambox-secondstage/main.bin.gz \
       ${DEPLOY_DIR_IMAGE}/${IMAGE_NAME}.boot.jffs2 \
       ${DEPLOY_DIR_IMAGE}/${IMAGE_NAME}.rootfs.jffs2 \
       ${MACHINE} 64 \
       > ${DEPLOY_DIR_IMAGE}/${IMAGE_NAME}.nfi"
```

## conf/machine/dm814x-evm.conf
```bitbake
#@TYPE: Machine
#@NAME: DM814x evm
#@DESCRIPTION: Machine configuration for the DM814x evm

require conf/machine/include/ti814x.inc
```

## conf/machine/dns323.conf
```bitbake
#@NAME: ARM/Orion based D-Link DNS-323

MACHINE_EXTRA_RDEPENDS          = "u-boot-utils"

require conf/machine/include/orion.inc
```

## conf/machine/dockstar.conf
```bitbake
#@TYPE: Machine
#@NAME: Seagate Dockstar
#@DESCRIPTION: Kirkwood based Seagate Dockstar NAS

MACHINE_EXTRA_RRECOMMENDS = "kernel-modules u-boot-utils"

MKUBIFS_ARGS = "-m 2048 -e 129024 -c 4096"
UBINIZE_ARGS = "-m 2048 -p 128KiB -s 512"

ROOT_FLASH_SIZE ?= "256"

MACHINE_FEATURES = "kernel26 usbhost ext2 vfat "

EXTRA_IMAGECMD_jffs2 = " -e 128KiB -l -p ; sumtool -i ${DEPLOY_DIR_IMAGE}/${IMAGE_NAME}.rootfs.jffs2 \
                          -o ${DEPLOY_DIR_IMAGE}/${IMAGE_NAME}.rootfs-summary.jffs2 \
                          -e 128KiB -p -l "

require conf/machine/include/kirkwood.inc

PREFERRED_PROVIDER_virtual/kernel = "linux"
```

## conf/machine/e680.conf
```bitbake
#@TYPE: Machine
#@NAME: Motorola Motorola EZX E680, Motorola EZX E680i
#@DESCRIPTION: Machine configuration for the Motorola GSM phones E680, and E680i

require conf/machine/include/motorola-ezx-base.inc
```

## conf/machine/ea3250.conf
```bitbake
#@TYPE: Machine
#@NAME: Embedded Artists LPC3250 machine
#@DESCRIPTION: Machine configuration for Embedded Artists LPC3250 development board
#@WEBSITE: http://www.embeddedartists.com/products/kits/lpc3250_kit.php

TARGET_ARCH = "arm"

require conf/machine/include/tune-arm926ejs.inc

MACHINE_KERNEL_PR		= "r0"

MACHINE_FEATURES 		= "kernel26 usbhost ext2 vfat"
MACHINE_TASK_PROVIDER 		= "task-base"

USE_DEVFS = "0"

PREFERRED_PROVIDER_virtual/bootloader = ""
PREFERRED_PROVIDER_virtual/kernel = "linux-ea3250"
PREFERRED_VERSION_linux-ea3250 = "2.6.27.8"

IMAGE_DEVICE_TABLES = "files/device_table-slugos.txt"
IMAGE_FSTYPES = "tar.gz"
SERIAL_CONSOLE = "ttyS0 115200"

KERNEL_IMAGETYPE = "uImage"
UBOOT_ENTRYPOINT = "0x80008000"
UBOOT_LOADADDRESS = "0x80008000"
```

## conf/machine/eee701.conf
```bitbake
#-----------------------------------------------------------------------------
#@TYPE: Machine
#@NAME: eeepc 701
#@DESCRIPTION: Machine configuration for the eeepc 701 netbook
#-----------------------------------------------------------------------------

require i686-generic.conf

PREFERRED_PROVIDER_virtual/xserver = "xserver-xorg"
PREFERRED_PROVIDER_virtual/libgl = "mesa-dri"
MACHINE_DRI_MODULES = "i915"

MACHINE_FEATURES +=" wifi alsa "
MACHINE_DISPLAY_WIDTH_PIXELS = "800"
MACHINE_DISPLAY_HEIGHT_PIXELS = "480"
MACHINE_DISPLAY_ORIENTATION = "0"
XSERVER = "xserver-xorg \
           xf86-video-intel \
           xf86-input-evdev \
           xf86-input-keyboard \
           xf86-input-mouse \
           xf86-input-synaptics \
           "

IMAGE_FSTYPES += "tar.gz"

PREFERRED_PROVIDER_virtual/kernel ?= "linux"
PREFERRED_VERSION_linux ?= "2.6.32"

GLIBC_ADDONS = "nptl"
GLIBC_EXTRA_OECONF = "--with-tls"
```

## conf/machine/eee901.conf
```bitbake
#@TYPE: Machine
#@NAME: eee PC 901
#@DESCRIPTION: Machine configuration for a eee PC 901

TARGET_ARCH = "i686"
require conf/machine/include/tune-x86-atom.inc

PREFERRED_PROVIDER_virtual/xserver = "xserver-xorg"
XSERVER = "xserver-xorg \
           xf86-input-evdev \
           xf86-input-mouse \
           xf86-video-intel \
           xf86-input-keyboard"

PREFERRED_PROVIDER_virtual/kernel = "linux"
OLDEST_KERNEL = "2.6.20"

GLIBC_ADDONS = "nptl"
GLIBC_EXTRA_OECONF = "--with-tls"

IMAGE_FSTYPES = "ext2.gz"

MACHINE_FEATURES = "kernel26 screen keyboard pci usbhost acpi ext2 x86"
MACHINE_EXTRA_RRECOMMENDS = " kernel-modules"
```

## conf/machine/efika.conf
```bitbake
#@TYPE: Machine
#@Name: Genisi EFIKA Development Platform
#@DESCRIPTION: Machine configuration for the EFIKA development platform: http://www.pegasosppc.com/efika.php

TARGET_ARCH = "powerpc"
PACKAGE_EXTRA_ARCHS = "all ${MACHINE} ppc ppc603e"

PREFERRED_PROVIDER_virtual/kernel = "linux-${MACHINE}"

MACHINE_FEATURES = "kernel26 usbhost ext2 alsa"

#don't try to access tty1
USE_VT = "0"

SERIAL_CONSOLE = "115200 ttyPSC0"

#tune for the MPC5200B cpu
require conf/machine/include/tune-ppc603e.inc
```

## conf/machine/efikamx.conf
```bitbake
#@TYPE: Machine
#@Name: Genesi EFIKA MX Development Platform
#@DESCRIPTION: Machine configuration for the EFIKA MX development platform (http://www.powerdeveloper.org/platforms/efikamx)

TARGET_ARCH = "arm"

PREFERRED_PROVIDER_virtual/kernel ?= "linux-efikamx"

MACHINE_FEATURES = "kernel26 usbhost ext2 alsa"

#don't try to access tty1
USE_VT = "0"

SERIAL_CONSOLE = "115200 ttymxc0"
UBOOT_ENTRYPOINT = "0x90008000"
UBOOT_LOADADDRESS = "0x90008000"

PREFERRED_PROVIDER_virtual/bootloader = "u-boot-efikamx"

#tune for ARMv7/Cortex A8
require conf/machine/include/tune-cortexa8.inc
```

## conf/machine/em-x270.conf
```bitbake
#@TYPE: Machine
#@NAME: EM-X270
#@DESCRIPTION: Machine configuration for the CompuLab EM-X270 with a pxa27x CPU

#
# Hardware-based properties
#
TARGET_ARCH = "arm"
GUI_MACHINE_CLASS ?= "bigscreen"

PACKAGE_EXTRA_ARCHS = "iwmmxt "
PREFERRED_PROVIDER_virtual/kernel = "${MACHINE}"

# Use tune-xscale per default. Machine independent feeds should be built with tune-strongarm.
#require conf/machine/include/tune-xscale.inc

# Uncomment this to use iwmmxt optimizations. Remove the above xscale stuff first
# require conf/machine/include/tune-iwmmxt.inc

require conf/machine/include/tune-xscale.inc

ROOT_FLASH_SIZE = "128"
IMAGE_CMD_jffs2 = " \
          mkfs.jffs2 --root=${IMAGE_ROOTFS} \
             --output=${DEPLOY_DIR_IMAGE}/${IMAGE_NAME}.rootfs.jffs2 \
             --eraseblock=0x20000 --pad --faketime -n; \
          sumtool -i ${DEPLOY_DIR_IMAGE}/${IMAGE_NAME}.rootfs.jffs2 \
		  -o ${DEPLOY_DIR_IMAGE}/${IMAGE_NAME}.rootfs-summary.jffs2 \
		  -e 0x20000 -p; \
	          cd ${DEPLOY_DIR_IMAGE}; \
		  rm -f ${DEPLOY_DIR_IMAGE}/${IMAGE_NAME}.rootfs.jffs2; \
	          ln -fs ${IMAGE_NAME}.rootfs-summary.jffs2 \
		         ${IMAGE_LINK_NAME}.rootfs-summary.jffs2 \
"

#VOLATILE_STORAGE_SIZE = "128"
MACHINE_DISPLAY_WIDTH_PIXELS ?= "480"
MACHINE_DISPLAY_HEIGHT_PIXELS ?= "640"
MACHINE_FEATURES = "kernel26 touchscreen apm alsa bluetooth wifi usbhost usbgadget screen phone "

#
# Software/packages selection
#

#PCMCIA_MANAGER = "pcmciautils"
PREFERRED_VERSION_em-x270 = "2.6.23"
MODUTILS = "26"	
PREFERRED_PROVIDER_xserver = "xserver-kdrive"

#PREFERRED_VERSION_orinoco-modules = "0.15rc1"

MACHINE_EXTRA_RDEPENDS = ""
MACHINE_EXTRA_RRECOMMENDS = "kernel-module-nls-cp437 \
				kernel-module-nls-iso8859-1 \
				kernel-module-nls-utf8 \
				"

#
# Modules autoload and other boot properties
#
module_autoload_evdev = "evdev"
module_autoload_mmc_block = "mmc_block"
module_autoload_pxa27x_udc = "pxa27x_udc"

#FIXME: this should be controlled by a userspace utility later.
module_autoload_g_ether = "g_ether"

SERIAL_CONSOLE = "115200 ttyS0"
```

## conf/machine/ep93xx.conf
```bitbake
#@TYPE: Machine
#@Name: Cirrus Logic EP-93xx Development Platform
#@DESCRIPTION: Machine configuration for Cirrus Logic EP-93xx Development Platform


TARGET_ARCH = "arm"

PREFERRED_PROVIDER_virtual/kernel = "linux"
PREFERRED_PROVIDER_xserver = "xserver-kdrive"

#don't try to access tty1
USE_VT = "0"

MACHINE_FEATURES = "kernel26 apm alsa ext2 pcmcia usbhost screen"

# used by sysvinit_2
SERIAL_CONSOLE = "57600 ttyAM0"

# used by some images
ROOT_FLASH_SIZE = "8"
#extra jffs2 tweaks
EXTRA_IMAGECMD_jffs2 = "--eraseblock=0x40000 --pad=0x500000 "

#tune for ep93xx cpus
#can be used for crunch support later on
#require conf/machine/include/tune-ep9312.inc


require conf/machine/include/tune-arm920t.inc
```

## conf/machine/epia.conf
```bitbake
require conf/machine/x86.conf

TARGET_ARCH = "i586"

PREFERRED_PROVIDER_virtual/kernel = "linux-epia"
OLDEST_KERNEL = "2.6.5"
KERNEL_IMAGETYPE = "bzImage"

GLIBC_ADDONS = "nptl"
GLIBC_EXTRA_OECONF = "--with-tls"

IMAGE_FSTYPES = "ext2.gz"

MACHINE_FEATURES = "kernel26 screen keyboard pci usbhost acpi ext2 x86"

require conf/machine/include/tune-c3.inc
```

## conf/machine/er0100.conf
```bitbake
#@TYPE: Machine
#@NAME: iRex Iliad e-ink reader
#@DESCRIPTION: Machine configuration for the iRex Iliad e-ink reader

#
# Hardware-based properties
#

# CPU: Intel (now Marvell) PXA255

TARGET_ARCH = "arm"

# Use tune-xscale per default. Machine independent feeds should be built with tune-strongarm.
require conf/machine/include/tune-xscale.inc

# Fix us:

#ROOT_FLASH_SIZE = "80"
#VOLATILE_STORAGE_SIZE = "64"
MACHINE_GUI_CLASS = "bigscreen"
MACHINE_DISPLAY_WIDTH_PIXELS = "768"
MACHINE_DISPLAY_HEIGHT_PIXELS = "1024"
MACHINE_FEATURES = "kernel24 touchscreen apm alsa pcmcia wifi usbgadget usbhost screen"

#
# Software/packages selection
#
PREFERRED_PROVIDER_virtual/kernel = "linux-er0100"
PCMCIA_MANAGER = "pcmcia-cs"
MODUTILS = "24"	
XSERVER = "xserver-kdrive-fbdev"


#
# Modules autoload and other boot properties
#
module_autoload_evdev = "evdev"
module_autoload_pcmcia = "pcmcia"

#FIXME: this should be controlled by a userspace utility later.
module_autoload_g_ether = "g_ether"

USE_VT = "0"
SERIAL_CONSOLE = "-L ttyS2 115200 vt100"
```

## conf/machine/eseries.conf
```bitbake
#@TYPE: Machine
#@NAME: eseries
#@DESCRIPTION: Machine configuration for the Toshiba eseries (e3xx/e4xx/e7xx/e8xx)

#
# Hardware-based properties
#
TARGET_ARCH = "arm"

#Compile with armv5te optimizations, incompatible with armv4(t) cpus
require conf/machine/include/tune-xscale.inc

#Set some hints for metadata  
VOLATILE_STORAGE_SIZE = "64"
ROOT_FLASH_SIZE = "32"
MACHINE_GUI_CLASS = "smallscreen"
MACHINE_DISPLAY_WIDTH_PIXELS = "240"
MACHINE_DISPLAY_HEIGHT_PIXELS = "320"
MACHINE_FEATURES = "kernel26 touchscreen apm alsa pcmcia bluetooth irda usbgadget screen"

#
# Software/packages selection
#
PCMCIA_MANAGER = "pcmciautils"
PREFERRED_PROVIDER_xserver = "xserver-kdrive"
PREFERRED_PROVIDER_virtual/kernel = "linux-handhelds-2.6"

EXTRA_IMAGECMD_jffs2 = "--pad --eraseblock=0x4000"

#
# Modules autoload and other boot properties
#
module_autoload_snd-pcm-oss 	= "snd-pcm-oss"

SERIAL_CONSOLE = "115200 ttyS0 vt100"
USE_VT = "0"

require conf/machine/include/LAB-settings.inc
```

## conf/machine/eten-m800.conf
```bitbake
#-----------------------------------------------------------------------------
#@TYPE: Machine
#@NAME: E-Ten Glofiish M800
#@DESCRIPTION: Machine configuration for the E-Ten Glofiish M800
#-----------------------------------------------------------------------------

TARGET_ARCH = "arm"

PREFERRED_PROVIDER_virtual/kernel ?= "linux-eten"
PREFERRED_PROVIDER_virtual/xserver = "xserver-kdrive"

MACHINE_FEATURES = "kernel26 apm alsa bluetooth gps usbgadget usbhost phone wifi vfat ext2 keyboard"
MACHINE_DISPLAY_WIDTH_PIXELS = "480"
MACHINE_DISPLAY_HEIGHT_PIXELS = "640"
MACHINE_DISPLAY_ORIENTATION = "0"
MACHINE_DISPLAY_PPI = "285"
XSERVER = "xserver-kdrive-fbdev"

# used by some images
ROOT_FLASH_SIZE = "256"

IMAGE_FSTYPES += "tar.gz"

# tune for S3C24x0
include conf/machine/include/tune-arm920t.inc
```

## conf/machine/exopcslate.conf
```bitbake
#@TYPE: Machine
#@NAME: exocpslate
#@DESCRIPTION: Machine configuration for the ExoPC Slate machine


TARGET_ARCH = "i686"

PREFERRED_VERSION_linux = "2.6.37"
PREFERRED_PROVIDER_virtual/kernel = "linux"
PREFERRED_PROVIDER_virtual/xserver = "xserver-xorg"
XSERVER = "xserver-xorg \
        xserver-xorg-extension-glx \
        xserver-xorg-extension-dri \
        xf86-input-tslib \
        xf86-input-evdev \
        xf86-input-evtouch \
        xf86-input-mouse \
        xf86-input-keyboard \
        xf86-video-fbdev \
"


KERNEL_IMAGETYPE = "bzImage"

GLIBC_ADDONS = "nptl"
GLIBC_EXTRA_OECONF = "--with-tls"

IMAGE_FSTYPES ?= "tar.gz"
IMAGE_DEVICE_TABLES = " \   
  files/device_table-minimal.txt \
  files/device_table_add-loop.txt \
  files/device_table_add-scsi.txt \
"

MACHINE_FEATURES = "kernel26 apm alsa bluetooth wifi vfat phone screen touchscreen keyboard pci usbhost acpi ext2 ext3 ext4 x86"
MACHINE_EXTRA_RRECOMMENDS = " kernel-modules"

module_autoload_hci_usb = "hci_usb"
module_autoload_g_ether = "g_ether"

require conf/machine/include/tune-atom.inc
```
