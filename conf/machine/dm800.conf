## conf/machine/fic-gta01.conf
```bitbake
#-----------------------------------------------------------------------------
#@TYPE: Machine
#@NAME: FIC GTA01 (Neo1973)
#@DESCRIPTION: Machine configuration for the FIC Neo1973/1 GSM phone
#-----------------------------------------------------------------------------

TARGET_ARCH = "arm"
PACKAGE_EXTRA_ARCHS = "armv4t"

PREFERRED_PROVIDER_virtual/kernel = "linux-gta01"

MACHINE_FEATURES = "kernel26 apm alsa bluetooth usbgadget usbhost phone"

# package machine specific modules
MACHINE_EXTRA_RRECOMMENDS = "\
  kernel-module-gta01-pm-bt  \
  kernel-module-gta01-pm-gps \
  kernel-module-gta01-pm-gsm \
  kernel-module-gta01kbd \
  kernel-module-s3cmci \
  kernel-module-ext2 \
  kernel-module-vfat \
  kernel-module-snd-soc-neo1973-wm8753 \
  kernel-module-snd-soc-smdk2440 \
  kernel-module-nls-iso8859-1 \
  kernel-module-nls-cp437 \
"

# do not outcomment, we bypass the sysvinit.bb logic here -- see FIC GTA01 inittab
#SERIAL_CONSOLE = "115200 ttySAC0"

# used by some images
ROOT_FLASH_SIZE = "60"

# extra jffs2 tweaks
EXTRA_IMAGECMD_jffs2 = "--eraseblock=0x4000 --pad -n"

# build tools
EXTRA_IMAGEDEPENDS += "sjf2410-linux-native"

# tune for S3C24x0
include conf/machine/include/tune-arm920t.conf
```

## conf/machine/fic-gta02.conf
```bitbake
#-----------------------------------------------------------------------------
#@TYPE: Machine
#@NAME: FIC GTA02 (Neo1973)
#@DESCRIPTION: Machine configuration for the FIC Neo1973.2 GSM phone
#-----------------------------------------------------------------------------

TARGET_ARCH = "arm"
PACKAGE_EXTRA_ARCHS = "armv4t"

PREFERRED_PROVIDER_virtual/kernel = "linux-openmoko"
UBOOT_ENTRYPOINT = "30008000"

MACHINE_FEATURES = "kernel26 apm alsa bluetooth usbgadget usbhost phone wifi"

# package machine specific modules
MACHINE_EXTRA_RRECOMMENDS = "\
  kernel-module-gta01-pm-bt  \
  kernel-module-gta01-pm-gps \
  kernel-module-gta01-pm-gsm \
  kernel-module-gta01kbd \
  kernel-module-s3cmci \
  kernel-module-ext2 \
  kernel-module-vfat \
  kernel-module-snd-soc-neo1973-wm8753 \
  kernel-module-snd-soc-smdk2440 \
  kernel-module-nls-iso8859-1 \
  kernel-module-nls-cp437 \
"

SERIAL_CONSOLE = "115200 ttySAC2"

# used by some images
ROOT_FLASH_SIZE = "256"

# extra jffs2 tweaks
EXTRA_IMAGECMD_jffs2 = "--little-endian --eraseblock=0x4000 --pad -n"

# build / upload tools
EXTRA_IMAGEDEPENDS += "sjf2410-linux-native dfu-util-native"

# tune for S3C24x0
include conf/machine/include/tune-arm920t.conf
```

## conf/machine/fsg3be.conf
```bitbake
#@TYPE: Machine
#@NAME: Freecom FSG-3 (big-endian)
#@DESCRIPTION: Machine configuration for an FSG3 in big-endian mode

TARGET_ARCH = "armeb"

PACKAGE_EXTRA_ARCHS = "ixp4xxbe"

MACHINE_ARCH = "ixp4xxbe"

OVERRIDES = "local:${MACHINE}:ixp4xxbe:ixp4xx:${DISTRO}:${TARGET_OS}:${TARGET_ARCH}:build-${BUILD_OS}:fail-fast:pn-${PN}"

# Match the vendor's latest kernel
PREFERRED_PROVIDER_virtual/kernel ?= "fsg3-kernel"
PREFERRED_VERSION_fsg3-kernel = "2.6.18"
KERNEL_CCSUFFIX = "-3.4.4+csl-arm-2005q3"
PREFERRED_PROVIDER_virtual/${TARGET_PREFIX}gcc-3.4.4+csl-arm-2005q3 = "gcc-cross-kernel-3.4.4"
PREFERRED_VERSION_virtual/${TARGET_PREFIX}gcc-3.4.4+csl-arm-2005q3 = "csl-arm-2005q3"

require conf/machine/include/ixp4xx.inc

# No room for jffs2 - the rootfs needs to be installed directly to disk
IMAGE_FSTYPES = "tar.gz"
```

## conf/machine/gamecube.conf
```bitbake
#@TYPE: Machine
#@Name: Nintendo GameCube
#@DESCRIPTION: Machine configuration for the Nintendo GameCube

TARGET_ARCH = "powerpc"

PREFERRED_PROVIDER_virtual/kernel ?= "linux"

MACHINE_FEATURES = "kernel26 ext2"

KERNEL_IMAGETYPE = "zImage"
```

## conf/machine/geodegx.conf
```bitbake
# Machine file for devices with the AMD Geode GX processor 
# Copyright (C) 2005, Advanced Micro Devices, Inc.  All Rights Reserved
# Released under the MIT license (see packages/COPYING)

TARGET_ARCH =  "i586"

require conf/machine/include/tune-geode.inc

PREFERRED_PROVIDER_virtual/kernel = "linux"
MACHINE_EXTRA_RDEPENDS = "kernel grub"
MACHINE_FEATURES = "kernel26 pci ext2 x86"
MACHINE_KERNEL_VERSION = "2.6"

udevdir = "/dev"

KERNEL_IMAGETYPE = "bzImage"

GLIBC_ADDONS = "nptl"
GLIBC_EXTRA_OECONF = "--with-tls --with-cpu=i586"
```

## conf/machine/geodelx.conf
```bitbake
# Machine file for devices with the AMD Geode LX processor 
# Copyright (C) 2005, Advanced Micro Devices, Inc.  All Rights Reserved
# Released under the MIT license (see packages/COPYING)

TARGET_ARCH =  "i486"

require conf/machine/include/tune-geode.inc

PREFERRED_PROVIDER_virtual/kernel = "linux-geodelx"

KERNEL_IMAGETYPE = "bzImage"

GLIBC_ADDONS = "nptl"
GLIBC_EXTRA_OECONF = "--with-tls --with-cpu=geode"
SELECTED_OPTIMIZATION_pn-glibc := "${@'${SELECTED_OPTIMIZATION}'.replace('-fomit-frame-pointer', '')}"
```

## conf/machine/gesbc-9302.conf
```bitbake
#@TYPE: Machine
#@Name: Glomation GESBC-9302 single board computer
#@DESCRIPTION: Low cost SBC based on Cirrus Logic EP9302 CPU

TARGET_ARCH = "arm"

PREFERRED_PROVIDER_virtual/kernel = "linux"
PREFERRED_VERSION_linux ?= "2.6.24"

#don't try to access tty1
USE_VT = "0"

MACHINE_FEATURES = "kernel26 apm alsa ext2 pcmcia usbhost screen"

# used by sysvinit_2
SERIAL_CONSOLE = "57600 ttyAM0"

# used by some images
ROOT_FLASH_SIZE = "8"
#extra jffs2 tweaks
IMAGE_FSTYPES ?= "jffs2"
EXTRA_IMAGECMD_jffs2 = "--eraseblock=0x40000 --pad=0x500000 "

#tune for ep93xx cpus
#can be used for crunch support later on
#require conf/machine/include/tune-ep9312.inc

require conf/machine/include/tune-arm920t.inc
```

## conf/machine/ghi270.conf
```bitbake
#@TYPE: Machine
#@NAME: GHI270 / DuraMax H / DuraMaxHG
#@DESCRIPTION: Machine configuration for the GHI270 platform with a pxa27x CPU

#
# Hardware-based properties
#
TARGET_ARCH = "arm"
PACKAGE_EXTRA_ARCHS = " iwmmxt "

# Use tune-xscale per default. Machine independent feeds should be built with tune-strongarm.
require conf/machine/include/tune-xscale.inc

# Uncomment this to use iwmmxt optimizations. Remove the above xscale stuff first
#require conf/machine/include/tune-iwmmxt.inc

EXTRA_IMAGECMD_jffs2_ghi270 = "-p -n -e 16KiB"

ROOT_FLASH_SIZE = "64"
VOLATILE_STORAGE_SIZE = "64"
MACHINE_GUI_CLASS = "smallscreen"
MACHINE_DISPLAY_WIDTH_PIXELS = "240"
MACHINE_DISPLAY_HEIGHT_PIXELS = "320"
MACHINE_FEATURES = "kernel26 touchscreen apm alsa pcmcia bluetooth irda wifi usbgadget screen"

#
# Software/packages selection
#
PREFERRED_PROVIDER_virtual/kernel = "linux-handhelds-2.6"
PREFERRED_VERSION_linux-handhelds-2.6               = "2.6.21-hh11"

PCMCIA_MANAGER = "pcmciautils"
MODUTILS = "26"

#PREFERRED_VERSION_xserver-kdrive = "1.3.0.0"

#PREFERRED_VERSION_orinoco-modules = "0.15rc1"

#
# Modules autoload and other boot properties
#

#FIXME: this should be controlled by a userspace utility later.
module_autoload_g_ether = "g_ether"

SERIAL_CONSOLE = "115200 ttySA0"
```
