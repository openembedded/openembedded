## conf/distro/familiar-0.8.4.conf
```bitbake
DISTRO = "familiar"
DISTRO_NAME = "Familiar Linux"
DISTRO_VERSION = "v0.8.4-rc2"

include conf/distro/familiar.conf
include conf/distro/familiar-feeds.inc

INHERIT += "simplepremirror"
SIMPLE_PREMIRROR = "http://familiar.handhelds.org/source/v0.8.4-rc2/sources/"


DISTRO_TYPE = "release"


CVSDATE = 20051212

PREFERRED_PROVIDERS += "virtual/${TARGET_PREFIX}gcc-initial:gcc-cross-initial"
PREFERRED_PROVIDERS += "virtual/${TARGET_PREFIX}gcc:gcc-cross"
PREFERRED_PROVIDERS += "virtual/${TARGET_PREFIX}g++:gcc-cross"

PREFERRED_PROVIDER_virtual/libiconv=glibc
PREFERRED_PROVIDER_virtual/libintl=glibc
PREFERRED_PROVIDER_x11=diet-x11

#newer hostap modules didn't seem to work for me 
PREFERRED_VERSION_hostap-modules ?= "0.3.9"

#2.4 machines prefer 0.13e ones
PREFERRED_VERSION_orinoco-modules ?= "0.13e"

#but 0.13e doesn't build against 2.6
PREFERRED_VERSION_orinoco-modules_h2200 ?= "0.15"
PREFERRED_VERSION_orinoco-modules_ipaq-pxa270 ?= "0.15"

#prefer a newer hh.org cvs kernel
CVSDATE_handhelds-pxa-2.6 = "20051221"
CVSDATE_LAB-kernel = "20051221"

CVSDATE_gomunicator = "20060518"

#The CSL compiler is unusable because
# 1) certain programs stop to compile
# 2) more programs segfault
PREFERRED_VERSION_gcc ?= "3.4.4"
PREFERRED_VERSION_gcc-cross ?= "3.4.4"
PREFERRED_VERSION_gcc-cross-initial ?= "3.4.4"
PREFERRED_VERSION_gcc-cross-sdk ?= "3.4.4"


#
# Machines section
#

# select kernel version for the zaurus family

ZKERNEL_VERSION_poodle = "2.4" 
ZKERNEL_VERSION_collie = "2.4"
ZKERNEL_VERSION_c7x0   = "2.6"
ZKERNEL_VERSION_spitz  = "2.4"
ZKERNEL_VERSION_akita  = "2.4"
ZKERNEL_VERSION_borzoi = "2.4"
ZKERNEL_VERSION_tosa   = "2.4" 


#
# Opie
#

PREFERRED_PROVIDERS += " virtual/libqpe:libqpe-opie"
PREFERRED_VERSION_qte = "2.3.10"

OPIE_VERSION = "1.2.1"
include conf/distro/preferred-opie-versions.inc

#
# GPE
#

PREFERRED_PROVIDERS += "virtual/xserver:xserver-kdrive"
PREFERRED_PROVIDERS += "virtual/gconf:gconf-dbus"
PREFERRED_PROVIDER_x11 = "diet-x11"

include conf/distro/preferred-gpe-versions-2.7.inc

#
# E
#
include conf/distro/preferred-e-versions.inc
```

## conf/distro/familiar-0.9.0.conf
```bitbake
include conf/distro/familiar.conf

DISTRO = "familiar"
DISTRO_NAME = "Familiar Linux"
DISTRO_VERSION = "v0.9.0-snapshots-${DATE}"

DISTRO_TYPE = "debug"
#DISTRO_TYPE = "release"

FEED_URIS += " \
        base##http://familiar.handhelds.org/releases/${DISTRO_VERSION}/feed/base \
	updates##http://familiar.handhelds.org/releases/${DISTRO_VERSION}/feed/updates"

#CVSDATE = 20050331

PREFERRED_PROVIDERS += "virtual/${TARGET_PREFIX}gcc-initial:gcc-cross-initial"
PREFERRED_PROVIDERS += "virtual/${TARGET_PREFIX}gcc:gcc-cross"
PREFERRED_PROVIDERS += "virtual/${TARGET_PREFIX}g++:gcc-cross"

#PREFERRED_VERSION_binutils-cross = "2.15.91.0.2"
#PREFERRED_VERSION_gcc-cross = "3.4.4"
#PREFERRED_VERSION_gcc-cross-initial = "3.4.4
#PREFERRED_VERSION_libtool-native = "1.5.6"
#PREFERRED_VERSION_libtool-cross= "1.5.6"

#
# Opie
#

PREFERRED_PROVIDERS += " virtual/libqpe:libqpe-opie"
PREFERRED_VERSION_qte = "2.3.10"

#OPIE_VERSION = "1.2.0"
include conf/distro/preferred-opie-versions.inc

#
# GPE
#

PREFERRED_PROVIDERS += "virtual/xserver:xserver-kdrive"
PREFERRED_PROVIDERS += "virtual/gconf:gconf-dbus"
PREFERRED_PROVIDER_x11 = "diet-x11"

include conf/distro/preferred-gpe-versions.inc

#
# E
#
include conf/distro/preferred-e-versions.inc
```

## conf/distro/familiar-feeds.inc
```bitbake
DISTRO_FEED_PREFIX = "http://ftp.handhelds.org/distributions/familiar/releases/${DISTRO_VERSION}/feed"

DISTRO_FEEDS_prepend () {
# Familiar ${DISTRO_VERSION} feeds

# base - essential packages
src/gz base ${DISTRO_FEED_PREFIX}/base
src/gz base-${MACHINE} ${DISTRO_FEED_PREFIX}/base/machine/${MACHINE}

# updates - security and bugfix updates go in this feed
src/gz updates ${DISTRO_FEED_PREFIX}/updates
src/gz updates-${MACHINE} ${DISTRO_FEED_PREFIX}/updates/machine/${MACHINE}

# common - additional packages not specific to any graphical environment
src/gz common ${DISTRO_FEED_PREFIX}/common
src/gz common-${MACHINE} ${DISTRO_FEED_PREFIX}/common/machine/${MACHINE}
}

DISTRO_LOCALE_FEEDS_PREFIXES = "${DISTRO_FEED_PREFIX}/base ${DISTRO_FEED_PREFIX}/updates ${DISTRO_FEED_PREFIX}/common"

DISTRO_LOCALE_FEEDS_HEADER_prepend () {
# Familiar ${DISTRO_VERSION} locale feeds

}
```

## conf/distro/familiar.conf
```bitbake
WARNING:="${@bb.fatal('\n*\n*\n*    Sorry, the Familiar Linux support in OpenEmbedded is not up-to-date. \n     If you want to produce Familiar Linux compatible packages,\n     please use the Familiar Linux fork of OpenEmbedded.\n     Otherwise, using a DISTRO like \"angstrom-2007.1\" or \"generic\"\n     probably works well enough with your MACHINE configuration.\n*\n*\n')}"
```

## conf/distro/foonas.conf
```bitbake
#@--------------------------------------------------------------------
#@TYPE: Distribution
#@NAME: foonas <http://www.foonas.org>
#@DESCRIPTION: A nas-centric distribution
#@MAINTAINER: Øyvind Repvik <repvik@foonas.org>
#@--------------------------------------------------------------------

FOONAS_MODE ?= "glibc"
ANGSTROM_MODE = ${FOONAS_MODE}
require conf/distro/angstrom-2007.1.conf

DISTRO = "foonas"
DISTRO_NAME = "foonas"
DISTRO_VERSION = "1.0-dev"
DISTRO_REVISION = "1"
DISTRO_TYPE = "debug"

DISTRO_FEATURES = "uboot redboot"
DISTRO_FEATURES_n2100 += "raid"
DISTRO_FEATURES_storcenter += "raid"
DISTRO_FEATURES_lsppchd += "raid"
DISTRO_FEATURES_lsppchg += "raid"
DISTRO_FEATURES_lsarm += "raid"

# This isn't actually in OE yet
#DISTRO_EXTRA_RDEPENDS = "openlink-machine"

ENABLE_BINARY_LOCALE_GENERATION = "0"
HOTPLUG = "udev"

# No room for debug apps on an NSLU2.
DEBUG_APPS = ""

FEED_URIS = "foonas##http://ipkg.foonas.org/${MACHINE}/cross-${FOONAS_MODE}/1.0-dev/"

IMAGE_PREPROCESS_COMMAND += "sed -i -es,^id:5:initdefault:,id:3:initdefault:, ${IMAGE_ROOTFS}/etc/inittab;"
IMAGE_PREPROCESS_COMMAND += "sed -i -es,^root::0,root:BTMzOOAQfESg6:0, ${IMAGE_ROOTFS}/etc/passwd;"
IMAGE_PREPROCESS_COMMAND += "sed -i -es,^VERBOSE=no,VERBOSE=very, ${IMAGE_ROOTFS}/etc/default/rcS;"
IMAGE_PREPROCESS_COMMAND += "rm -f ${IMAGE_ROOTFS}/boot/*"
IMAGE_PREPROCESS_COMMAND += "rm -f ${IMAGE_ROOTFS}/usr/lib/ipkg/lists/*"
IMAGE_POSTPROCESS_COMMAND += "${MACHINE}_pack_image;"
IMAGE_DEVICE_TABLE = "${@bb.which(bb.data.getVar('BBPATH', d, 1), 'files/device_table-slugos.txt')}"

require conf/distro/include/sane-srcdates.inc                                                         
PREFERRED_VERSION_openlink = "svn"
PREFERRED_VERSION_dtc = "20070216"
PREFERRED_VERSION_dtc-native = "20070216"
PREFERRED_VERSION_udev = "097"

# Various defines for QNAP Turbostation
#FOONAS_KERNEL_turbostation = "kernel-module-ext3 kernel-module-minix \
#				kernel-module-usb-storage"
#FOONAS_SUPPORT_turbostation += "uboot-utils"
#BOOTSTRAP_EXTRA_RDEPENDS_turbostation = "udev mdadm"
#
# Various defines for Linkstations
#FOONAS_KERNEL_lsppchg = "kernel-module-dm-mod kernel-module-raid1 \
#				 kernel-module-raid0 kernel-module-raid456 \
#				kernel-module-multipath"
#FOONAS_KERNEL_lsppchd = "${FOONAS_KERNEL_lsppchg}"
#FOONAS_SUPPORT_lsppchd = "uboot-utils dtc"
#FOONAS_SUPPORT_lsppchg = ${FOONAS_SUPPORT_lsppchd}
#
#FOONAS_KERNEL_storcenter = "kernel-module-dummy \
#                        kernel-module-af-packet "
```

## conf/distro/freeze.conf
```bitbake
# general configuration file for freezing a distribution
#
# If freeze.conf is included (include conf/distro/freeze.conf) in the
# distro conf file it will define BBFILES from the information in
# ${DISTRO}-bbfiles.conf or ${DISTRO}-packages.conf (whichever
# exists in that order of preference.)
#
# NOTE that these conf files use ${PKGDIR} and therefore that
# variable must be defined before this file is included, or the
# definition below (${TOPDIR}/openmebedded) must be correct.
#
PKGDIR ?= "${TOPDIR}/openembedded"
FROZEN_DIR ?= "/non/-existent/-directory/-for/-security"

# Pull in the frozen definitions (if they exist)  The multiple
# includes allow the frozen file to be stored alongside local.conf
# and in the conf/distro directory - the former take precedence over
# the latter.
include conf/distro/${DISTRO}-packages.conf
include conf/${DISTRO}-packages.conf
include ${FROZEN_DIR}/${DISTRO}-packages.conf

include conf/distro/${DISTRO}-bbfiles.conf
include conf/${DISTRO}-bbfiles.conf
include ${FROZEN_DIR}/${DISTRO}-bbfiles.conf
```
