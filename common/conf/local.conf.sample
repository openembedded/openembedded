## conf/distro/angstrom-2010.x.conf
```bitbake
#@--------------------------------------------------------------------
#@TYPE: Distribution
#@NAME: Angstrom <http://www.angstrom-distribution.org>
#@DESCRIPTION: The Linux Distribution for Kernel 2.6 based devices
#@MAINTAINER: Graeme 'XorA' Gregory <dp@xora.org.uk>
#@MAINTAINER: Koen Kooi <koen@openembedded.org>
#@MAINTAINER: Philip 'Crofton' Balister <philip@balister.org>
#@--------------------------------------------------------------------

# This is a aimed to be the next stable angstrom release. 
# If you want something stable *right now*, use angstrom-2008.1
#
# Use this at your own risk, we welcome bugreports sent to
#    angstrom-distro-devel@linuxtogo.org
#
# For more contact info please visit
#    http://www.angstrom-distribution.org/contact
#
# Again, in doubt, use DISTRO="angstrom-2008.1"

#DISTRO_VERSION = "2010.X"
DISTRO_VERSION = "v${DATE}"
DISTRO_REVISION = "4"
DISTRO_PR = ".9"

OLDEST_KERNEL ?= "2.6.16"

require conf/distro/include/angstrom-2010-preferred-versions.inc
require conf/distro/include/preferred-opie-versions-1.2.4.inc

#Images built can have to modes:
# 'debug': empty rootpassword, strace included
# 'release' no root password, no strace and gdb by default
DISTRO_TYPE ?= "debug"
#DISTRO_TYPE = "release"

# Set the toolchain type (internal, external) and brand (generic, csl etc.)
TOOLCHAIN_TYPE ?= "internal"
TOOLCHAIN_BRAND ?= ""

# Ship just basic locale by default. Locales are big (~1Mb uncompr.), so
# shipping some adhoc subset will be still useless and size burden for
# users of all other languages/countries. Instead, worth to make it easy
# to install additional languages: installer/wizard + metapackages which
# will RRECOMMEND as much as possible content for a given language
# (locales, UI transalations, help, etc. - useless for pros, but really 
# helpful for common users).
# Also, it appears that no locales fit in 16Mb for now. "C" locale rules!
IMAGE_LINGUAS = '${@base_less_or_equal("ROOT_FLASH_SIZE", "16", "", "en-us", d)}'


# set feed path variables
FEED_BASEPATH = "feeds/next/${ANGSTROM_PKG_FORMAT}/${LIBC}/"

# Uncomment this to fetch packaged-staging packages from the central angstrom server
#PSTAGE_MIRROR = "${ANGSTROM_URI}/${FEED_BASEPATH}packaged-staging"

#Make sure we use 2.6 on machines with a 2.4/2.6 selector
KERNEL = "kernel26"
MACHINE_KERNEL_VERSION = "2.6"
PCMCIA_MANAGER = "pcmciautils"

#Preferred version for the kernel on various machines
PREFERRED_VERSION_linux-handhelds-2.6 ?= "2.6.21-hh20"

#This is unrelated to the kernel version, but userspace apps (e.g. HAL) require a recent version to build against
LINUX_LIBC_HEADERS_VERSION ?= "2.6.32"
PREFERRED_VERSION_linux-libc-headers = "${LINUX_LIBC_HEADERS_VERSION}"
PREFERRED_VERSION_linux-libc-headers-native = "${LINUX_LIBC_HEADERS_VERSION}"

#Prefer glibc 2.6 and uclibc 0.9.30, these have had the most testing.
PREFERRED_VERSION_glibc 		?= "2.10.1"
PREFERRED_VERSION_glibc-initial 	?= "2.10.1"
PREFERRED_VERSION_uclibc        	?= "0.9.30.2"
PREFERRED_VERSION_uclibc-initial	?= "0.9.30.2"
PREFERRED_VERSION_eglibc		?= "2.12"
PREFERRED_VERSION_eglibc-initial	?= "2.12"

#powerpc needs additional patches to gcc
ANGSTROM_GCC_VERSION_ppc405 		?= "4.1.1"
ANGSTROM_GCC_VERSION_xilinx-ml403	?= "4.1.1"
ANGSTROM_GCC_VERSION_xilinx-ml403	?= "4.1.1"

# Blackfin has its on gcc
ANGSTROM_GCC_VERSION_bfin			= "4.1.2"

# Uncomment this if want need to build an armv7a kernel with CSL toolchain (<2.6.27 don't boot with mainline gcc)
#KERNEL_CCSUFFIX_armv7a = "-4.2.1+csl-arm-2007q3-53"
KERNEL_CCSUFFIX_archos5 = "-4.2.1+csl-arm-2007q3-53"
KERNEL_CCSUFFIX_archos5it = "-4.2.1+csl-arm-2007q3-53"

#avr32 only has support for gcc 4.2.2
ANGSTROM_GCC_VERSION_avr32		?= "4.2.2"

#Everybody else can just use this: 
ANGSTROM_GCC_VERSION                     ?= "4.5"

ANGSTROM_BINUTILS_VERSION                ?= "2.20.1"

PREFERRED_VERSION_binutils               ?= "${ANGSTROM_BINUTILS_VERSION}"
PREFERRED_VERSION_binutils-cross         ?= "${ANGSTROM_BINUTILS_VERSION}"
PREFERRED_VERSION_binutils-cross-sdk     ?= "${ANGSTROM_BINUTILS_VERSION}"

PREFERRED_VERSION_gcc                    ?= "${ANGSTROM_GCC_VERSION}"
PREFERRED_VERSION_gcc-cross              ?= "${ANGSTROM_GCC_VERSION}"
PREFERRED_VERSION_gcc-cross-sdk          ?= "${ANGSTROM_GCC_VERSION}"
PREFERRED_VERSION_gcc-cross-initial      ?= "${ANGSTROM_GCC_VERSION}"
PREFERRED_VERSION_gcc-cross-intermediate ?= "${ANGSTROM_GCC_VERSION}"

#avr32 only has patches for binutils 2.17 in OE
PREFERRED_VERSION_binutils_avr32 = "2.17"
PREFERRED_VERSION_binutils-cross_avr32 = "2.17"
PREFERRED_VERSION_binutils-cross-sdk_avr32 = "2.17"

PREFERRED_PROVIDER_dbus-glib             = "dbus-glib"
PREFERRED_PROVIDER_hotplug               = "udev"
PREFERRED_PROVIDER_opkg                 ?= "opkg"

ANGSTROM_BLACKLIST_pn-bluez-libs	= "bluez-libs 3.x has been replaced by bluez4"
ANGSTROM_BLACKLIST_pn-bluez-utils	= "bluez-utils 3.x has been replaced by bluez4"

ANGSTROM_BLACKLIST_pn-fso-apm       = "regular apmd is good enough"

ANGSTROM_BLACKLIST_pn-ipkg			= "ipkg has been superseded by opkg"

require conf/distro/include/angstrom.inc

# Toolchain virtuals:
require conf/distro/include/toolchain-${TOOLCHAIN_TYPE}.inc
require conf/distro/include/arm-thumb.inc

# Set DISTRO_FEED_CONFIGS to our config var, assigned in the above .inc
DISTRO_FEED_CONFIGS = "${ANGSTROM_FEED_CONFIGS}"

# If we're using an .ipk based rootfs, we want to have opkg installed so postinst script can run
# We also take this opportunity to inject angstrom-version and the feed configs into the rootfs
IPKG_VARIANT = "opkg angstrom-version ${ANGSTROM_FEED_CONFIGS}"

# we need the same provider for opkg and u-a
PREFERRED_PROVIDER_virtual/update-alternatives = "opkg"

# Select xserver-xorg as default, since kdrive has been EOL'ed
XSERVER ?= "xserver-xorg xf86-input-evdev xf86-input-keyboard xf86-input-mouse xf86-video-fbdev" 

# do some task-base stuff here

# Prefer bluez4, it's needed for things like connman. Bluez4 is also largely backward compatible with
# bluez 3.x
DISTRO_BLUETOOTH_MANAGER = "\
	blueprobe \
	bluez4 \
   "

# We want to ship extra debug utils in the rootfs when doing a debug build 
DEBUG_APPS ?= ""
DEBUG_APPS += '${@base_conditional("DISTRO_TYPE", "release", "", "strace procps",d)}'

# This hooks into task-base, so it won't do anything if your images doesn't include task-base.
# angstrom-version: ship this to have an identifiable rootfs so user can report bugs against a specific version
# ANGSTROM_FEED_CONFIGS: configfiles for the online feeds
# util-linux-ng-mount util-linux-ng-umount: busybox mount is broken
# angstrom-libc-fixup-hack: fixes an obscure bug with libc.so symlink
DISTRO_EXTRA_RDEPENDS += "\
    angstrom-version \
    ${ANGSTROM_FEED_CONFIGS} \
    util-linux-ng-mount util-linux-ng-umount \
    angstrom-libc-fixup-hack \
    "

# This also hooks into task-base, but isn't mandatory.
# If you don't want parts of this in your task-base using images you can put this in the image recipe:
# BAD_RECOMMENDATIONS = "avahi-daemon avahi-autoipd"
# Note that BAD_RECOMMENDATIONS is a feature of rootfs_ipk.bbclass, not angstrom
# kernel modules: ship fs modules so you can mount stuff and af-packet so networking works
# avahi: makes finding your device on the network a lot easier
# openssh-sftp-server: provides sftp which combined with avahi makes it real easy to use things like sshfs
# psplash-angstrom: angstrom branded psplash, you can add your own psplash-foo to an image, it uses update-alternatives
# DEBUG_APPS: ship strace and procpc to make simple debugging a lot easier
DISTRO_EXTRA_RRECOMMENDS += " \
    kernel-module-vfat \
    kernel-module-ext2 \
    kernel-module-ext3 \
    kernel-module-af-packet \
    avahi-daemon \
    avahi-autoipd \
    openssh-sftp-server \
    ${DEBUG_APPS} \
"

SPLASH ?= ' ${@base_contains("MACHINE_FEATURES", "screen", "psplash-angstrom", "",d)}'
ARM_INSTRUCTION_SET_pn-uclibc = "arm"
ARM_INSTRUCTION_SET_pn-uclibc-initial = "arm"


#Machine specific tweaks, will move to its own include soon
PREFERRED_PROVIDER_virtual/kernel_beagleboard = "linux-omap"
PREFERRED_VERSION_linux-omap_beagleboard = "2.6.37"
```

## conf/distro/angstrom.conf
```bitbake
#@TYPE: Distribution
#@NAME: Angstrom 
#@DESCRIPTION: Distribution configuration for Angstrom

DISTRO = "angstrom"
DISTRO_NAME = "Angstrom"

#we'll use this till we get a real domain
ANGSTROM_URI = "http://ewi546.ewi.utwente.nl/angstrom"

#Set the default maintainer to angstrom-dev
MAINTAINER ?= "Angstrom Developers <angstrom-dev@handhelds.org>"

#use ipkg package format with debian style naming
INHERIT += "package_ipk debian"

#use multimachine buildrules 
include conf/distro/include/multimachine.conf

#Generate locales on the buildsystem instead of on the target. Speeds up first boot
ENABLE_BINARY_LOCALE_GENERATION ?= "1"


#EABI isn't working yet, so we'll use TARGET_OS = linux in the meantime
#TARGET_OS = "none-linux-gnueabi"
TARGET_OS = "linux"

#mess with compiler flags to use -Os instead of -O2
#Please see http://free-electrons.com/doc/embedded_linux_optimizations/img47.html for some more info
FULL_OPTIMIZATION = "-fexpensive-optimizations -fomit-frame-pointer -frename-registers -Os"
BUILD_OPTIMIZATION = "-Os"

#eabi is softfloat by default, but let's make sure :)
TARGET_FPU = "soft"

PARALLEL_INSTALL_MODULES = "1"

BOOTSTRAP_EXTRA_DEPENDS += "angstrom-version dropbear sysvinit"
BOOTSTRAP_EXTRA_RDEPENDS += "angstrom-version dropbear sysvinit"

#Name the generated images in a sane way
IMAGE_NAME = "${DISTRO_NAME}-${IMAGE_BASENAME}-${DISTRO_VERSION}-${MACHINE}"
DEPLOY_DIR_IMAGE = ${DEPLOY_DIR}/images/${MACHINE}

DISTRO_CHECK := "${@bb.data.getVar("DISTRO_VERSION",d,1) or bb.fatal('Remove this line or set a dummy DISTRO_VERSION if you really want to build an unversioned distro')}"
```

## conf/distro/asusoe.conf
```bitbake
#@TYPE: Distribution
#@NAME: AsusOE Linux
#@DESCRIPTION: Distribution configuration for the WL500g Linux

DISTRO_NAME = "AsusOE"
DISTRO_VERSION = "0.1-alpha"

TARGET_OS = "linux-uclibc"
TARGET_SYS = "${TARGET_ARCH}-uclibc"

CROSS_DIR = "/opt/brcm/hndtools-mipsel-uclibc"

INHIBIT_DEFAULT_DEPS = "1"

USE_NLS ?= "no"

INHERIT += "package_ipk debian"

export prefix = "/opt"
export sysconfdir = "/opt/etc"
export localstatedir = "/opt/var"
```

## conf/distro/aurora.conf
```bitbake
#-----------------------------------------------------------------------------
#@TYPE: Distribution
#@NAME: Aurora
#@DESCRIPTION: Aurora distribution (based on minimal)
#
#@COMMENT: This is used by the FreeSmartphone team to ship a distribution
#@COMMENT: which is suitable for several mobile handset devices out there
#@COMMENT: and uses the FSO middleware to access several of their features
#@COMMENT: like telephony or GPS.
#-----------------------------------------------------------------------------

require conf/distro/minimal.conf

# set default locale for images
IMAGE_LINGUAS ?= "en-us"

#
# Header
#

DISTRO_NAME = "aurora"
DISTRO_VERSION = "0.1-${DATE}"
DISTRO_REVISION = "1"
DISTRO_PR = ".0"
DISTRO = "aurora"
DISTRO_SSH_DAEMON = "openssh"
DISTRO_APM = "fso-apm"
DISTRO_ALSA_STATE = "fsoaudiod"

require conf/distro/include/preferred-aurora-versions.inc

############################################################################
# SETTINGS
############################################################################

# Generate locales on the buildsystem instead of on the target. Speeds up first boot, set to "1" to enable
ENABLE_BINARY_LOCALE_GENERATION ?= "1"

# We only want to build UTF8 locales
LOCALE_UTF8_ONLY = "1"

# save statistical info on images
INHERIT += "testlab"

# activate the angstrom blacklister
INHERIT += "angstrom-blacklist"

DISTRO_FEED_PREFIX ?= "aurora"
DISTRO_FEED_URI ?= "http://amethyst.openembedded.net/~morphis/aurora/ipk/"

#############################################################################
# CONTENTS
#############################################################################

# Some additional content for images based on aurora
DISTRO_EXTRA_RDEPENDS += " \
    aurora-version \
"
```

## conf/distro/celinux-test.conf
```bitbake
#@--------------------------------------------------------------------
#@TYPE: Distribution
#@NAME: CELF Linux test
#@DESCRIPTION: A Linux Distribution for the CELF test project
#@--------------------------------------------------------------------

#
# core distro settings
#

# we want IPKG packages and Debian style naming
INHERIT += " package_ipk debian"

# enable if build for many machines
#INHERIT += " multimachine"

# we want images supporting the following features (for task-base)
DISTRO_FEATURES = "nfs pcmcia usbhost"

# enable if you want ltp in bootstrap images
#DISTRO_EXTRA_RDEPENDS = "ltp"

DISTRO_VERSION = "${DATE}"

# DISTRO_TYPE control behaviour of some recipes
# dropbear allow password-less root logins for "debug"
# kernel can be set to export logs to screen/serial
DISTRO_TYPE = "debug"
# DISTRO_TYPE = "release"

# fixed SRCDATE for many packages
require conf/distro/include/sane-srcdates.inc

# fix it to one date but allow to override in local.conf if needed
SRCDATE ?= "20060927"

#
# toolchain
#
PREFERRED_PROVIDERS += " virtual/${TARGET_PREFIX}gcc-initial:gcc-cross-initial"
PREFERRED_PROVIDERS += " virtual/${TARGET_PREFIX}gcc:gcc-cross"
PREFERRED_PROVIDERS += " virtual/${TARGET_PREFIX}g++:gcc-cross"
PREFERRED_PROVIDERS += " virtual/${TARGET_PREFIX}binutils:binutils-cross"
PREFERRED_PROVIDERS += " virtual/${TARGET_PREFIX}libc-for-gcc:glibc"

PREFERRED_VERSION_binutils = "2.16"
PREFERRED_VERSION_binutils-cross = "2.16"

PREFERRED_VERSION_gcc = "3.4.4"
PREFERRED_VERSION_gcc-cross = "3.4.4"
PREFERRED_VERSION_gcc-cross-initial = "3.4.4"

PREFERRED_VERSION_glibc = "2.3.5+cvs20050627"

# glibc provides iconv and intl
PREFERRED_PROVIDER_virtual/libiconv = "glibc"
PREFERRED_PROVIDER_virtual/libintl = "glibc"

#
# omap5912osk settings
#

# use latest booting kernel but allow to override it in local.conf
PREFERRED_VERSION_linux-omap1_omap5912osk ?= "2.6.18-omap1"

# gcc 3.x use other -mtune name then gcc 4.x
TARGET_CC_ARCH_omap5912osk = "-march=armv5te -mtune=arm926ejs"

# 2.6.18 kernel does not support pcmcia-cs ioctl() calls
PCMCIA_MANAGER = "pcmciautils"

#
# target system settings
#
TARGET_OS = "linux"

# use softfloat binaries to gain speed on ARM machines
TARGET_FPU_arm = "soft"

#
# extra checking for needed tools
#

# set minimal version of BitBake needed
BB_MIN_VERSION = "1.6.0"

# check for required tools and minimal BitBake version
INHERIT += "sanity"
```
