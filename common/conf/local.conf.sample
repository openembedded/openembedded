## conf/distro/amsdelta-oe.conf
```bitbake
DISTRO = "amsdelta-oe"
DISTRO_NAME = "AmsDelta Linux"
DISTRO_VERSION = "unstable-${DATE}"

require conf/distro/angstrom-2007.1.conf


DISTRO_TYPE = "debug"
#DISTRO_TYPE = "release"
#!!!!! DON'T FORGET TO ENABLE ZAPROOTPASSWD !!!!!


#
# Opie
#

PREFERRED_PROVIDERS += " virtual/libqpe:libqpe-opie"
PREFERRED_VERSION_qte = "2.3.10"

OPIE_VERSION = "1.2.1"
require conf/distro/include/preferred-opie-versions.inc

#
# GPE
#

PREFERRED_PROVIDERS += "virtual/xserver:xserver-kdrive"
PREFERRED_PROVIDERS += "virtual/gconf:gconf-dbus"
PREFERRED_PROVIDER_virtual/libx11 = "diet-x11"

require conf/distro/include/preferred-gpe-versions-2.8.inc
```

## conf/distro/angstrom-2006.9.conf
```bitbake
#DISTRO_VERSION = "2006.9"
DISTRO_VERSION = "test-${DATE}"

include conf/distro/angstrom.conf


DISTRO_TYPE = "debug"
#DISTRO_TYPE = "release"
#!!!!! DON'T FORGET TO ENABLE ZAPROOTPASSWD !!!!!


FEED_URIS += " \
		 base##${ANGSTROM_URI}/unstable/feed/base/"
#        base##${ANGSTROM_URI}/releases/${DISTRO_VERSION}/feed/base \
#        ${MACHINE}##${ANGSTROM_URI}/releases/${DISTRO_VERSION}/feed/${MACHINE} \
#        updates##${ANGSTROM_URI}/releases/${DISTRO_VERSION}/feed/updates"

#CVSDATE = 20050331


# Opie
include conf/distro/preferred-opie-versions.inc

# GPE
include conf/distro/preferred-gpe-versions-2.8.inc

# E
include conf/distro/preferred-e-versions.inc

PREFERRED_PROVIDERS += " virtual/libqpe:libqpe-opie"
PREFERRED_VERSION_qte = "2.3.10"


PREFERRED_PROVIDERS += "virtual/xserver:xserver-kdrive"
PREFERRED_PROVIDERS += "virtual/gconf:gconf-dbus"
#PREFERRED_PROVIDER_libx11 = "diet-x11"


PREFERRED_PROVIDERS += "virtual/${TARGET_PREFIX}gcc-initial:gcc-cross-initial"
PREFERRED_PROVIDERS += "virtual/${TARGET_PREFIX}gcc:gcc-cross"
PREFERRED_PROVIDERS += "virtual/${TARGET_PREFIX}g++:gcc-cross"

PREFERRED_PROVIDER_virtual/libiconv = "glibc"
PREFERRED_PROVIDER_virtual/libintl = "glibc"

#EABI stuff
#PREFERRED_PROVIDER_virtual/arm-none-linux-gnueabi-libc-for-gcc = "glibc-intermediate"
PREFERRED_VERSION_gcc ?= "4.0.2"
PREFERRED_VERSION_gcc-cross ?= "4.0.2"
PREFERRED_VERSION_gcc-cross-initial ?= "4.0.2"



#use EABI toolchain
#PREFERRED_VERSION_gcc ?= "3.4.4+csl-arm-20051214"
#PREFERRED_VERSION_gcc-cross ?= "3.4.4+csl-arm-20051214"
#PREFERRED_VERSION_gcc-cross-initial ?= "3.4.4+csl-arm-20051214"
#PREFERRED_VERSION_binutils ?= "2.16.91.0.4"
#PREFERRED_VERSION_binutils-cross ?= "2.16.91.0.4"
#PREFERRED_VERSION_glibc ?= "2.3.5+cvs20051214"
#PREFERRED_VERSION_glibc-intermediate ?= "2.3.5+cvs20051214"


PREFERRED_VERSION_orinoco-modules_h3600 = "0.13e"
PREFERRED_VERSION_orinoco-modules_h3900 = "0.13e"
PREFERRED_VERSION_dbus = "0.61"
```

## conf/distro/angstrom-2007.1-legacy.conf
```bitbake
#this is a special version of angstrom for legacy (e.g. kernel 2.4) software
# that means:
#      * no udev
#      * no sysfs
#      * no EABI for ARM

require conf/distro/angstrom-2007.1.conf

# We'll have to fill this in as we go.
```

## conf/distro/angstrom-2007.1-oabi.conf
```bitbake
require conf/distro/angstrom-2007.1.conf

#this is a special version of angstrom for armv4 based machines that can't do EABI
#see http://wiki.debian.org/ArmEabiPort for details on that

PREFERRED_PROVIDER_virtual/arm-angstrom-linux-libc-for-gcc = "glibc-intermediate"

#only glibc based builds are supported ATM
TARGET_OS = "linux"

PACKAGE_ARCH = "arm-oabi"
PACKAGE_EXTRA_ARCHS = "arm-oabi"

PREFERRED_VERSION_linux-handhelds-2.6_h3600 = "2.6.19-hh12"

FEED_ARCH_collie       = "arm-oabi"
FEED_ARCH_h3600        = "arm-oabi"
FEED_ARCH_h3800        = "arm-oabi"
FEED_ARCH_simpad       = "arm-oabi"
```

## conf/distro/angstrom-2007.1.conf
```bitbake
#@--------------------------------------------------------------------
#@TYPE: Distribution
#@NAME: Angstrom <http://www.angstrom-distribution.org>
#@DESCRIPTION: The Linux Distribution for Kernel 2.6 based devices
#@MAINTAINER: Koen Kooi <koen@dominion.kabel.utwente.nl>
#@MAINTAINER: Michael 'Mickey' Lauer <mickey@Vanille.de>
#@--------------------------------------------------------------------

#DISTRO_VERSION = "2007.9"
DISTRO_VERSION = "2007.9-test-${DATE}"
DISTRO_REVISION = "46"

require conf/distro/include/sane-srcdates.inc
require conf/distro/include/sane-srcrevs.inc

#Images built can have to modes:
# 'debug': empty rootpassword, strace and gdb included
# 'release' no root password, no strace and gdb by default
DISTRO_TYPE ?= "debug"
#DISTRO_TYPE = "release"

# Ship just basic locale by default. Locales are big (~1Mb uncompr.), so
# shipping some adhoc subset will be still useless and size burden for
# users of all other languages/countries. Instead, worth to make it easy
# to install additional languages: installer/wizard + metapackages which
# will RRECOMMEND as much as possible content for a given language
# (locales, UI transalations, help, etc. - useless for pros, but really 
# helpful for common users).
# Also, it appears that no locales fit in 16Mb for now. "C" locale rules!
IMAGE_LINGUAS = '${@base_less_or_equal("ROOT_FLASH_SIZE", "16", "", "en-gb", d)}'

FEED_URIS += " \
		no-arch##${ANGSTROM_URI}/unstable/feed/all \
		base##${ANGSTROM_URI}/unstable/feed/${FEED_ARCH}/base \
		perl##${ANGSTROM_URI}/unstable/feed/${FEED_ARCH}/perl \
		python##${ANGSTROM_URI}/unstable/feed/${FEED_ARCH}/python \
		debug##${ANGSTROM_URI}/unstable/feed/${FEED_ARCH}/debug \
		gstreamer##${ANGSTROM_URI}/unstable/feed/${FEED_ARCH}/gstreamer \
		${MACHINE}##${ANGSTROM_URI}/unstable/feed/${FEED_ARCH}/machine/${MACHINE}"
#        base##${ANGSTROM_URI}/releases/${DISTRO_VERSION}/feed/${FEED_ARCH}/base \
#        ${MACHINE}##${ANGSTROM_URI}/releases/${DISTRO_VERSION}/feed/${FEED_ARCH}/machine/${MACHINE} \
#        updates##${ANGSTROM_URI}/releases/${DISTRO_VERSION}/feed/${FEED_ARCH}/updates"

#The angstrom-mirrors.bbclass should have everything, but we can use this as a fallback
CVS_TARBALL_STASH ?= "\
		     http://www.angstrom-distribution.org/unstable/sources/ \
		     http://ewi546.ewi.utwente.nl/mirror/www.openzaurus.org/official/unstable/3.5.4/sources/ \
		    "


#Make sure we use 2.6 on machines with a 2.4/2.6 selector
KERNEL = "kernel26"
MACHINE_KERNEL_VERSION = "2.6"
PCMCIA_MANAGER = "pcmciautils"

#Preferred version for the kernel on various machines
PREFERRED_VERSION_linux-handhelds-2.6               ?= "2.6.21-hh17"
RDEPENDS_kernel-base_hx4700 = ""
RDEPENDS_kernel-base_htcuniversal = ""

# Needed for crappy ipaqs with broken hostap in the kernel
PREFERRED_VERSION_hostap-modules                    ?= "0.4.7"
PREFERRED_VERSION_hostap-utils                      ?= "0.4.7"

PREFERRED_VERSION_file         = "4.18"
PREFERRED_VERSION_file_native  = "4.18"

PREFERRED_VERSION_fontconfig       = "2.4.1"
PREFERRED_VERSION_freetype         = "2.3.4"
PREFERRED_VERSION_freetype-native  = "2.2.1"
PREFERRED_VERSION_cairo            = "1.4.10"
PREFERRED_VERSION_glib-2.0         = "2.12.12"
PREFERRED_VERSION_pango            = "1.16.4"
PREFERRED_VERSION_atk              = "1.20.0"
PREFERRED_VERSION_gtk+             = "2.10.14"

# newer poppler cvs breaks some apps, fix until popper 6 and apps
# catch up with api changes
# PREFERRED_VERSION_poppler          = "0.5.4"

# older gtk-webcore releases don't work on ARM/EABI
# We need to switch to a fixed SRCDATE or release as soon as possible 
PREFERRED_VERSION_osb-browser      = "0.5.0+svn${SRCDATE}"
PREFERRED_VERSION_osb-jscore       = "0.5.2+svn${SRCDATE}"
PREFERRED_VERSION_osb-nrcit        = "0.5.2+svn${SRCDATE}"
PREFERRED_VERSION_osb-nrcore       = "0.5.2+svn${SRCDATE}"

PREFERRED_PROVIDER_avahi = "avahi"

#Small machines prefer kdrive, but we might ship full Xorg in other images
PREFERRED_PROVIDER_virtual/xserver  ?= "xserver-kdrive"
PREFERRED_PROVIDER_xserver          ?= "xserver-kdrive"

PREFERRED_VERSION_xserver-kdrive    ?= "1.3.0.0"
PREFERRED_VERSION_libxrandr         ?= "1.2.1"
PREFERRED_VERSION_xrandr            ?= "1.2.0" 
PREFERRED_VERSION_randrproto        ?= "1.2.1"

PREFERRED_VERSION_libgnomeui         = "2.18.1"
PREFERRED_VERSION_prismstumbler      = "0.7.3"

#use EABI ready toolchain
PREFERRED_VERSION_gcc               ?= "4.1.2"
PREFERRED_VERSION_gcc-cross         ?= "4.1.2"
PREFERRED_VERSION_gcc-cross-sdk     ?= "4.1.2"
PREFERRED_VERSION_gcc-cross-initial ?= "4.1.2"

PREFERRED_VERSION_gcc_dht-walnut               ?= "4.1.1"
PREFERRED_VERSION_gcc-cross_dht-walnut         ?= "4.1.1"
PREFERRED_VERSION_gcc-cross-sdk_dht-walnut     ?= "4.1.1"
PREFERRED_VERSION_gcc-cross-initial_dht-walnut ?= "4.1.1"

PREFERRED_VERSION_binutils          ?= "2.18"
PREFERRED_VERSION_binutils-cross    ?= "2.18"
PREFERRED_VERSION_binutils-cross-sdk ?= "2.18"


#This is unrelated to the kernel version, but userspace apps (e.g. HAL) require a recent version to build against
PREFERRED_VERSION_linux-libc-headers ?= "2.6.20"
PREFERRED_VERSION_linux-libc-headers_bfin = "2.6.21"

#Prefer glibc 2.5 and uclibc 0.9.29, these have had the most testing.
PREFERRED_VERSION_glibc ?= "2.5"
PREFERRED_VERSION_uclibc ?= "0.9.29"
PREFERRED_VERSION_uclibc-initial ?= "0.9.29"

PREFERRED_VERSION_glibc-intermediate_i686 ?= "2.4"
PREFERRED_VERSION_glibc-intermediate ?= "2.5"

PREFERRED_VERSION_glibc-initial ?= "2.5"

# To use an EABI compatible version 3 series gcc, either uncomment 
# the lines below or set them in local.conf: 
#
# PREFERRED_VERSION_gcc-cross = "3.4.4+csl-arm-2005q3"
# PREFERRED_VERSION_gcc-cross-initial = "3.4.4+csl-arm-2005q3"


# Busybox <1.1.0 doesn't have EABI support
PREFERRED_VERSION_busybox = "1.2.1"

PREFERRED_VERSION_dbus ?= "1.0.2"
PREFERRED_VERSION_dbus-glib ?= "0.74"

#Loads preferred versions from files, these have weak assigments (?=), so put them at the bottom
require conf/distro/include/preferred-gpe-versions-2.8.inc
require conf/distro/include/preferred-e-versions.inc
require conf/distro/include/preferred-xorg-versions.inc
require conf/distro/include/preferred-openmoko-versions.inc


# Virtuals:
PREFERRED_PROVIDER_virtual/${TARGET_PREFIX}gcc-initial = "gcc-cross-initial"
PREFERRED_PROVIDER_virtual/${TARGET_PREFIX}gcc = "gcc-cross"
PREFERRED_PROVIDER_virtual/${TARGET_PREFIX}g++ = "gcc-cross"

#Set preferred provider for the C library that is used to build the crosscompiler (NPTL voodoo)
PREFERRED_PROVIDER_virtual/${TARGET_PREFIX}libc-for-gcc               = "glibc-intermediate"
PREFERRED_PROVIDER_virtual/arm-angstrom-linux-gnueabi-libc-for-gcc    = "glibc-intermediate"
PREFERRED_PROVIDER_virtual/armeb-angstrom-linux-gnueabi-libc-for-gcc  = "glibc-intermediate"
PREFERRED_PROVIDER_virtual/arm-angstrom-linux-libc-for-gcc            = "glibc-intermediate"
PREFERRED_PROVIDER_virtual/powerpc-angstrom-linux-libc-for-gcc        = "glibc-intermediate"
PREFERRED_PROVIDER_virtual/mipsel-angstrom-linux-libc-for-gcc         = "glibc-intermediate"
PREFERRED_PROVIDER_virtual/sparc-angstrom-linux-libc-for-gcc          = "glibc-intermediate"

PREFERRED_PROVIDER_virtual/arm-angstrom-linux-uclibcgnueabi-libc-for-gcc    = "uclibc-initial"
PREFERRED_PROVIDER_virtual/armeb-angstrom-linux-uclibcgnueabi-libc-for-gcc  = "uclibc-initial"

# hostap stuff, we prefer the in-kernel modules, but those don't work for all machines
PREFERRED_PROVIDER_hostap-conf                      ?= "hostap-conf"
PREFERRED_PROVIDER_hostap-modules_h2200             ?= "hostap-modules"
PREFERRED_PROVIDER_hostap-modules_hx4700            ?= "hostap-modules"

PREFERRED_PROVIDER_virtual/db           ?= "db"
PREFERRED_PROVIDER_virtual/db-native    ?= "db-native"
PREFERRED_PROVIDER_virtual/libsdl       ?= "libsdl-x11"
PREFERRED_PROVIDER_virtual/libx11       ?= "libx11"
PREFERRED_PROVIDER_virtual/libxine      ?= "libxine-x11"
PREFERRED_PROVIDER_virtual/xserver      ?= "xserver-kdrive"

# Others:
PREFERRED_PROVIDER_dbus-glib             = "dbus-glib"
PREFERRED_PROVIDER_esound 		?= "pulseaudio"
PREFERRED_PROVIDER_gconf                ?= "gconf-dbus"
PREFERRED_PROVIDER_gnome-vfs            ?= "gnome-vfs"
PREFERRED_PROVIDER_gnome-vfs-plugin-file ?= "gnome-vfs"
PREFERRED_PROVIDER_tslib                ?= "tslib"
PREFERRED_PROVIDER_tslib-conf           ?= "tslib"
PREFERRED_PROVIDER_libgpewidget         ?= "libgpewidget"
PREFERRED_PROVIDER_ntp                  ?= "ntp"
PREFERRED_PROVIDER_hotplug               = "udev"
PREFERRED_PROVIDER_libxss                = "libxss"

# we don't ship gtk-directfb by default
PREFERRED_PROVIDER_gtk+                   ?= "gtk+"
PREFERRED_PROVIDER_gdk-pixbuf-loader-ani  ?= "gtk+"
PREFERRED_PROVIDER_gdk-pixbuf-loader-bmpg ?= "gtk+"
PREFERRED_PROVIDER_gdk-pixbuf-loader-gif  ?= "gtk+"
PREFERRED_PROVIDER_gdk-pixbuf-loader-ico  ?= "gtk+"
PREFERRED_PROVIDER_gdk-pixbuf-loader-jpeg ?= "gtk+"
PREFERRED_PROVIDER_gdk-pixbuf-loader-pcx  ?= "gtk+"
PREFERRED_PROVIDER_gdk-pixbuf-loader-png  ?= "gtk+"
PREFERRED_PROVIDER_gdk-pixbuf-loader-pnm  ?= "gtk+"
PREFERRED_PROVIDER_gdk-pixbuf-loader-ras  ?= "gtk+"
PREFERRED_PROVIDER_gdk-pixbuf-loader-tga  ?= "gtk+"
PREFERRED_PROVIDER_gdk-pixbuf-loader-wbmp ?= "gtk+"
PREFERRED_PROVIDER_gdk-pixbuf-loader-xbm  ?= "gtk+"
PREFERRED_PROVIDER_gdk-pixbuf-loader-xpm  ?= "gtk+"


#Silence a warning during parsing
PREFERRED_PROVIDER_task-bootstrap = "task-bootstrap"


# Lock down almost every recipe:
require conf/distro/include/angstrom-2007-preferred-versions.inc 

#This is needed to get a correct PACKAGE_ARCH for packages that have PACKAGE_ARCH = ${MACHINE_ARCH}
ARM_ABI ?= "${@['','oabi'][bb.data.getVar('MACHINE',d) in ['collie','h3600', 'h3800', 'simpad', 'htcwallaby']]}"
require conf/distro/include/angstrom${ARM_ABI}.inc

# do some task-base stuff here

# We want to ship extra debug utils in the rootfs when doing a debug build 
DEBUG_APPS ?= ""
DEBUG_APPS += '${@base_conditional("DISTRO_TYPE", "release", "", "tslib-tests tslib-calibrate gdb strace procps",d)}'

#this should go away soon
EXTRA_STUFF ?= ""


# Angstrom want to ship some extra stuff. This should be moved into task-base eventually
# contains ipkg specific stuff as well :(

#work around a bitbake bug where mtd-utils-native isn't created so do_rootfs fails 
DISTRO_EXTRA_DEPENDS += " \
    mtd-utils-native \
    "    

DISTRO_EXTRA_RDEPENDS += "\
    update-modules \
    ${@base_contains("MACHINE_FEATURES", "screen", "psplash", "",d)} \   
    angstrom-version \
    ipkg ipkg-collateral \
    util-linux-mount util-linux-umount \
    ${EXTRA_STUFF} \
    ${DEBUG_APPS} \
    "

DISTRO_EXTRA_RRECOMMENDS += " \
    kernel-module-vfat \
    kernel-module-ext2 \
    kernel-module-af-packet \
    avahi-daemon \
    avahi-autoipd \
    openssh-sftp-server \
    "
```
